/dts-v1/;

/ {
	compatible = "qcom,atoll-ab-idp\0qcom,atoll-ab\0qcom,idp\0qcom,atp";
	model = "ATP";
	qcom,board-id = <0x21 0x00>;
	qcom,msm-id = <0x1bb 0x00>;

	__fixups__ {
		BOB = "/fragment@32/__overlay__/wcd938x-codec:cdc-vdd-mic-bias-supply:0\0/fragment@32/__overlay__/wcd937x-codec:cdc-vdd-mic-bias-supply:0";
		CPU0 = "/fragment@0/__overlay__/pm6150l-tz/cooling-maps/trip0_cpu0:cooling-device:0";
		CPU1 = "/fragment@0/__overlay__/pm6150l-tz/cooling-maps/trip0_cpu1:cooling-device:0\0/fragment@0/__overlay__/pm6150l-tz/cooling-maps/trip1_cpu1:cooling-device:0";
		CPU2 = "/fragment@0/__overlay__/pm6150l-tz/cooling-maps/trip0_cpu2:cooling-device:0\0/fragment@0/__overlay__/pm6150l-tz/cooling-maps/trip1_cpu2:cooling-device:0";
		CPU3 = "/fragment@0/__overlay__/pm6150l-tz/cooling-maps/trip0_cpu3:cooling-device:0\0/fragment@0/__overlay__/pm6150l-tz/cooling-maps/trip1_cpu3:cooling-device:0";
		CPU4 = "/fragment@0/__overlay__/pm6150l-tz/cooling-maps/trip0_cpu4:cooling-device:0\0/fragment@0/__overlay__/pm6150l-tz/cooling-maps/trip1_cpu4:cooling-device:0";
		CPU5 = "/fragment@0/__overlay__/pm6150l-tz/cooling-maps/trip0_cpu5:cooling-device:0\0/fragment@0/__overlay__/pm6150l-tz/cooling-maps/trip1_cpu5:cooling-device:0";
		CPU6 = "/fragment@0/__overlay__/pm6150l-tz/cooling-maps/trip0_cpu6:cooling-device:0\0/fragment@0/__overlay__/pm6150l-tz/cooling-maps/trip1_cpu6:cooling-device:0\0/fragment@0/__overlay__/pm6150-bcl-lvl0/cooling-maps/vbat_cpu6:cooling-device:0\0/fragment@0/__overlay__/pm6150-bcl-lvl1/cooling-maps/ibat_cpu6:cooling-device:0\0/fragment@0/__overlay__/pm6150-bcl-lvl2/cooling-maps/ibat_cpu6:cooling-device:0\0/fragment@0/__overlay__/soc/cooling-maps/soc_cpu6:cooling-device:0";
		CPU7 = "/fragment@0/__overlay__/pm6150l-tz/cooling-maps/trip0_cpu7:cooling-device:0\0/fragment@0/__overlay__/pm6150l-tz/cooling-maps/trip1_cpu7:cooling-device:0\0/fragment@0/__overlay__/pm6150-bcl-lvl0/cooling-maps/vbat_cpu7:cooling-device:0\0/fragment@0/__overlay__/pm6150-bcl-lvl1/cooling-maps/ibat_cpu7:cooling-device:0\0/fragment@0/__overlay__/pm6150-bcl-lvl2/cooling-maps/ibat_cpu7:cooling-device:0\0/fragment@0/__overlay__/soc/cooling-maps/soc_cpu7:cooling-device:0";
		L10A = "/fragment@32/__overlay__/wcd938x-codec:cdc-vdd-rxtx-supply:0\0/fragment@32/__overlay__/wcd938x-codec:cdc-vddio-supply:0\0/fragment@32/__overlay__/wcd937x-codec:cdc-vdd-ldo-rxtx-supply:0\0/fragment@32/__overlay__/wcd937x-codec:cdc-vddpx-1-supply:0";
		L15A = "/fragment@32/__overlay__/wcd938x-codec:cdc-vdd-buck-supply:0\0/fragment@32/__overlay__/wcd937x-codec:cdc-vdd-buck-supply:0";
		L18A = "/fragment@10/__overlay__/qcom,dsi-display:vddio-supply:0";
		atoll_snd = "/fragment@33:target:0";
		audio_apr = "/fragment@33/__overlay__:qcom,msm_audio_ssr_devs:0";
		bcl_lvl0 = "/fragment@0/__overlay__/pm6150-bcl-lvl0/cooling-maps/vbat_cpu6:trip:0\0/fragment@0/__overlay__/pm6150-bcl-lvl0/cooling-maps/vbat_cpu7:trip:0";
		bcl_lvl1 = "/fragment@0/__overlay__/pm6150-bcl-lvl1/cooling-maps/ibat_cpu6:trip:0\0/fragment@0/__overlay__/pm6150-bcl-lvl1/cooling-maps/ibat_cpu7:trip:0";
		bcl_lvl2 = "/fragment@0/__overlay__/pm6150-bcl-lvl2/cooling-maps/ibat_cpu6:trip:0\0/fragment@0/__overlay__/pm6150-bcl-lvl2/cooling-maps/ibat_cpu7:trip:0";
		bolero = "/fragment@32:target:0\0/fragment@32/__overlay__/wsa-macro@62640000/wsa_swr_master/wsa881x@20170211:qcom,bolero-handle:0\0/fragment@32/__overlay__/wsa-macro@62640000/wsa_swr_master/wsa881x@20170212:qcom,bolero-handle:0\0/fragment@32/__overlay__/wsa-macro@62640000/wsa_swr_master/wsa881x@21170213:qcom,bolero-handle:0\0/fragment@32/__overlay__/wsa-macro@62640000/wsa_swr_master/wsa881x@21170214:qcom,bolero-handle:0\0/fragment@33/__overlay__:asoc-codec:4\0/fragment@33/__overlay__:qcom,msm_audio_ssr_devs:12";
		disp_pins_default = "/fragment@10/__overlay__/qcom,dsi-display:pinctrl-0:4";
		eud = "/fragment@16/__overlay__:extcon:8";
		fsa4480 = "/fragment@30/__overlay__:qcom,dp-aux-switch:0";
		lcdb_ldo_vreg = "/fragment@10/__overlay__/qcom,dsi-display:lab-supply:0";
		lcdb_ncp_vreg = "/fragment@10/__overlay__/qcom,dsi-display:ibb-supply:0";
		lpass_audio_hw_vote = "/fragment@31/__overlay__/lpi_pinctrl@627C0000:clocks:8\0/fragment@32/__overlay__/tx-macro@62620000/tx_swr_master:clocks:8\0/fragment@32/__overlay__/rx-macro@62600000/rx_swr_master:clocks:8\0/fragment@32/__overlay__/wsa-macro@62640000/wsa_swr_master:clocks:8\0/fragment@32/__overlay__/va-macro@62770000:clocks:0";
		lpass_core_hw_vote = "/fragment@31/__overlay__/lpi_pinctrl@627C0000:clocks:0\0/fragment@32/__overlay__/tx-macro@62620000/tx_swr_master:clocks:0\0/fragment@32/__overlay__/rx-macro@62600000/rx_swr_master:clocks:0\0/fragment@32/__overlay__/wsa-macro@62640000/wsa_swr_master:clocks:0";
		mdss_dsi0 = "/fragment@10/__overlay__/qcom,dsi-display:qcom,dsi-ctrl:0";
		mdss_dsi0_pll = "/fragment@10/__overlay__/qcom,dsi-display:clocks:0\0/fragment@10/__overlay__/qcom,dsi-display:clocks:8\0/fragment@10/__overlay__/qcom,dsi-display:clocks:16\0/fragment@10/__overlay__/qcom,dsi-display:clocks:24\0/fragment@10/__overlay__/qcom,dsi-display:clocks:32\0/fragment@10/__overlay__/qcom,dsi-display:clocks:40\0/fragment@10/__overlay__/qcom,dsi-display:clocks:48\0/fragment@10/__overlay__/qcom,dsi-display:clocks:56\0/fragment@10/__overlay__/qcom,dsi-display:clocks:64\0/fragment@10/__overlay__/qcom,dsi-display:clocks:72";
		mdss_dsi_phy0 = "/fragment@10/__overlay__/qcom,dsi-display:qcom,dsi-phy:0";
		mdss_mdp = "/fragment@1:target:0\0/fragment@2:target:0\0/fragment@3:target:0\0/fragment@4:target:0\0/fragment@5:target:0\0/fragment@6:target:0\0/fragment@7:target:0\0/fragment@8:target:0\0/fragment@9:target:0\0/fragment@12:target:0";
		nfc_clk_req_active = "/fragment@28/__overlay__/nq@28:pinctrl-0:8";
		nfc_clk_req_suspend = "/fragment@28/__overlay__/nq@28:pinctrl-1:8";
		nfc_enable_active = "/fragment@28/__overlay__/nq@28:pinctrl-0:4";
		nfc_enable_suspend = "/fragment@28/__overlay__/nq@28:pinctrl-1:4";
		nfc_int_active = "/fragment@28/__overlay__/nq@28:pinctrl-0:0";
		nfc_int_suspend = "/fragment@28/__overlay__/nq@28:pinctrl-1:0";
		pm6150_charger = "/fragment@0/__overlay__/pm6150-tz/cooling-maps/trip0_bat:cooling-device:0\0/fragment@0/__overlay__/pm6150-tz/cooling-maps/trip1_bat:cooling-device:0\0/fragment@16/__overlay__:extcon:4\0/fragment@25:target:0";
		pm6150_l10 = "/fragment@29/__overlay__/synaptics_tcm@20:vdd-supply:0";
		pm6150_l12 = "/fragment@19/__overlay__:vccq2-supply:0\0/fragment@20/__overlay__:vdd-io-supply:0";
		pm6150_l19 = "/fragment@19/__overlay__:vcc-supply:0\0/fragment@20/__overlay__:vdd-supply:0";
		pm6150_l4 = "/fragment@18/__overlay__:vdda-phy-supply:0";
		pm6150_pdphy = "/fragment@11/__overlay__:qcom,dp-usbpd-detection:0\0/fragment@16/__overlay__:extcon:0\0/fragment@17/__overlay__:extcon:0";
		pm6150_qg = "/fragment@24:target:0";
		pm6150_trip0 = "/fragment@0/__overlay__/pm6150-tz/cooling-maps/trip0_bat:trip:0";
		pm6150_trip1 = "/fragment@0/__overlay__/pm6150-tz/cooling-maps/trip1_bat:trip:0";
		pm6150_vadc = "/fragment@25/__overlay__:io-channels:0\0/fragment@25/__overlay__:io-channels:8\0/fragment@25/__overlay__:io-channels:16\0/fragment@25/__overlay__:io-channels:24\0/fragment@25/__overlay__:io-channels:32\0/fragment@25/__overlay__:io-channels:40\0/fragment@25/__overlay__:io-channels:48";
		pm6150a_amoled = "/fragment@23:target:0";
		pm6150l_adc_tm = "/fragment@15:target:0\0/fragment@22/__overlay__/pa-therm1:thermal-sensors:0";
		pm6150l_gpios = "/fragment@2/__overlay__/qcom,mdss_dsi_rm69299_visionox_amoled_video:qcom,platform-reset-gpio:0\0/fragment@3/__overlay__/qcom,mdss_dsi_rm69299_visionox_amoled_cmd:qcom,platform-reset-gpio:0\0/fragment@4/__overlay__/qcom,mdss_dsi_sim_video:qcom,platform-reset-gpio:0\0/fragment@5/__overlay__/qcom,mdss_dsi_sim_cmd:qcom,platform-reset-gpio:0\0/fragment@6/__overlay__/qcom,mdss_dsi_sim_dsc_375_cmd:qcom,platform-reset-gpio:0\0/fragment@10/__overlay__/qcom,dsi-display:qcom,platform-reset-gpio:0\0/fragment@26:target:0\0/fragment@27/__overlay__/gpio_keys/vol_up:gpios:0";
		pm6150l_l3 = "/fragment@18/__overlay__:vdda-pll-supply:0\0/fragment@19/__overlay__:qcom,vddp-ref-clk-supply:0";
		pm6150l_l6 = "/fragment@21/__overlay__:vdd-io-supply:0";
		pm6150l_l7 = "/fragment@29/__overlay__/synaptics_tcm@20:avdd-supply:0";
		pm6150l_l9 = "/fragment@21/__overlay__:vdd-supply:0";
		pm6150l_trip0 = "/fragment@0/__overlay__/pm6150l-tz/cooling-maps/trip0_cpu0:trip:0\0/fragment@0/__overlay__/pm6150l-tz/cooling-maps/trip0_cpu1:trip:0\0/fragment@0/__overlay__/pm6150l-tz/cooling-maps/trip0_cpu2:trip:0\0/fragment@0/__overlay__/pm6150l-tz/cooling-maps/trip0_cpu3:trip:0\0/fragment@0/__overlay__/pm6150l-tz/cooling-maps/trip0_cpu4:trip:0\0/fragment@0/__overlay__/pm6150l-tz/cooling-maps/trip0_cpu5:trip:0\0/fragment@0/__overlay__/pm6150l-tz/cooling-maps/trip0_cpu6:trip:0\0/fragment@0/__overlay__/pm6150l-tz/cooling-maps/trip0_cpu7:trip:0";
		pm6150l_trip1 = "/fragment@0/__overlay__/pm6150l-tz/cooling-maps/trip1_cpu1:trip:0\0/fragment@0/__overlay__/pm6150l-tz/cooling-maps/trip1_cpu2:trip:0\0/fragment@0/__overlay__/pm6150l-tz/cooling-maps/trip1_cpu3:trip:0\0/fragment@0/__overlay__/pm6150l-tz/cooling-maps/trip1_cpu4:trip:0\0/fragment@0/__overlay__/pm6150l-tz/cooling-maps/trip1_cpu5:trip:0\0/fragment@0/__overlay__/pm6150l-tz/cooling-maps/trip1_cpu6:trip:0\0/fragment@0/__overlay__/pm6150l-tz/cooling-maps/trip1_cpu7:trip:0";
		pm6150l_vadc = "/fragment@14:target:0\0/fragment@15/__overlay__:io-channels:0\0/fragment@15/__overlay__:io-channels:8\0/fragment@15/__overlay__:io-channels:16\0/fragment@15/__overlay__:io-channels:24";
		q6core = "/fragment@31:target:0\0/fragment@33/__overlay__:qcom,msm_audio_ssr_devs:4\0/fragment@34:target:0";
		qupv3_se0_i2c = "/fragment@28:target:0";
		qupv3_se7_i2c = "/fragment@29:target:0";
		qusb_phy0 = "/fragment@25/__overlay__:dpdm-supply:0";
		sdc1_clk_off = "/fragment@20/__overlay__:pinctrl-1:0";
		sdc1_clk_on = "/fragment@20/__overlay__:pinctrl-0:0";
		sdc1_cmd_off = "/fragment@20/__overlay__:pinctrl-1:4";
		sdc1_cmd_on = "/fragment@20/__overlay__:pinctrl-0:4";
		sdc1_data_off = "/fragment@20/__overlay__:pinctrl-1:8";
		sdc1_data_on = "/fragment@20/__overlay__:pinctrl-0:8";
		sdc1_rclk_off = "/fragment@20/__overlay__:pinctrl-1:12";
		sdc1_rclk_on = "/fragment@20/__overlay__:pinctrl-0:12";
		sdc2_cd_off = "/fragment@21/__overlay__:pinctrl-1:12";
		sdc2_cd_on = "/fragment@21/__overlay__:pinctrl-0:12";
		sdc2_clk_off = "/fragment@21/__overlay__:pinctrl-1:0";
		sdc2_clk_on = "/fragment@21/__overlay__:pinctrl-0:0";
		sdc2_cmd_off = "/fragment@21/__overlay__:pinctrl-1:4";
		sdc2_cmd_on = "/fragment@21/__overlay__:pinctrl-0:4";
		sdc2_data_off = "/fragment@21/__overlay__:pinctrl-1:8";
		sdc2_data_on = "/fragment@21/__overlay__:pinctrl-0:8";
		sde_dp = "/fragment@11:target:0\0/fragment@30:target:0";
		sde_dp_usbplug_cc_active = "/fragment@11/__overlay__:pinctrl-0:0";
		sde_dp_usbplug_cc_suspend = "/fragment@11/__overlay__:pinctrl-1:0";
		sde_rscc = "/fragment@12/__overlay__:connectors:8";
		sde_te_active = "/fragment@10/__overlay__/qcom,dsi-display:pinctrl-0:0";
		sde_te_suspend = "/fragment@10/__overlay__/qcom,dsi-display:pinctrl-1:0";
		sdhc_1 = "/fragment@20:target:0";
		sdhc_2 = "/fragment@21:target:0";
		soc = "/fragment@10:target:0\0/fragment@13:target:0\0/fragment@27:target:0\0/fragment@35:target:0";
		soc_trip = "/fragment@0/__overlay__/soc/cooling-maps/soc_cpu6:trip:0\0/fragment@0/__overlay__/soc/cooling-maps/soc_cpu7:trip:0";
		spkr_1_sd_n_active = "/fragment@35/__overlay__/wsa_spkr_en1_pinctrl:pinctrl-0:0";
		spkr_1_sd_n_sleep = "/fragment@35/__overlay__/wsa_spkr_en1_pinctrl:pinctrl-1:0";
		spkr_2_sd_n_active = "/fragment@35/__overlay__/wsa_spkr_en2_pinctrl:pinctrl-0:0";
		spkr_2_sd_n_sleep = "/fragment@35/__overlay__/wsa_spkr_en2_pinctrl:pinctrl-1:0";
		stub_codec = "/fragment@33/__overlay__:asoc-codec:0";
		tert_i2s_data0_active = "/fragment@35/__overlay__/msm_cdc_pinctrl_pri:pinctrl-0:8";
		tert_i2s_data0_sleep = "/fragment@35/__overlay__/msm_cdc_pinctrl_pri:pinctrl-1:8";
		tert_i2s_data1_active = "/fragment@35/__overlay__/msm_cdc_pinctrl_pri:pinctrl-0:12";
		tert_i2s_data1_sleep = "/fragment@35/__overlay__/msm_cdc_pinctrl_pri:pinctrl-1:12";
		tert_i2s_sck_active = "/fragment@35/__overlay__/msm_cdc_pinctrl_pri:pinctrl-0:0";
		tert_i2s_sck_sleep = "/fragment@35/__overlay__/msm_cdc_pinctrl_pri:pinctrl-1:0";
		tert_i2s_ws_active = "/fragment@35/__overlay__/msm_cdc_pinctrl_pri:pinctrl-0:4";
		tert_i2s_ws_sleep = "/fragment@35/__overlay__/msm_cdc_pinctrl_pri:pinctrl-1:4";
		thermal_zones = "/fragment@0:target:0\0/fragment@22:target:0";
		tlmm = "/fragment@2/__overlay__/qcom,mdss_dsi_rm69299_visionox_amoled_video:qcom,platform-te-gpio:0\0/fragment@3/__overlay__/qcom,mdss_dsi_rm69299_visionox_amoled_cmd:qcom,platform-te-gpio:0\0/fragment@8/__overlay__/qcom,mdss_dsi_ft8756_huaxing_video:qcom,esd-err-int-gpio:0\0/fragment@9/__overlay__/qcom,mdss_dsi_nt36675_tianma_video:qcom,esd-err-int-gpio:0\0/fragment@10/__overlay__/qcom,dsi-display:qcom,platform-te-gpio:0\0/fragment@11/__overlay__:qcom,usbplug-cc-gpio:0\0/fragment@21/__overlay__:cd-gpios:0\0/fragment@28/__overlay__/nq@28:qcom,nq-irq:0\0/fragment@28/__overlay__/nq@28:qcom,nq-ven:0\0/fragment@28/__overlay__/nq@28:qcom,nq-firm:0\0/fragment@28/__overlay__/nq@28:qcom,nq-clkreq:0\0/fragment@28/__overlay__/nq@28:interrupt-parent:0\0/fragment@29/__overlay__/synaptics_tcm@20:interrupt-parent:0\0/fragment@29/__overlay__/synaptics_tcm@20:synaptics,irq-gpio:0\0/fragment@29/__overlay__/synaptics_tcm@20:synaptics,reset-gpio:0";
		ts_active = "/fragment@29/__overlay__/synaptics_tcm@20:pinctrl-0:0";
		ts_int_suspend = "/fragment@29/__overlay__/synaptics_tcm@20:pinctrl-1:0";
		ts_release = "/fragment@29/__overlay__/synaptics_tcm@20:pinctrl-2:0";
		ts_reset_suspend = "/fragment@29/__overlay__/synaptics_tcm@20:pinctrl-1:4";
		ufs_phy_gdsc = "/fragment@19/__overlay__:vdd-hba-supply:0";
		ufshc_mem = "/fragment@19:target:0";
		ufsphy_mem = "/fragment@18:target:0";
		usb0 = "/fragment@16:target:0";
		usb_qmp_dp_phy = "/fragment@17:target:0";
		va_cdc_dma_0_tx = "/fragment@36:target:0";
		wcd_reset_active = "/fragment@35/__overlay__/msm_cdc_pinctrl@58:pinctrl-0:0";
		wcd_reset_sleep = "/fragment@35/__overlay__/msm_cdc_pinctrl@58:pinctrl-1:0";
	};

	__local_fixups__ {

		fragment@10 {

			__overlay__ {

				qcom,dsi-display {
					qcom,dsi-display-list = <0x00 0x04>;
				};

				qcom,dsi-display@0 {
					qcom,dsi-panel = <0x00>;
				};

				qcom,dsi-display@1 {
					qcom,dsi-panel = <0x00>;
				};

				qcom,dsi-display@2 {
					qcom,dsi-panel = <0x00>;
				};

				qcom,dsi-display@3 {
					qcom,dsi-panel = <0x00>;
				};

				qcom,dsi-display@4 {
					qcom,dsi-panel = <0x00>;
				};

				qcom,dsi-display@5 {
					qcom,dsi-panel = <0x00>;
				};

				qcom,dsi-display@6 {
					qcom,dsi-panel = <0x00>;
				};

				qcom,dsi-display@7 {
					qcom,dsi-panel = <0x00>;
				};
			};
		};

		fragment@11 {

			__overlay__ {
				qcom,ext-disp = <0x00>;
			};
		};

		fragment@12 {

			__overlay__ {
				connectors = <0x00 0x04>;
			};
		};

		fragment@2 {

			__overlay__ {

				qcom,mdss_dsi_rm69299_visionox_amoled_video {
					qcom,panel-supply-entries = <0x00>;
				};
			};
		};

		fragment@24 {

			__overlay__ {
				qcom,battery-data = <0x00>;
			};
		};

		fragment@25 {

			__overlay__ {
				qcom,battery-data = <0x00>;
			};
		};

		fragment@27 {

			__overlay__ {

				gpio_keys {
					pinctrl-0 = <0x00>;
				};
			};
		};

		fragment@3 {

			__overlay__ {

				qcom,mdss_dsi_rm69299_visionox_amoled_cmd {
					qcom,panel-supply-entries = <0x00>;
				};
			};
		};

		fragment@32 {

			__overlay__ {

				bolero-clk-rsc-mngr {
					clocks = <0x00 0x08 0x10 0x18 0x20 0x28 0x30 0x38>;
				};

				rx-macro@62600000 {
					clocks = <0x00 0x08>;
					qcom,rx-swr-gpios = <0x00>;
				};

				tx-macro@62620000 {
					clocks = <0x00 0x08>;
					qcom,tx-swr-gpios = <0x00>;
				};

				wcd937x-codec {
					qcom,rx-slave = <0x00>;
					qcom,tx-slave = <0x00>;
					qcom,wcd-rst-gpio-node = <0x00>;
				};

				wcd938x-codec {
					qcom,rx-slave = <0x00>;
					qcom,tx-slave = <0x00>;
					qcom,wcd-rst-gpio-node = <0x00>;
				};

				wsa-macro@62640000 {
					clocks = <0x00 0x08>;
					qcom,wsa-swr-gpios = <0x00>;

					wsa_swr_master {

						wsa881x@20170211 {
							qcom,spkr-sd-n-node = <0x00>;
						};

						wsa881x@20170212 {
							qcom,spkr-sd-n-node = <0x00>;
						};

						wsa881x@21170213 {
							qcom,spkr-sd-n-node = <0x00>;
						};

						wsa881x@21170214 {
							qcom,spkr-sd-n-node = <0x00>;
						};
					};
				};
			};
		};

		fragment@33 {

			__overlay__ {
				asoc-codec = <0x08>;
				qcom,cdc-dmic01-gpios = <0x00>;
				qcom,cdc-dmic23-gpios = <0x00>;
				qcom,cdc-dmic45-gpios = <0x00>;
				qcom,codec-aux-devs = <0x00>;
				qcom,msm_audio_ssr_devs = <0x08>;
				qcom,tert-mi2s-gpios = <0x00>;
				qcom,wsa-devs = <0x00 0x04 0x08 0x0c>;
			};
		};

		fragment@34 {

			__overlay__ {

				cdc_dmic01_pinctrl {
					pinctrl-0 = <0x00 0x04>;
					pinctrl-1 = <0x00 0x04>;
				};

				cdc_dmic23_pinctrl {
					pinctrl-0 = <0x00 0x04>;
					pinctrl-1 = <0x00 0x04>;
				};

				cdc_dmic45_pinctrl {
					pinctrl-0 = <0x00 0x04>;
					pinctrl-1 = <0x00 0x04>;
				};

				msm_cdc_pinctrl_quin {
					pinctrl-0 = <0x00 0x04 0x08 0x0c>;
					pinctrl-1 = <0x00 0x04 0x08 0x0c>;
				};

				rx_swr_clk_data_pinctrl {
					pinctrl-0 = <0x00 0x04>;
					pinctrl-1 = <0x00 0x04>;
				};

				tx_swr_clk_data_pinctrl {
					pinctrl-0 = <0x00 0x04 0x08 0x0c>;
					pinctrl-1 = <0x00 0x04 0x08 0x0c>;
				};

				wsa_swr_clk_data_pinctrl {
					pinctrl-0 = <0x00 0x04>;
					pinctrl-1 = <0x00 0x04>;
				};
			};
		};

		fragment@4 {

			__overlay__ {

				qcom,mdss_dsi_sim_video {
					qcom,panel-supply-entries = <0x00>;
				};
			};
		};

		fragment@5 {

			__overlay__ {

				qcom,mdss_dsi_sim_cmd {
					qcom,panel-supply-entries = <0x00>;
				};
			};
		};

		fragment@6 {

			__overlay__ {

				qcom,mdss_dsi_sim_dsc_375_cmd {
					qcom,panel-supply-entries = <0x00>;
				};
			};
		};
	};

	__symbols__ {
		cdc_dmic01_clk_active = "/fragment@31/__overlay__/lpi_pinctrl@627C0000/dmic01_clk_active";
		cdc_dmic01_clk_sleep = "/fragment@31/__overlay__/lpi_pinctrl@627C0000/dmic01_clk_sleep";
		cdc_dmic01_data_active = "/fragment@31/__overlay__/lpi_pinctrl@627C0000/dmic01_data_active";
		cdc_dmic01_data_sleep = "/fragment@31/__overlay__/lpi_pinctrl@627C0000/dmic01_data_sleep";
		cdc_dmic01_gpios = "/fragment@34/__overlay__/cdc_dmic01_pinctrl";
		cdc_dmic23_clk_active = "/fragment@31/__overlay__/lpi_pinctrl@627C0000/dmic23_clk_active";
		cdc_dmic23_clk_sleep = "/fragment@31/__overlay__/lpi_pinctrl@627C0000/dmic23_clk_sleep";
		cdc_dmic23_data_active = "/fragment@31/__overlay__/lpi_pinctrl@627C0000/dmic23_data_active";
		cdc_dmic23_data_sleep = "/fragment@31/__overlay__/lpi_pinctrl@627C0000/dmic23_data_sleep";
		cdc_dmic23_gpios = "/fragment@34/__overlay__/cdc_dmic23_pinctrl";
		cdc_dmic45_clk_active = "/fragment@31/__overlay__/lpi_pinctrl@627C0000/dmic45_clk_active";
		cdc_dmic45_clk_sleep = "/fragment@31/__overlay__/lpi_pinctrl@627C0000/dmic45_clk_sleep";
		cdc_dmic45_data_active = "/fragment@31/__overlay__/lpi_pinctrl@627C0000/dmic45_data_active";
		cdc_dmic45_data_sleep = "/fragment@31/__overlay__/lpi_pinctrl@627C0000/dmic45_data_sleep";
		cdc_dmic45_gpios = "/fragment@34/__overlay__/cdc_dmic45_pinctrl";
		cdc_quin_mi2s_gpios = "/fragment@34/__overlay__/msm_cdc_pinctrl_quin";
		cdc_tert_mi2s_gpios = "/fragment@35/__overlay__/msm_cdc_pinctrl_pri";
		clock_audio_rx_1 = "/fragment@35/__overlay__/rx_core_clk";
		clock_audio_rx_2 = "/fragment@35/__overlay__/rx_npl_clk";
		clock_audio_tx_1 = "/fragment@35/__overlay__/tx_core_clk";
		clock_audio_tx_2 = "/fragment@35/__overlay__/tx_npl_clk";
		clock_audio_va_1 = "/fragment@35/__overlay__/va_core_clk";
		clock_audio_va_2 = "/fragment@35/__overlay__/va_npl_clk";
		clock_audio_wsa_1 = "/fragment@35/__overlay__/wsa_core_clk";
		clock_audio_wsa_2 = "/fragment@35/__overlay__/wsa_npl_clk";
		dsi_ft8756_huaxing_vid_display = "/fragment@10/__overlay__/qcom,dsi-display@6";
		dsi_ft8756_huaxing_video = "/fragment@8/__overlay__/qcom,mdss_dsi_ft8756_huaxing_video";
		dsi_nt36672c_video = "/fragment@7/__overlay__/qcom,mdss_dsi_nt36672c_video";
		dsi_nt36672c_video_display = "/fragment@10/__overlay__/qcom,dsi-display@5";
		dsi_nt36675_tianma_vid_display = "/fragment@10/__overlay__/qcom,dsi-display@7";
		dsi_nt36675_tianma_video = "/fragment@9/__overlay__/qcom,mdss_dsi_nt36675_tianma_video";
		dsi_panel_pwr_supply = "/fragment@10/__overlay__/dsi_panel_pwr_supply";
		dsi_panel_pwr_supply_labibb_amoled = "/fragment@10/__overlay__/dsi_panel_pwr_supply_labibb_amoled";
		dsi_panel_pwr_supply_no_labibb = "/fragment@10/__overlay__/dsi_panel_pwr_supply_no_labibb";
		dsi_rm69299_visionox_amoled_cmd = "/fragment@3/__overlay__/qcom,mdss_dsi_rm69299_visionox_amoled_cmd";
		dsi_rm69299_visionox_amoled_cmd_display = "/fragment@10/__overlay__/qcom,dsi-display@1";
		dsi_rm69299_visionox_amoled_vid_display = "/fragment@10/__overlay__/qcom,dsi-display@0";
		dsi_rm69299_visionox_amoled_video = "/fragment@2/__overlay__/qcom,mdss_dsi_rm69299_visionox_amoled_video";
		dsi_sim_cmd = "/fragment@5/__overlay__/qcom,mdss_dsi_sim_cmd";
		dsi_sim_cmd_display = "/fragment@10/__overlay__/qcom,dsi-display@3";
		dsi_sim_dsc_375_cmd = "/fragment@6/__overlay__/qcom,mdss_dsi_sim_dsc_375_cmd";
		dsi_sim_dsc_375_cmd_display = "/fragment@10/__overlay__/qcom,dsi-display@4";
		dsi_sim_vid = "/fragment@4/__overlay__/qcom,mdss_dsi_sim_video";
		dsi_sim_vid_display = "/fragment@10/__overlay__/qcom,dsi-display@2";
		ext_disp = "/fragment@10/__overlay__/qcom,msm-ext-disp";
		ext_disp_audio_codec = "/fragment@10/__overlay__/qcom,msm-ext-disp/qcom,msm-ext-disp-audio-codec-rx";
		key_vol_up_default = "/fragment@26/__overlay__/key_vol_up/key_vol_up_default";
		lpi_tlmm = "/fragment@31/__overlay__/lpi_pinctrl@627C0000";
		mtp_batterydata = "/fragment@13/__overlay__/qcom,battery-data";
		quin_mi2s_sck_active = "/fragment@31/__overlay__/lpi_pinctrl@627C0000/quin_mi2s_sck_active";
		quin_mi2s_sck_sleep = "/fragment@31/__overlay__/lpi_pinctrl@627C0000/quin_mi2s_sck_sleep";
		quin_mi2s_sd0_active = "/fragment@31/__overlay__/lpi_pinctrl@627C0000/quin_mi2s_sd0_active";
		quin_mi2s_sd0_sleep = "/fragment@31/__overlay__/lpi_pinctrl@627C0000/quin_mi2s_sd0_sleep";
		quin_mi2s_sd1_active = "/fragment@31/__overlay__/lpi_pinctrl@627C0000/quin_mi2s_sd1_active";
		quin_mi2s_sd1_sleep = "/fragment@31/__overlay__/lpi_pinctrl@627C0000/quin_mi2s_sd1_sleep";
		quin_mi2s_ws_active = "/fragment@31/__overlay__/lpi_pinctrl@627C0000/quin_mi2s_ws_active";
		quin_mi2s_ws_sleep = "/fragment@31/__overlay__/lpi_pinctrl@627C0000/quin_mi2s_ws_sleep";
		rx_macro = "/fragment@32/__overlay__/rx-macro@62600000";
		rx_swr_clk_active = "/fragment@31/__overlay__/lpi_pinctrl@627C0000/rx_swr_clk_active";
		rx_swr_clk_sleep = "/fragment@31/__overlay__/lpi_pinctrl@627C0000/rx_swr_clk_sleep";
		rx_swr_data_active = "/fragment@31/__overlay__/lpi_pinctrl@627C0000/rx_swr_data_active";
		rx_swr_data_sleep = "/fragment@31/__overlay__/lpi_pinctrl@627C0000/rx_swr_data_sleep";
		rx_swr_gpios = "/fragment@34/__overlay__/rx_swr_clk_data_pinctrl";
		sde_dsi = "/fragment@10/__overlay__/qcom,dsi-display";
		sde_wb = "/fragment@10/__overlay__/qcom,wb-display@0";
		swr0 = "/fragment@32/__overlay__/wsa-macro@62640000/wsa_swr_master";
		swr1 = "/fragment@32/__overlay__/rx-macro@62600000/rx_swr_master";
		swr2 = "/fragment@32/__overlay__/tx-macro@62620000/tx_swr_master";
		tx_macro = "/fragment@32/__overlay__/tx-macro@62620000";
		tx_swr_clk_active = "/fragment@31/__overlay__/lpi_pinctrl@627C0000/tx_swr_clk_active";
		tx_swr_clk_sleep = "/fragment@31/__overlay__/lpi_pinctrl@627C0000/tx_swr_clk_sleep";
		tx_swr_data0_active = "/fragment@31/__overlay__/lpi_pinctrl@627C0000/tx_swr_data0_active";
		tx_swr_data0_sleep = "/fragment@31/__overlay__/lpi_pinctrl@627C0000/tx_swr_data0_sleep";
		tx_swr_data1_active = "/fragment@31/__overlay__/lpi_pinctrl@627C0000/tx_swr_data1_active";
		tx_swr_data1_sleep = "/fragment@31/__overlay__/lpi_pinctrl@627C0000/tx_swr_data1_sleep";
		tx_swr_data2_active = "/fragment@31/__overlay__/lpi_pinctrl@627C0000/tx_swr_data2_active";
		tx_swr_data2_sleep = "/fragment@31/__overlay__/lpi_pinctrl@627C0000/tx_swr_data2_sleep";
		tx_swr_gpios = "/fragment@34/__overlay__/tx_swr_clk_data_pinctrl";
		va_macro = "/fragment@32/__overlay__/va-macro@62770000";
		wcd937x_codec = "/fragment@32/__overlay__/wcd937x-codec";
		wcd937x_rx_slave = "/fragment@32/__overlay__/rx-macro@62600000/rx_swr_master/wcd937x-rx-slave";
		wcd937x_tx_slave = "/fragment@32/__overlay__/tx-macro@62620000/tx_swr_master/wcd937x-tx-slave";
		wcd938x_codec = "/fragment@32/__overlay__/wcd938x-codec";
		wcd938x_rx_slave = "/fragment@32/__overlay__/rx-macro@62600000/rx_swr_master/wcd938x-rx-slave";
		wcd938x_tx_slave = "/fragment@32/__overlay__/tx-macro@62620000/tx_swr_master/wcd938x-tx-slave";
		wcd_rst_gpio = "/fragment@35/__overlay__/msm_cdc_pinctrl@58";
		wsa881x_0211 = "/fragment@32/__overlay__/wsa-macro@62640000/wsa_swr_master/wsa881x@20170211";
		wsa881x_0212 = "/fragment@32/__overlay__/wsa-macro@62640000/wsa_swr_master/wsa881x@20170212";
		wsa881x_0213 = "/fragment@32/__overlay__/wsa-macro@62640000/wsa_swr_master/wsa881x@21170213";
		wsa881x_0214 = "/fragment@32/__overlay__/wsa-macro@62640000/wsa_swr_master/wsa881x@21170214";
		wsa_macro = "/fragment@32/__overlay__/wsa-macro@62640000";
		wsa_spkr_en1 = "/fragment@35/__overlay__/wsa_spkr_en1_pinctrl";
		wsa_spkr_en2 = "/fragment@35/__overlay__/wsa_spkr_en2_pinctrl";
		wsa_swr_clk_active = "/fragment@31/__overlay__/lpi_pinctrl@627C0000/wsa_swr_clk_active";
		wsa_swr_clk_sleep = "/fragment@31/__overlay__/lpi_pinctrl@627C0000/wsa_swr_clk_sleep";
		wsa_swr_data_active = "/fragment@31/__overlay__/lpi_pinctrl@627C0000/wsa_swr_data_active";
		wsa_swr_data_sleep = "/fragment@31/__overlay__/lpi_pinctrl@627C0000/wsa_swr_data_sleep";
		wsa_swr_gpios = "/fragment@34/__overlay__/wsa_swr_clk_data_pinctrl";
	};

	fragment@0 {
		target = <0xffffffff>;

		__overlay__ {

			pm6150-bcl-lvl0 {

				cooling-maps {

					vbat_cpu6 {
						cooling-device = <0xffffffff 0xfffffffe 0xfffffffe>;
						trip = <0xffffffff>;
					};

					vbat_cpu7 {
						cooling-device = <0xffffffff 0xfffffffe 0xfffffffe>;
						trip = <0xffffffff>;
					};
				};
			};

			pm6150-bcl-lvl1 {

				cooling-maps {

					ibat_cpu6 {
						cooling-device = <0xffffffff 0xfffffffe 0xfffffffe>;
						trip = <0xffffffff>;
					};

					ibat_cpu7 {
						cooling-device = <0xffffffff 0xfffffffe 0xfffffffe>;
						trip = <0xffffffff>;
					};
				};
			};

			pm6150-bcl-lvl2 {

				cooling-maps {

					ibat_cpu6 {
						cooling-device = <0xffffffff 0xfffffffe 0xfffffffe>;
						trip = <0xffffffff>;
					};

					ibat_cpu7 {
						cooling-device = <0xffffffff 0xfffffffe 0xfffffffe>;
						trip = <0xffffffff>;
					};
				};
			};

			pm6150-tz {

				cooling-maps {

					trip0_bat {
						cooling-device = <0xffffffff 0xfffffffd 0xfffffffd>;
						trip = <0xffffffff>;
					};

					trip1_bat {
						cooling-device = <0xffffffff 0xfffffffe 0xfffffffe>;
						trip = <0xffffffff>;
					};
				};
			};

			pm6150l-tz {

				cooling-maps {

					trip0_cpu0 {
						cooling-device = <0xffffffff 0xfffffffd 0xfffffffd>;
						trip = <0xffffffff>;
					};

					trip0_cpu1 {
						cooling-device = <0xffffffff 0xfffffffd 0xfffffffd>;
						trip = <0xffffffff>;
					};

					trip0_cpu2 {
						cooling-device = <0xffffffff 0xfffffffd 0xfffffffd>;
						trip = <0xffffffff>;
					};

					trip0_cpu3 {
						cooling-device = <0xffffffff 0xfffffffd 0xfffffffd>;
						trip = <0xffffffff>;
					};

					trip0_cpu4 {
						cooling-device = <0xffffffff 0xfffffffd 0xfffffffd>;
						trip = <0xffffffff>;
					};

					trip0_cpu5 {
						cooling-device = <0xffffffff 0xfffffffd 0xfffffffd>;
						trip = <0xffffffff>;
					};

					trip0_cpu6 {
						cooling-device = <0xffffffff 0xfffffffd 0xfffffffd>;
						trip = <0xffffffff>;
					};

					trip0_cpu7 {
						cooling-device = <0xffffffff 0xfffffffd 0xfffffffd>;
						trip = <0xffffffff>;
					};

					trip1_cpu1 {
						cooling-device = <0xffffffff 0xfffffffe 0xfffffffe>;
						trip = <0xffffffff>;
					};

					trip1_cpu2 {
						cooling-device = <0xffffffff 0xfffffffe 0xfffffffe>;
						trip = <0xffffffff>;
					};

					trip1_cpu3 {
						cooling-device = <0xffffffff 0xfffffffe 0xfffffffe>;
						trip = <0xffffffff>;
					};

					trip1_cpu4 {
						cooling-device = <0xffffffff 0xfffffffe 0xfffffffe>;
						trip = <0xffffffff>;
					};

					trip1_cpu5 {
						cooling-device = <0xffffffff 0xfffffffe 0xfffffffe>;
						trip = <0xffffffff>;
					};

					trip1_cpu6 {
						cooling-device = <0xffffffff 0xfffffffe 0xfffffffe>;
						trip = <0xffffffff>;
					};

					trip1_cpu7 {
						cooling-device = <0xffffffff 0xfffffffe 0xfffffffe>;
						trip = <0xffffffff>;
					};
				};
			};

			soc {

				cooling-maps {

					soc_cpu6 {
						cooling-device = <0xffffffff 0xfffffffe 0xfffffffe>;
						trip = <0xffffffff>;
					};

					soc_cpu7 {
						cooling-device = <0xffffffff 0xfffffffe 0xfffffffe>;
						trip = <0xffffffff>;
					};
				};
			};
		};
	};

	fragment@1 {
		target = <0xffffffff>;

		__overlay__ {
			#cooling-cells = <0x02>;
		};
	};

	fragment@10 {
		target = <0xffffffff>;

		__overlay__ {

			dsi_panel_pwr_supply {
				#address-cells = <0x01>;
				#size-cells = <0x00>;
				phandle = <0x53>;

				qcom,panel-supply-entry@0 {
					qcom,supply-disable-load = <0x50>;
					qcom,supply-enable-load = <0x7d00>;
					qcom,supply-max-voltage = <0x1d0d80>;
					qcom,supply-min-voltage = <0x1b7740>;
					qcom,supply-name = "vddio";
					qcom,supply-post-on-sleep = <0x01>;
					qcom,supply-pre-off-sleep = <0x0f>;
					reg = <0x00>;
				};

				qcom,panel-supply-entry@1 {
					qcom,supply-disable-load = <0x64>;
					qcom,supply-enable-load = <0x186a0>;
					qcom,supply-max-voltage = <0x5b8d80>;
					qcom,supply-min-voltage = <0x4630c0>;
					qcom,supply-name = "lab";
					qcom,supply-post-on-sleep = <0x03>;
					qcom,supply-pre-off-sleep = <0x0a>;
					reg = <0x01>;
				};

				qcom,panel-supply-entry@2 {
					qcom,supply-disable-load = <0x64>;
					qcom,supply-enable-load = <0x186a0>;
					qcom,supply-max-voltage = <0x5b8d80>;
					qcom,supply-min-voltage = <0x4630c0>;
					qcom,supply-name = "ibb";
					qcom,supply-pre-off-sleep = <0x04>;
					reg = <0x02>;
				};
			};

			dsi_panel_pwr_supply_labibb_amoled {
				#address-cells = <0x01>;
				#size-cells = <0x00>;
				phandle = <0x01>;

				qcom,panel-supply-entry@0 {
					qcom,supply-disable-load = <0x50>;
					qcom,supply-enable-load = <0x7d00>;
					qcom,supply-max-voltage = <0x1d0d80>;
					qcom,supply-min-voltage = <0x1b7740>;
					qcom,supply-name = "vddio";
					reg = <0x00>;
				};

				qcom,panel-supply-entry@1 {
					qcom,supply-disable-load = <0x50>;
					qcom,supply-enable-load = <0x3390>;
					qcom,supply-max-voltage = <0x2dc6c0>;
					qcom,supply-min-voltage = <0x2dc6c0>;
					qcom,supply-name = "vdda-3p3";
					reg = <0x01>;
				};
			};

			dsi_panel_pwr_supply_no_labibb {
				#address-cells = <0x01>;
				#size-cells = <0x00>;
				phandle = <0x02>;

				qcom,panel-supply-entry@0 {
					qcom,supply-disable-load = <0x50>;
					qcom,supply-enable-load = <0x7d00>;
					qcom,supply-max-voltage = <0x1d0d80>;
					qcom,supply-min-voltage = <0x1b7740>;
					qcom,supply-name = "vddio";
					reg = <0x00>;
				};
			};

			qcom,dsi-display {
				clock-names = "mux_byte_clk0\0mux_pixel_clk0\0src_byte_clk0\0src_pixel_clk0\0cphy_byte_clk0\0cphy_pixel_clk0\0shadow_byte_clk0\0shadow_pixel_clk0\0shadow_cphybyte_clk0\0shadow_cphypixel_clk0";
				clocks = <0xffffffff 0x06 0xffffffff 0x09 0xffffffff 0x03 0xffffffff 0x08 0xffffffff 0x0a 0xffffffff 0x0d 0xffffffff 0x11 0xffffffff 0x15 0xffffffff 0x16 0xffffffff 0x19>;
				compatible = "qcom,dsi-display";
				ibb-supply = <0xffffffff>;
				lab-supply = <0xffffffff>;
				phandle = <0x0f>;
				pinctrl-0 = <0xffffffff 0xffffffff>;
				pinctrl-1 = <0xffffffff>;
				pinctrl-names = "panel_active\0panel_suspend";
				qcom,dsi-ctrl = <0xffffffff>;
				qcom,dsi-display-list = <0x0b 0x0c>;
				qcom,dsi-phy = <0xffffffff>;
				qcom,panel-te-source = <0x00>;
				qcom,platform-reset-gpio = <0xffffffff 0x03 0x00>;
				qcom,platform-te-gpio = <0xffffffff 0x0a 0x00>;
				vddio-supply = <0xffffffff>;
			};

			qcom,dsi-display@0 {
				label = "dsi_rm69299_visionox_amoled_vid_display";
				phandle = <0x54>;
				qcom,display-type = "primary";
				qcom,dsi-ctrl-num = <0x00>;
				qcom,dsi-display-active;
				qcom,dsi-panel = <0x03>;
				qcom,dsi-phy-num = <0x00>;
				qcom,dsi-select-clocks = "mux_byte_clk0\0mux_pixel_clk0\0src_byte_clk0\0src_pixel_clk0\0shadow_byte_clk0\0shadow_pixel_clk0";
			};

			qcom,dsi-display@1 {
				label = "dsi_rm69299_visionox_amoled_cmd_display";
				phandle = <0x55>;
				qcom,display-type = "primary";
				qcom,dsi-ctrl-num = <0x00>;
				qcom,dsi-panel = <0x04>;
				qcom,dsi-phy-num = <0x00>;
				qcom,dsi-select-clocks = "mux_byte_clk0\0mux_pixel_clk0";
			};

			qcom,dsi-display@2 {
				label = "dsi_sim_vid_display";
				phandle = <0x56>;
				qcom,display-type = "primary";
				qcom,dsi-ctrl-num = <0x00>;
				qcom,dsi-panel = <0x05>;
				qcom,dsi-phy-num = <0x00>;
				qcom,dsi-select-clocks = "mux_byte_clk0\0mux_pixel_clk0";
			};

			qcom,dsi-display@3 {
				label = "dsi_sim_cmd_display";
				phandle = <0x57>;
				qcom,display-type = "primary";
				qcom,dsi-ctrl-num = <0x00>;
				qcom,dsi-panel = <0x06>;
				qcom,dsi-phy-num = <0x00>;
				qcom,dsi-select-clocks = "mux_byte_clk0\0mux_pixel_clk0";
			};

			qcom,dsi-display@4 {
				label = "dsi_sim_dsc_375_cmd_display";
				phandle = <0x58>;
				qcom,display-type = "primary";
				qcom,dsi-ctrl-num = <0x00>;
				qcom,dsi-panel = <0x07>;
				qcom,dsi-phy-num = <0x00>;
				qcom,dsi-select-clocks = "mux_byte_clk0\0mux_pixel_clk0";
			};

			qcom,dsi-display@5 {
				label = "dsi_nt36672c_video_display";
				phandle = <0x59>;
				qcom,display-type = "primary";
				qcom,dsi-ctrl-num = <0x00>;
				qcom,dsi-panel = <0x08>;
				qcom,dsi-phy-num = <0x00>;
				qcom,dsi-select-clocks = "mux_byte_clk0\0mux_pixel_clk0\0cphy_byte_clk0\0cphy_pixel_clk0\0shadow_cphybyte_clk0\0shadow_cphypixel_clk0";
			};

			qcom,dsi-display@6 {
				label = "dsi_ft8756_huaxing_vid_display";
				phandle = <0x0b>;
				qcom,display-type = "primary";
				qcom,dsi-ctrl-num = <0x00>;
				qcom,dsi-panel = <0x09>;
				qcom,dsi-phy-num = <0x00>;
				qcom,dsi-select-clocks = "mux_byte_clk0\0mux_pixel_clk0\0src_byte_clk0\0src_pixel_clk0\0shadow_byte_clk0\0shadow_pixel_clk0";
			};

			qcom,dsi-display@7 {
				label = "dsi_nt36675_tianma_vid_display";
				phandle = <0x0c>;
				qcom,display-type = "primary";
				qcom,dsi-ctrl-num = <0x00>;
				qcom,dsi-panel = <0x0a>;
				qcom,dsi-phy-num = <0x00>;
				qcom,dsi-select-clocks = "mux_byte_clk0\0mux_pixel_clk0\0src_byte_clk0\0src_pixel_clk0\0shadow_byte_clk0\0shadow_pixel_clk0";
			};

			qcom,msm-ext-disp {
				compatible = "qcom,msm-ext-disp";
				phandle = <0x0d>;

				qcom,msm-ext-disp-audio-codec-rx {
					compatible = "qcom,msm-ext-disp-audio-codec-rx";
					phandle = <0x27>;
				};
			};

			qcom,wb-display@0 {
				cell-index = <0x00>;
				compatible = "qcom,wb-display";
				label = "wb_display";
				phandle = <0x0e>;
			};
		};
	};

	fragment@11 {
		target = <0xffffffff>;

		__overlay__ {
			pinctrl-0 = <0xffffffff>;
			pinctrl-1 = <0xffffffff>;
			pinctrl-name = "mdss_dp_active\0mdss_dp_sleep";
			qcom,dp-usbpd-detection = <0xffffffff>;
			qcom,ext-disp = <0x0d>;
			qcom,usbplug-cc-gpio = <0xffffffff 0x68 0x00>;
			status = "disabled";
		};
	};

	fragment@12 {
		target = <0xffffffff>;

		__overlay__ {
			connectors = <0x0e 0x0f 0xffffffff>;
		};
	};

	fragment@13 {
		target = <0xffffffff>;

		__overlay__ {

			qcom,battery-data {
				phandle = <0x10>;
				qcom,batt-id-range-pct = <0x0f>;

				qcom,alium_860_89032_0000_3600mAh {
					qcom,batt-id-kohm = <0x6b>;
					qcom,battery-beta = <0x109a>;
					qcom,battery-therm-kohm = <0x64>;
					qcom,battery-type = "Alium_860_89032_0000_3600mAh_Jun15th2018";
					qcom,fastchg-current-ma = <0x1518>;
					qcom,fg-cc-cv-threshold-uv = <0x423920>;
					qcom,jeita-fcc-ranges = <0x00 0x32 0x2625a0 0x33 0x190 0x5265c0 0x191 0x1c2 0x2625a0>;
					qcom,jeita-fv-ranges = <0x00 0x32 0x40d990 0x33 0x190 0x426030 0x191 0x1c2 0x40d990>;
					qcom,jeita-hard-thresholds = <0x58cd 0x20b8>;
					qcom,jeita-soft-fcc-ua = <0x2625a0 0x2625a0>;
					qcom,jeita-soft-fv-uv = <0x40d990 0x40d990>;
					qcom,jeita-soft-hys-thresholds = <0x4f5e 0x2943>;
					qcom,jeita-soft-thresholds = <0x5314 0x25e3>;
					qcom,max-voltage-uv = <0x426030>;
					qcom,ocv-based-step-chg;
					qcom,qg-batt-profile-ver = <0x64>;
					qcom,step-chg-ranges = <0x36ee80 0x39fbc0 0x5265c0 0x39fbc1 0x419ce0 0x36ee80 0x419ce1 0x426030 0x2625a0>;

					qcom,fcc1-temp-lut {
						qcom,lut-col-legend = <0x00 0x0a 0x19 0x28 0x32>;
						qcom,lut-data = <0xd62 0xdbf 0xdfd 0xe1d 0xe2e>;
					};

					qcom,fcc2-temp-lut {
						qcom,lut-col-legend = <0xfffffff6 0x00 0x0a 0x19 0x28 0x32>;
						qcom,lut-data = <0xdda 0xdf8 0xe02 0xe04 0xdff 0xdff>;
					};

					qcom,pc-temp-v1-lut {
						qcom,lut-col-legend = <0x00 0x0a 0x19 0x28 0x32>;
						qcom,lut-data = <0xa846 0xa903 0xa965 0xa982 0xa987 0xa757 0xa82c 0xa88b 0xa8b2 0xa8bc 0xa671 0xa747 0xa7a8 0xa7d4 0xa7e5 0xa598 0xa65f 0xa6c5 0xa6f2 0xa707 0xa4ca 0xa582 0xa5e5 0xa611 0xa627 0xa3ff 0xa4af 0xa508 0xa531 0xa546 0xa330 0xa3e1 0xa430 0xa452 0xa465 0xa25d 0xa311 0xa35c 0xa377 0xa387 0xa1a0 0xa23e 0xa287 0xa29e 0xa2ad 0xa10a 0xa17a 0xa1b1 0xa1c4 0xa1d2 0xa07e 0xa0e5 0xa0f6 0xa0f5 0xa0fc 0x9fa9 0xa061 0xa067 0xa048 0xa036 0x9e4b 0x9f9a 0x9fd6 0x9fae 0x9f81 0x9cdb 0x9e3d 0x9ee8 0x9ee6 0x9ebf 0x9bed 0x9cd1 0x9d85 0x9dc6 0x9dd7 0x9b4d 0x9bf5 0x9c67 0x9cb4 0x9cf4 0x9ad6 0x9b65 0x9bd6 0x9c18 0x9c4a 0x9a75 0x9af5 0x9b63 0x9baa 0x9bc5 0x9a1f 0x9a9b 0x9ade 0x9b13 0x9b23 0x99c4 0x9a41 0x9a3f 0x9a2d 0x9a41 0x9962 0x99c6 0x998a 0x9943 0x9959 0x98fd 0x992a 0x98b8 0x9892 0x98a0 0x9894 0x9882 0x97f4 0x9800 0x9807 0x982b 0x97c6 0x976f 0x9780 0x9781 0x97cb 0x9713 0x970f 0x970c 0x970c 0x9775 0x9697 0x96b5 0x96a2 0x96a2 0x9724 0x963e 0x965a 0x9642 0x963e 0x96db 0x95fa 0x9603 0x95e9 0x95e1 0x9698 0x95c7 0x95b7 0x9598 0x958b 0x965b 0x959d 0x9571 0x954e 0x953b 0x9627 0x9575 0x9533 0x950c 0x94f4 0x95f8 0x9550 0x94fe 0x94d1 0x94b3 0x95cc 0x952e 0x94cf 0x949b 0x947a 0x95a2 0x9511 0x94a4 0x9465 0x9440 0x9579 0x94f7 0x947f 0x9432 0x9407 0x954f 0x94d6 0x9458 0x93fe 0x93cc 0x9525 0x94b2 0x942f 0x93c6 0x938b 0x94f0 0x9484 0x9402 0x938b 0x9345 0x94a6 0x943e 0x93bf 0x9343 0x92f7 0x944c 0x93da 0x935f 0x92ed 0x92a2 0x93e6 0x936c 0x92f1 0x9288 0x923f 0x936b 0x92f1 0x9276 0x920e 0x91c6 0x92e1 0x926f 0x91f1 0x9188 0x9141 0x9248 0x91ea 0x9165 0x90ff 0x90bc 0x91cf 0x9176 0x9100 0x909b 0x905b 0x9179 0x9129 0x90c1 0x9060 0x9022 0x9159 0x910e 0x90ab 0x904f 0x9011 0x913e 0x90f9 0x909a 0x903f 0x9001 0x911a 0x90de 0x907f 0x9020 0x8fdd 0x90ac 0x9070 0x8ff7 0x8f74 0x8f1a 0x8f68 0x8f1c 0x8e9e 0x8e14 0x8db6 0x8d9d 0x8d55 0x8cd8 0x8c4c 0x8beb 0x8b59 0x8b10 0x8a94 0x8a02 0x899f 0x8849 0x87fb 0x877d 0x86e5 0x867d 0x836c 0x8325 0x82aa 0x8209 0x8197 0x7530 0x7530 0x7530 0x7530 0x7530>;
						qcom,lut-row-legend = <0x2710 0x2648 0x2580 0x24b8 0x23f0 0x2328 0x2260 0x2198 0x20d0 0x2008 0x1f40 0x1e78 0x1db0 0x1ce8 0x1c20 0x1b58 0x1a90 0x19c8 0x1900 0x1838 0x1770 0x16a8 0x15e0 0x1518 0x1450 0x1388 0x12c0 0x11f8 0x1130 0x1068 0xfa0 0xed8 0xe10 0xd48 0xc80 0xbb8 0xaf0 0xa28 0x960 0x898 0x7d0 0x708 0x640 0x578 0x4b0 0x3e8 0x384 0x320 0x2bc 0x258 0x1f4 0x190 0x12c 0xc8 0x64 0x00>;
					};

					qcom,pc-temp-v2-lut {
						qcom,lut-col-legend = <0xfffffff6 0x00 0x0a 0x19 0x28 0x32>;
						qcom,lut-data = <0xa98d 0xa97e 0xa974 0xa960 0xa92e 0xa910 0xa7fb 0xa83a 0xa854 0xa856 0xa82f 0xa819 0xa6a3 0xa712 0xa747 0xa757 0xa738 0xa728 0xa594 0xa609 0xa64d 0xa665 0xa64a 0xa63c 0xa4c7 0xa51d 0xa566 0xa581 0xa565 0xa558 0xa3f4 0xa43e 0xa489 0xa4a2 0xa484 0xa478 0xa2af 0xa364 0xa3b3 0xa3c8 0xa3a5 0xa397 0xa162 0xa292 0xa2e4 0xa2f3 0xa2ca 0xa2b9 0xa11a 0xa1c1 0xa210 0xa21b 0xa1ef 0xa1de 0xa14f 0xa0ea 0xa131 0xa139 0xa110 0xa103 0xa17a 0xa03c 0xa071 0xa077 0xa047 0xa035 0xa046 0x9fd6 0x9ff5 0x9ff5 0x9fb3 0x9f87 0x9d6d 0x9f7f 0x9f85 0x9f81 0x9f2b 0x9ee2 0x9b88 0x9eab 0x9ea9 0x9ead 0x9e5e 0x9e1a 0x9a81 0x9c78 0x9cde 0x9d1e 0x9d16 0x9d22 0x99b8 0x9a96 0x9b46 0x9bd5 0x9bfe 0x9c3f 0x9913 0x99e8 0x9a78 0x9b4d 0x9b70 0x9b9c 0x9887 0x9977 0x99df 0x9aeb 0x9b04 0x9b0e 0x97f7 0x98f2 0x9948 0x9a53 0x9a64 0x9a58 0x975c 0x9856 0x98b5 0x9965 0x9971 0x9967 0x96c8 0x97b8 0x9827 0x987f 0x9885 0x9883 0x9649 0x9720 0x9799 0x97d3 0x97d8 0x97d6 0x95d8 0x968d 0x9711 0x9743 0x9748 0x9745 0x957d 0x9608 0x9697 0x96c6 0x96cb 0x96c8 0x9533 0x9591 0x9629 0x9658 0x965c 0x9658 0x94f4 0x952a 0x95c3 0x95f3 0x95f6 0x95f1 0x94bc 0x94d6 0x9565 0x9595 0x9598 0x9592 0x948a 0x9491 0x950e 0x953e 0x9540 0x9538 0x9458 0x9459 0x94bd 0x94f0 0x94ef 0x94e6 0x9429 0x942b 0x9471 0x94aa 0x94a5 0x949b 0x93fa 0x9403 0x942c 0x9467 0x9461 0x9456 0x93cb 0x93dc 0x93ed 0x9426 0x9422 0x9418 0x939a 0x93b7 0x93b6 0x93e7 0x93e7 0x93dd 0x9366 0x9390 0x9384 0x93a6 0x93a1 0x9392 0x9330 0x9367 0x935a 0x9364 0x9348 0x932b 0x92f5 0x933c 0x9330 0x9322 0x92ea 0x92bd 0x92b6 0x9309 0x9301 0x92e2 0x9296 0x925d 0x9274 0x92ce 0x92cf 0x92a2 0x9248 0x9208 0x922d 0x9289 0x9294 0x925e 0x91fe 0x91bc 0x91e4 0x9235 0x924a 0x9214 0x91b6 0x9173 0x919a 0x91d4 0x91f2 0x91c0 0x9166 0x9124 0x9151 0x916d 0x918d 0x9158 0x9101 0x90c0 0x910a 0x9104 0x9119 0x90da 0x9085 0x9045 0x90be 0x90a5 0x90a4 0x9064 0x9011 0x8fd4 0x9066 0x9055 0x9058 0x9026 0x8fde 0x8fa3 0x8ff1 0x9009 0x9027 0x900b 0x8fc1 0x8f87 0x8fa0 0x8fd7 0x9010 0x8ff6 0x8fb0 0x8f76 0x8f3a 0x8f9b 0x8ff2 0x8fd7 0x8f94 0x8f5b 0x8e9d 0x8f3c 0x8fa7 0x8f84 0x8f3f 0x8efc 0x8dbc 0x8e73 0x8ecd 0x8e86 0x8e46 0x8df2 0x8c72 0x8d0b 0x8d41 0x8ce7 0x8ca5 0x8c4f 0x8a95 0x8b0d 0x8b2a 0x8ad3 0x8a9a 0x8a45 0x87f8 0x8865 0x887d 0x881c 0x87ec 0x879d 0x841a 0x8496 0x84d3 0x8488 0x847e 0x8426 0x7eca 0x7f24 0x801b 0x8028 0x7f97 0x7ef0 0x6fcb 0x6e6e 0x6d71 0x6d74 0x6d50 0x6d1a>;
						qcom,lut-row-legend = <0x2710 0x2648 0x2580 0x24b8 0x23f0 0x2328 0x2260 0x2198 0x20d0 0x2008 0x1f40 0x1e78 0x1db0 0x1ce8 0x1c20 0x1b58 0x1a90 0x19c8 0x1900 0x1838 0x1770 0x16a8 0x15e0 0x1518 0x1450 0x1388 0x12c0 0x11f8 0x1130 0x1068 0xfa0 0xed8 0xe10 0xd48 0xc80 0xbb8 0xaf0 0xa28 0x960 0x898 0x7d0 0x708 0x640 0x578 0x4b0 0x3e8 0x384 0x320 0x2bc 0x258 0x1f4 0x190 0x12c 0xc8 0x64 0x00>;
					};

					qcom,pc-temp-y1-lut {
						qcom,lut-col-legend = <0xfffffff6 0x00 0x0a 0x19 0x28 0x32>;
						qcom,lut-data = <0x1dae 0x1a6c 0x17b7 0x1540 0x1467 0x143b 0x1db4 0x1a6f 0x17c3 0x153f 0x1466 0x143d 0x1dc0 0x1a74 0x17ca 0x153e 0x1466 0x143e 0x1dcd 0x1a7a 0x17ce 0x153c 0x1466 0x1440 0x1dd8 0x1a7e 0x17d0 0x153b 0x1467 0x1441 0x1ddd 0x1a80 0x17d0 0x153a 0x1467 0x1443 0x1ddc 0x1a80 0x17cc 0x153a 0x1468 0x1443 0x1dda 0x1a80 0x17c6 0x153a 0x146a 0x1444 0x1dd3 0x1a7d 0x17c5 0x153b 0x146c 0x1445 0x1dbc 0x1a76 0x17c8 0x153c 0x146d 0x1446 0x1daa 0x1a70 0x17ca 0x153d 0x146f 0x1448 0x1db3 0x1a6e 0x17c6 0x153d 0x1470 0x1449 0x1dc8 0x1a6f 0x17c0 0x153d 0x1472 0x144b 0x1ddc 0x1a74 0x17c1 0x153e 0x1474 0x144d 0x1df4 0x1a85 0x17d0 0x1545 0x1479 0x1452 0x1e03 0x1a97 0x17db 0x154d 0x147c 0x1454 0x1dfa 0x1aa4 0x17df 0x154f 0x147c 0x1455 0x1de7 0x1aaf 0x17e3 0x1552 0x147d 0x1455 0x1dd8 0x1ab0 0x17e4 0x1554 0x147e 0x1456 0x1dca 0x1aa1 0x17e2 0x1555 0x1480 0x1459 0x1dc3 0x1a95 0x17e2 0x1558 0x1483 0x145c 0x1dd6 0x1a97 0x17ed 0x155c 0x1487 0x1460 0x1df9 0x1a9f 0x17fb 0x1560 0x148b 0x1463 0x1e01 0x1aa5 0x17fd 0x1565 0x148e 0x1467 0x1e00 0x1aa8 0x17f8 0x1569 0x1491 0x146a 0x1e04 0x1aac 0x17f7 0x156d 0x1493 0x146e 0x1e09 0x1ab8 0x1800 0x1571 0x1496 0x1472 0x1e0c 0x1acc 0x180b 0x1576 0x149a 0x1475 0x1e0a 0x1ad7 0x180e 0x157b 0x149d 0x1478 0x1df8 0x1adc 0x1812 0x1581 0x14a0 0x147a 0x1de0 0x1ade 0x1817 0x1586 0x14a3 0x147d 0x1dd9 0x1adb 0x181b 0x158b 0x14a7 0x1480 0x1ddb 0x1ad7 0x181f 0x1590 0x14aa 0x1484 0x1ddd 0x1ad7 0x1820 0x1593 0x14ad 0x1487 0x1de1 0x1ad5 0x1821 0x1596 0x14b0 0x1489 0x1de8 0x1ad3 0x1823 0x1599 0x14b2 0x148b 0x1df7 0x1adf 0x1827 0x159b 0x14b4 0x148c 0x1e0a 0x1aef 0x182c 0x159d 0x14b5 0x148d 0x1e0d 0x1aef 0x1831 0x159e 0x14b5 0x148e 0x1dff 0x1ae3 0x1835 0x159f 0x14b6 0x148e 0x1df5 0x1adf 0x183a 0x15a1 0x14b7 0x148f 0x1df6 0x1ae5 0x1841 0x15a5 0x14b9 0x1491 0x1df6 0x1aeb 0x184c 0x15a8 0x14ba 0x1492 0x1df6 0x1af2 0x1849 0x15aa 0x14bb 0x1493 0x1dfa 0x1af8 0x1850 0x15af 0x14be 0x1495 0x1e04 0x1b0b 0x1850 0x15b1 0x14be 0x1496 0x1e09 0x1b08 0x1859 0x15b4 0x14be 0x1496 0x1e26 0x1b0e 0x1863 0x15b4 0x14be 0x1496 0x1e37 0x1b0b 0x186b 0x15b6 0x14bf 0x1496 0x1e2c 0x1b1e 0x1867 0x15b9 0x14c2 0x1498 0x1e29 0x1b3f 0x1879 0x15c2 0x14c5 0x149b 0x1e38 0x1b5b 0x1895 0x15d1 0x14cc 0x14a0 0x1e61 0x1b5f 0x18a8 0x15e4 0x14d3 0x14a6 0x1eb6 0x1b7e 0x18ca 0x15f7 0x14dc 0x14ac 0x1eb6 0x1b7e 0x18ca 0x15f7 0x14dc 0x14ac 0x1eb6 0x1b7e 0x18ca 0x15f7 0x14dc 0x14ac>;
						qcom,lut-row-legend = <0x2710 0x2648 0x2580 0x24b8 0x23f0 0x2328 0x2260 0x2198 0x20d0 0x2008 0x1f40 0x1e78 0x1db0 0x1ce8 0x1c20 0x1b58 0x1a90 0x19c8 0x1900 0x1838 0x1770 0x16a8 0x15e0 0x1518 0x1450 0x1388 0x12c0 0x11f8 0x1130 0x1068 0xfa0 0xed8 0xe10 0xd48 0xc80 0xbb8 0xaf0 0xa28 0x960 0x898 0x7d0 0x708 0x640 0x578 0x4b0 0x3e8 0x384 0x320 0x2bc 0x258 0x1f4 0x190 0x12c 0xc8 0x64 0x00>;
					};

					qcom,pc-temp-y2-lut {
						qcom,lut-col-legend = <0xfffffff6 0x00 0x0a 0x19 0x28 0x32>;
						qcom,lut-data = <0x25d6 0x28a1 0x29b8 0x2b2a 0x2b60 0x2c89 0x2638 0x287f 0x299b 0x2b15 0x2b62 0x2c51 0x2674 0x286a 0x297a 0x2afb 0x2b61 0x2bfc 0x2693 0x285f 0x2959 0x2ade 0x2b5e 0x2ba2 0x269f 0x285b 0x293d 0x2abd 0x2b58 0x2b5a 0x26a2 0x285a 0x292b 0x2a9a 0x2b51 0x2b3c 0x266c 0x2867 0x2922 0x2a6d 0x2b48 0x2b43 0x260b 0x287d 0x291b 0x2a3f 0x2b3b 0x2b4e 0x25f2 0x2878 0x2916 0x2a29 0x2b28 0x2b4d 0x25fe 0x283e 0x2912 0x2a1c 0x2b09 0x2b3a 0x2615 0x2814 0x2910 0x2a13 0x2ae5 0x2b24 0x2698 0x2862 0x291a 0x2a04 0x2ab6 0x2afb 0x2784 0x28ea 0x2933 0x29f0 0x2a85 0x2ac3 0x27ba 0x2909 0x295a 0x29f2 0x2a7a 0x2abc 0x26d8 0x28f6 0x29a8 0x2a1d 0x2a90 0x2af0 0x2601 0x28e9 0x29e0 0x2a53 0x2ab0 0x2b19 0x25e5 0x28ff 0x29fa 0x2a91 0x2aec 0x2b1b 0x25de 0x2924 0x2a0e 0x2ad0 0x2b33 0x2b18 0x25d8 0x292d 0x2a1d 0x2aef 0x2b47 0x2b23 0x25d2 0x292c 0x2a2b 0x2afc 0x2b48 0x2b59 0x25cd 0x2929 0x2a36 0x2b0a 0x2b4a 0x2b9b 0x25ca 0x28f3 0x2a3f 0x2b29 0x2b78 0x2bd9 0x25c8 0x2849 0x2a48 0x2b54 0x2bc0 0x2c13 0x25c6 0x27d1 0x2a4b 0x2b74 0x2be2 0x2c3d 0x25c3 0x275f 0x2a50 0x2b8f 0x2bf6 0x2c5c 0x25c0 0x271c 0x2a54 0x2ba1 0x2c07 0x2c71 0x25bf 0x270e 0x2a52 0x2bac 0x2c19 0x2c83 0x25be 0x2700 0x2a4a 0x2bb0 0x2c2d 0x2c96 0x25bd 0x26ed 0x2a46 0x2ba7 0x2c35 0x2cb5 0x25bc 0x26d4 0x2a44 0x2b8e 0x2c41 0x2cec 0x25bb 0x26b9 0x2a3f 0x2b80 0x2c4d 0x2d11 0x25bb 0x26a1 0x29e9 0x2b83 0x2c40 0x2d02 0x25ba 0x268b 0x294e 0x2b8f 0x2c2f 0x2cda 0x25b9 0x2672 0x290b 0x2b9c 0x2c33 0x2cca 0x25b8 0x2655 0x28fa 0x2b99 0x2c39 0x2cd1 0x25b8 0x263a 0x28ee 0x2b84 0x2c35 0x2cd6 0x25b7 0x2622 0x28e6 0x2b68 0x2c34 0x2cdc 0x25b7 0x2604 0x290b 0x2b59 0x2c39 0x2ce8 0x25b6 0x25ec 0x293c 0x2b5f 0x2c3b 0x2ce7 0x25b6 0x25de 0x291d 0x2b60 0x2c36 0x2cd1 0x25b6 0x25d4 0x28ba 0x2b5f 0x2c32 0x2cc5 0x25b6 0x25cb 0x289c 0x2b62 0x2c34 0x2ccc 0x25b6 0x25c4 0x28a6 0x2b5d 0x2c32 0x2ccf 0x25b5 0x25be 0x281b 0x2b46 0x2c13 0x2cc8 0x25b5 0x25bb 0x27d7 0x2b34 0x2c13 0x2cb0 0x25b5 0x25bb 0x27c4 0x2b11 0x2c20 0x2c82 0x25b5 0x25ba 0x2810 0x2b0d 0x2c0a 0x2c51 0x25b5 0x25b9 0x2851 0x2b23 0x2be8 0x2c48 0x25b5 0x25b8 0x2853 0x2b28 0x2bef 0x2c50 0x25b4 0x25b8 0x2837 0x2ae6 0x2c1e 0x2c3a 0x25b4 0x25b6 0x2800 0x2acc 0x2bf7 0x2bfd 0x25b4 0x25b5 0x27bc 0x2aa1 0x2b7e 0x2ba7 0x25b4 0x25b4 0x2786 0x2a49 0x2b0f 0x2b35 0x25b2 0x25b4 0x2773 0x2a1c 0x2a4f 0x2a4a 0x25b2 0x25b4 0x2773 0x2a1c 0x2a4f 0x2a4a 0x25b2 0x25b4 0x2773 0x2a1c 0x2a4f 0x2a4a>;
						qcom,lut-row-legend = <0x2710 0x2648 0x2580 0x24b8 0x23f0 0x2328 0x2260 0x2198 0x20d0 0x2008 0x1f40 0x1e78 0x1db0 0x1ce8 0x1c20 0x1b58 0x1a90 0x19c8 0x1900 0x1838 0x1770 0x16a8 0x15e0 0x1518 0x1450 0x1388 0x12c0 0x11f8 0x1130 0x1068 0xfa0 0xed8 0xe10 0xd48 0xc80 0xbb8 0xaf0 0xa28 0x960 0x898 0x7d0 0x708 0x640 0x578 0x4b0 0x3e8 0x384 0x320 0x2bc 0x258 0x1f4 0x190 0x12c 0xc8 0x64 0x00>;
					};

					qcom,pc-temp-y3-lut {
						qcom,lut-col-legend = <0xfffffff6 0x00 0x0a 0x19 0x28 0x32>;
						qcom,lut-data = <0x347a 0x3456 0x3421 0x33e5 0x33e0 0x33d8 0x356b 0x345f 0x341a 0x33e4 0x33e0 0x33da 0x35ff 0x346c 0x3416 0x33e3 0x33e0 0x33db 0x364d 0x3479 0x3416 0x33e3 0x33e0 0x33dd 0x366b 0x3484 0x3418 0x33e3 0x33e0 0x33de 0x3670 0x3489 0x341c 0x33e5 0x33e0 0x33de 0x35ec 0x3489 0x3423 0x33e8 0x33e0 0x33de 0x34fc 0x3488 0x342b 0x33ed 0x33e1 0x33de 0x34bb 0x348b 0x342e 0x33ef 0x33e1 0x33de 0x34ba 0x349e 0x342f 0x33f0 0x33e1 0x33dd 0x34bb 0x34ac 0x3430 0x33f0 0x33e1 0x33dd 0x34d3 0x349e 0x343d 0x33f7 0x33e4 0x33df 0x3504 0x3481 0x3450 0x3401 0x33e9 0x33e2 0x3510 0x3471 0x3451 0x3402 0x33ea 0x33e3 0x34ec 0x3468 0x343b 0x33fe 0x33e8 0x33e2 0x34cc 0x3462 0x3427 0x33fb 0x33e6 0x33e2 0x34d0 0x345f 0x3422 0x33fd 0x33e8 0x33e2 0x34e0 0x345d 0x341f 0x3401 0x33ec 0x33e3 0x34e7 0x345a 0x341b 0x3401 0x33ec 0x33e3 0x34e9 0x3455 0x3416 0x33f9 0x33e7 0x33e0 0x34ea 0x344f 0x3411 0x33f0 0x33e3 0x33dd 0x34ec 0x3445 0x340c 0x33e8 0x33e1 0x33dc 0x34f0 0x3435 0x3407 0x33e3 0x33e0 0x33db 0x34f5 0x3427 0x3406 0x33e2 0x33df 0x33db 0x3500 0x341c 0x3405 0x33e3 0x33de 0x33db 0x3512 0x3417 0x3405 0x33e4 0x33de 0x33da 0x3525 0x3418 0x3405 0x33e3 0x33de 0x33da 0x3539 0x341b 0x3405 0x33e3 0x33dd 0x33da 0x354f 0x341f 0x3405 0x33e5 0x33dd 0x33da 0x356b 0x3423 0x3405 0x33e9 0x33dd 0x33d9 0x358d 0x3428 0x3405 0x33ec 0x33dd 0x33d9 0x35b2 0x342d 0x3400 0x33ed 0x33de 0x33d9 0x35da 0x3434 0x33f9 0x33ec 0x33de 0x33da 0x360a 0x343c 0x33f6 0x33ec 0x33df 0x33da 0x3641 0x3449 0x33f7 0x33ea 0x33de 0x33da 0x3680 0x3458 0x33f8 0x33e8 0x33de 0x33d9 0x36c1 0x3468 0x33fb 0x33e6 0x33de 0x33d9 0x3702 0x347a 0x3402 0x33e4 0x33dd 0x33d9 0x3742 0x3490 0x3408 0x33e3 0x33dd 0x33d9 0x3781 0x34b0 0x340c 0x33e3 0x33dd 0x33d9 0x37c1 0x34dc 0x340f 0x33e3 0x33dd 0x33d9 0x3803 0x3511 0x3415 0x33e3 0x33de 0x33da 0x3845 0x3550 0x341e 0x33e3 0x33de 0x33da 0x3892 0x35a3 0x3421 0x33e4 0x33de 0x33da 0x38ea 0x3613 0x3429 0x33e3 0x33de 0x33da 0x390d 0x3642 0x3430 0x33eb 0x33df 0x33dc 0x393f 0x363e 0x3435 0x33ec 0x33e1 0x33dd 0x395c 0x3658 0x3442 0x33f0 0x33e3 0x33e0 0x398d 0x36b9 0x3451 0x33f2 0x33e2 0x33e0 0x3a0b 0x3718 0x3452 0x33ee 0x33e1 0x33dd 0x3a97 0x37a6 0x345a 0x33f0 0x33e0 0x33dd 0x3b31 0x3888 0x346f 0x33f5 0x33e3 0x33e1 0x3c10 0x3978 0x3492 0x33f9 0x33e6 0x33e4 0x3f2c 0x3a7b 0x34ca 0x3403 0x33ea 0x33e6 0x3f2c 0x3a7b 0x34ca 0x3403 0x33ea 0x33e6 0x3f2c 0x3a7b 0x34ca 0x3403 0x33ea 0x33e6>;
						qcom,lut-row-legend = <0x2710 0x2648 0x2580 0x24b8 0x23f0 0x2328 0x2260 0x2198 0x20d0 0x2008 0x1f40 0x1e78 0x1db0 0x1ce8 0x1c20 0x1b58 0x1a90 0x19c8 0x1900 0x1838 0x1770 0x16a8 0x15e0 0x1518 0x1450 0x1388 0x12c0 0x11f8 0x1130 0x1068 0xfa0 0xed8 0xe10 0xd48 0xc80 0xbb8 0xaf0 0xa28 0x960 0x898 0x7d0 0x708 0x640 0x578 0x4b0 0x3e8 0x384 0x320 0x2bc 0x258 0x1f4 0x190 0x12c 0xc8 0x64 0x00>;
					};

					qcom,pc-temp-y4-lut {
						qcom,lut-col-legend = <0xfffffff6 0x00 0x0a 0x19 0x28 0x32>;
						qcom,lut-data = <0x45b5 0x41d2 0x40f2 0x406d 0x4045 0x4044 0x452b 0x41db 0x40ef 0x4073 0x4045 0x4042 0x44eb 0x41eb 0x40ef 0x4078 0x4047 0x4041 0x44e9 0x4200 0x40f2 0x407b 0x4048 0x4040 0x4515 0x421b 0x40f7 0x407d 0x404a 0x4040 0x4561 0x4239 0x40fe 0x407e 0x404b 0x4040 0x4627 0x4263 0x4106 0x407c 0x404d 0x4041 0x478b 0x428e 0x4111 0x407a 0x404e 0x4044 0x4914 0x42a4 0x411c 0x407a 0x4051 0x4046 0x4b24 0x42ad 0x4127 0x4081 0x4055 0x4049 0x4c74 0x42bc 0x4138 0x408c 0x405b 0x404d 0x4a3e 0x4407 0x419f 0x409e 0x4069 0x4059 0x4560 0x4626 0x4237 0x40b4 0x407d 0x4068 0x437a 0x4642 0x4251 0x40bd 0x4081 0x406c 0x4347 0x43a8 0x4203 0x40bf 0x407d 0x406b 0x432d 0x41b1 0x41aa 0x40c3 0x407b 0x406a 0x4320 0x41b5 0x416e 0x40ec 0x4091 0x407a 0x430d 0x41e2 0x413b 0x4129 0x40ba 0x4098 0x42ef 0x41ed 0x4117 0x412a 0x40c0 0x409d 0x42b4 0x41c5 0x40fa 0x40d1 0x4094 0x407d 0x4274 0x4198 0x40e3 0x4085 0x4066 0x405b 0x4249 0x4180 0x40d4 0x4078 0x4054 0x404d 0x4228 0x416e 0x40c8 0x4072 0x4049 0x4043 0x421f 0x416b 0x40c2 0x406f 0x4048 0x4042 0x4223 0x415f 0x40be 0x406b 0x4048 0x4042 0x422b 0x414f 0x40bb 0x4069 0x4049 0x4043 0x4231 0x4143 0x40ba 0x406b 0x404b 0x4045 0x423b 0x4137 0x40ba 0x406d 0x404e 0x4048 0x4246 0x4136 0x40b9 0x406e 0x4051 0x404c 0x4252 0x4142 0x40b4 0x4070 0x4057 0x4051 0x425e 0x4154 0x40b0 0x4072 0x405e 0x4058 0x426a 0x4167 0x40b4 0x4074 0x4068 0x4063 0x4276 0x417f 0x40bd 0x4076 0x4073 0x4070 0x4283 0x4198 0x40c4 0x4074 0x4075 0x4072 0x4290 0x41b2 0x40c9 0x4069 0x4064 0x4061 0x429c 0x41cd 0x40cd 0x405e 0x404f 0x404c 0x42a8 0x41ef 0x40d2 0x405b 0x4044 0x4043 0x42b5 0x421f 0x40d8 0x4059 0x403e 0x403f 0x42c7 0x4244 0x40dc 0x405a 0x403e 0x4040 0x42e1 0x4252 0x40e9 0x405d 0x4042 0x4045 0x4308 0x425c 0x40fd 0x4060 0x4047 0x404a 0x433b 0x4262 0x410c 0x4063 0x4048 0x404b 0x437e 0x4270 0x4118 0x4064 0x4046 0x4048 0x43d3 0x4287 0x4129 0x4061 0x403d 0x403b 0x442a 0x42c2 0x4147 0x406b 0x4041 0x403e 0x441b 0x42ef 0x4160 0x4075 0x4057 0x405a 0x441e 0x4307 0x4166 0x4084 0x4070 0x4078 0x43ed 0x432a 0x4193 0x40a2 0x4099 0x40a2 0x43d0 0x436e 0x41e6 0x40be 0x409c 0x4098 0x43e5 0x4383 0x41de 0x409e 0x406e 0x4064 0x43f6 0x4384 0x41d8 0x409e 0x4060 0x4059 0x4411 0x43a0 0x41fb 0x40bd 0x4070 0x4067 0x4463 0x43f1 0x4266 0x40fb 0x4090 0x4085 0x470a 0x44a2 0x432d 0x41de 0x4141 0x4118 0x470a 0x44a2 0x432d 0x41de 0x4141 0x4118 0x470a 0x44a2 0x432d 0x41de 0x4141 0x4118>;
						qcom,lut-row-legend = <0x2710 0x2648 0x2580 0x24b8 0x23f0 0x2328 0x2260 0x2198 0x20d0 0x2008 0x1f40 0x1e78 0x1db0 0x1ce8 0x1c20 0x1b58 0x1a90 0x19c8 0x1900 0x1838 0x1770 0x16a8 0x15e0 0x1518 0x1450 0x1388 0x12c0 0x11f8 0x1130 0x1068 0xfa0 0xed8 0xe10 0xd48 0xc80 0xbb8 0xaf0 0xa28 0x960 0x898 0x7d0 0x708 0x640 0x578 0x4b0 0x3e8 0x384 0x320 0x2bc 0x258 0x1f4 0x190 0x12c 0xc8 0x64 0x00>;
					};

					qcom,pc-temp-y5-lut {
						qcom,lut-col-legend = <0xfffffff6 0x00 0x0a 0x19 0x28 0x32>;
						qcom,lut-data = <0x2208 0x348a 0x3ab0 0x3545 0x4573 0x3634 0x2208 0x34aa 0x3839 0x3326 0x4393 0x3e82 0x269f 0x34e2 0x3660 0x31db 0x419b 0x43da 0x2f8b 0x3522 0x3519 0x3130 0x3fbf 0x46e0 0x3428 0x3557 0x345a 0x30f0 0x3e34 0x4838 0x3590 0x3572 0x341a 0x30e7 0x3d2f 0x4884 0x30ee 0x3576 0x34b3 0x32d3 0x3ca4 0x46c7 0x2869 0x3578 0x35a4 0x35e5 0x3c3f 0x4385 0x267f 0x34b6 0x35c2 0x3648 0x3b81 0x4119 0x2a54 0x3032 0x3545 0x34d0 0x3996 0x3e92 0x2ff6 0x2cf8 0x3494 0x33cf 0x387f 0x3ce5 0x37e1 0x2fd6 0x333d 0x3525 0x3964 0x3cfd 0x4112 0x360e 0x319c 0x3768 0x3acb 0x3dbd 0x4280 0x3a64 0x326c 0x37dc 0x3b0d 0x3dbf 0x373b 0x3dd4 0x395e 0x3745 0x3a7a 0x3cb2 0x2cf9 0x3f72 0x3eca 0x36d1 0x3a41 0x3bb0 0x2d03 0x3ec5 0x3f83 0x384b 0x3ae8 0x3b5d 0x2edc 0x3dc2 0x3fc3 0x3b9d 0x3c38 0x3b2b 0x2f8c 0x3d9a 0x3f92 0x3dc7 0x3e57 0x3b93 0x2f1e 0x3df3 0x3ecf 0x3f34 0x4225 0x3e9f 0x2e5c 0x3e54 0x3de6 0x3fc8 0x445b 0x4233 0x2d64 0x3c6d 0x3c08 0x3c17 0x4527 0x44e0 0x2c30 0x3697 0x3971 0x3578 0x4604 0x471b 0x2b6b 0x3248 0x38a0 0x33d2 0x4627 0x47ff 0x2b06 0x2f1a 0x38d8 0x353a 0x4512 0x484d 0x2ad4 0x2d6f 0x3925 0x3660 0x43d2 0x484f 0x2add 0x2d4c 0x3975 0x3678 0x4315 0x4790 0x2aec 0x2d55 0x39cc 0x366c 0x4294 0x45bc 0x2af3 0x2d44 0x3a34 0x38ed 0x427b 0x43ff 0x2b16 0x2d12 0x3b09 0x40ee 0x4270 0x426f 0x2b4e 0x2d07 0x3ba6 0x465a 0x4280 0x41aa 0x2b80 0x2d07 0x38cb 0x47e5 0x43ef 0x42bb 0x2ba9 0x2cec 0x3382 0x48db 0x472c 0x45f6 0x2bd0 0x2ce9 0x319e 0x48b8 0x4a98 0x495f 0x2bf8 0x2d41 0x31a4 0x45bb 0x4e8c 0x4c69 0x2c20 0x2daa 0x31b5 0x4185 0x51da 0x4ea9 0x2c45 0x2dd9 0x3221 0x3e14 0x52fb 0x508e 0x2c64 0x2d8a 0x34af 0x3aee 0x5257 0x524a 0x2c6c 0x2d32 0x3713 0x3918 0x50bc 0x5292 0x2c5a 0x2d52 0x36de 0x38bf 0x4e90 0x50e7 0x2c45 0x2d99 0x34f7 0x3913 0x4dbc 0x4f8f 0x2c53 0x2da9 0x354f 0x3906 0x4ea8 0x5136 0x2cb7 0x2d71 0x370b 0x3898 0x515e 0x56c7 0x2d6c 0x2d2c 0x33cd 0x3962 0x555b 0x5c52 0x2e6e 0x2cc8 0x325a 0x3610 0x4cc2 0x4ea4 0x2fc4 0x2d10 0x320a 0x3e49 0x4394 0x4373 0x30b0 0x2d1b 0x3431 0x3e08 0x42cc 0x40b6 0x322c 0x2e86 0x370e 0x4092 0x40be 0x3f21 0x3256 0x3099 0x3915 0x3fe1 0x3e27 0x3e5b 0x322c 0x3127 0x38b1 0x3e5f 0x428d 0x410e 0x3117 0x3039 0x38e1 0x4283 0x4414 0x4431 0x2f77 0x2f18 0x37f8 0x4528 0x4741 0x4a06 0x2e6f 0x2e5e 0x37ca 0x4396 0x477b 0x4ab1 0x2b65 0x2d9d 0x3932 0x4343 0x45a6 0x476b 0x2b65 0x2d9d 0x3932 0x4343 0x45a6 0x476b 0x2b65 0x2d9d 0x3932 0x4343 0x45a6 0x476b>;
						qcom,lut-row-legend = <0x2710 0x2648 0x2580 0x24b8 0x23f0 0x2328 0x2260 0x2198 0x20d0 0x2008 0x1f40 0x1e78 0x1db0 0x1ce8 0x1c20 0x1b58 0x1a90 0x19c8 0x1900 0x1838 0x1770 0x16a8 0x15e0 0x1518 0x1450 0x1388 0x12c0 0x11f8 0x1130 0x1068 0xfa0 0xed8 0xe10 0xd48 0xc80 0xbb8 0xaf0 0xa28 0x960 0x898 0x7d0 0x708 0x640 0x578 0x4b0 0x3e8 0x384 0x320 0x2bc 0x258 0x1f4 0x190 0x12c 0xc8 0x64 0x00>;
					};

					qcom,pc-temp-y6-lut {
						qcom,lut-col-legend = <0xfffffff6 0x00 0x0a 0x19 0x28 0x32>;
						qcom,lut-data = <0x1af4 0x1607 0x1492 0x13c9 0x139d 0x1392 0x1afb 0x160e 0x148d 0x13c8 0x139d 0x1393 0x1aff 0x1616 0x148a 0x13c7 0x139d 0x1394 0x1aff 0x161e 0x148a 0x13c8 0x139d 0x1395 0x1afc 0x1626 0x148c 0x13c9 0x139e 0x1395 0x1af7 0x162e 0x148e 0x13ca 0x139f 0x1396 0x1ac7 0x1636 0x1494 0x13cc 0x139f 0x1397 0x1a78 0x163e 0x149c 0x13cf 0x13a1 0x1397 0x1a74 0x1646 0x14a1 0x13d2 0x13a2 0x1398 0x1aff 0x164c 0x14a3 0x13d4 0x13a3 0x1399 0x1b70 0x1657 0x14a8 0x13d7 0x13a5 0x139a 0x1af4 0x16ac 0x14cc 0x13e2 0x13ac 0x139f 0x19d3 0x172c 0x1503 0x13ef 0x13b5 0x13a6 0x1941 0x172c 0x150b 0x13f2 0x13b7 0x13a8 0x190e 0x1670 0x14e5 0x13f1 0x13b5 0x13a7 0x18f6 0x15e2 0x14be 0x13f0 0x13b3 0x13a7 0x18fb 0x15e4 0x14ab 0x13fd 0x13bb 0x13ac 0x1909 0x15f5 0x149c 0x1412 0x13c9 0x13b5 0x190d 0x15f9 0x148f 0x1412 0x13cb 0x13b7 0x190c 0x15ed 0x1483 0x13f3 0x13bb 0x13ab 0x190a 0x15e0 0x147a 0x13d6 0x13ab 0x139f 0x190d 0x15d6 0x1473 0x13cd 0x13a4 0x139a 0x191a 0x15ce 0x146e 0x13c8 0x13a1 0x1397 0x192c 0x15c9 0x146d 0x13c7 0x13a0 0x1397 0x1945 0x15c7 0x146e 0x13c7 0x13a0 0x1397 0x1964 0x15c6 0x146f 0x13c8 0x13a0 0x1398 0x1982 0x15cb 0x1470 0x13c9 0x13a1 0x1398 0x19a0 0x15d5 0x1473 0x13ca 0x13a2 0x1399 0x19c0 0x15e2 0x1475 0x13cc 0x13a3 0x139a 0x19e6 0x15f3 0x1476 0x13d0 0x13a5 0x139c 0x1a11 0x1607 0x1477 0x13d4 0x13a7 0x139e 0x1a3f 0x161d 0x1478 0x13d6 0x13ab 0x13a2 0x1a72 0x1638 0x1479 0x13d7 0x13af 0x13a6 0x1aa7 0x1655 0x147b 0x13d6 0x13b0 0x13a7 0x1ae0 0x1676 0x147f 0x13d2 0x13ab 0x13a2 0x1b1c 0x169b 0x1483 0x13ce 0x13a5 0x139c 0x1b59 0x16c6 0x1488 0x13cc 0x13a2 0x139a 0x1b96 0x16f8 0x1490 0x13cb 0x13a0 0x1398 0x1bd4 0x1732 0x149a 0x13ca 0x13a0 0x1399 0x1c13 0x1772 0x14a5 0x13cb 0x13a1 0x139a 0x1c51 0x17bc 0x14b0 0x13cd 0x13a3 0x139c 0x1c90 0x1811 0x14bf 0x13ce 0x13a4 0x139d 0x1cd3 0x1875 0x14d0 0x13cf 0x13a3 0x139c 0x1d22 0x18ef 0x14e0 0x13d0 0x13a1 0x1399 0x1d80 0x1984 0x14f9 0x13d2 0x13a3 0x139a 0x1da5 0x19b9 0x150c 0x13db 0x13a9 0x13a3 0x1dcf 0x19c4 0x1513 0x13e1 0x13b2 0x13ad 0x1dde 0x19e7 0x152f 0x13ec 0x13bf 0x13bb 0x1e04 0x1a57 0x155a 0x13f6 0x13c0 0x13b8 0x1e6d 0x1abf 0x1560 0x13eb 0x13b2 0x13a7 0x1edf 0x1b41 0x1573 0x13ee 0x13ae 0x13a5 0x1f66 0x1c0d 0x15ab 0x13fd 0x13b6 0x13ac 0x2034 0x1cdf 0x160e 0x1415 0x13c2 0x13b7 0x23c8 0x1de5 0x16a3 0x1461 0x13f8 0x13e4 0x23c8 0x1de5 0x16a3 0x1461 0x13f8 0x13e4 0x23c8 0x1de5 0x16a3 0x1461 0x13f8 0x13e4>;
						qcom,lut-row-legend = <0x2710 0x2648 0x2580 0x24b8 0x23f0 0x2328 0x2260 0x2198 0x20d0 0x2008 0x1f40 0x1e78 0x1db0 0x1ce8 0x1c20 0x1b58 0x1a90 0x19c8 0x1900 0x1838 0x1770 0x16a8 0x15e0 0x1518 0x1450 0x1388 0x12c0 0x11f8 0x1130 0x1068 0xfa0 0xed8 0xe10 0xd48 0xc80 0xbb8 0xaf0 0xa28 0x960 0x898 0x7d0 0x708 0x640 0x578 0x4b0 0x3e8 0x384 0x320 0x2bc 0x258 0x1f4 0x190 0x12c 0xc8 0x64 0x00>;
					};

					qcom,pc-temp-z1-lut {
						qcom,lut-col-legend = <0x00 0x0a 0x19 0x28 0x32>;
						qcom,lut-data = <0x38d1 0x33b6 0x2f09 0x2da0 0x2d49 0x38bb 0x337f 0x2f0d 0x2d9e 0x2d52 0x38c3 0x3376 0x2f0b 0x2da5 0x2d5c 0x38c7 0x337e 0x2f07 0x2da7 0x2d60 0x38d3 0x3382 0x2f03 0x2da8 0x2d62 0x38eb 0x337d 0x2f01 0x2da8 0x2d64 0x38ff 0x336c 0x2f02 0x2da9 0x2d67 0x38f6 0x335e 0x2f03 0x2dac 0x2d6a 0x38d7 0x335d 0x2f05 0x2dae 0x2d6d 0x38b6 0x3362 0x2f09 0x2db1 0x2d6f 0x3896 0x3360 0x2f0d 0x2db5 0x2d72 0x3874 0x334e 0x2f0f 0x2db8 0x2d77 0x3843 0x333c 0x2f0f 0x2dbb 0x2d7b 0x3810 0x332e 0x2f0b 0x2dbb 0x2d7c 0x37ee 0x3328 0x2f04 0x2db9 0x2d7c 0x37d3 0x3329 0x2f01 0x2db7 0x2d7c 0x37b6 0x3329 0x2f04 0x2dbb 0x2d7f 0x3792 0x332c 0x2f0a 0x2dc2 0x2d85 0x3772 0x3337 0x2f14 0x2dc9 0x2d8b 0x3765 0x3349 0x2f21 0x2dce 0x2d8f 0x3763 0x335e 0x2f2c 0x2dd3 0x2d93 0x376a 0x3374 0x2f35 0x2dd8 0x2d98 0x3773 0x3384 0x2f3d 0x2ddd 0x2d9c 0x377f 0x338b 0x2f45 0x2de1 0x2da1 0x3787 0x3391 0x2f4d 0x2de7 0x2da6 0x378c 0x339a 0x2f54 0x2dec 0x2daa 0x378f 0x33a6 0x2f5b 0x2df0 0x2daf 0x3794 0x33ad 0x2f62 0x2df4 0x2db3 0x379f 0x33b2 0x2f69 0x2df8 0x2db7 0x37af 0x33ba 0x2f6f 0x2dfc 0x2dbb 0x37c7 0x33c2 0x2f75 0x2e00 0x2dbf 0x37de 0x33c9 0x2f7a 0x2e04 0x2dc4 0x37e6 0x33d1 0x2f80 0x2e08 0x2dc8 0x37ea 0x33de 0x2f86 0x2e0d 0x2dcd 0x37f0 0x33f1 0x2f8e 0x2e12 0x2dd1 0x3807 0x3403 0x2f95 0x2e17 0x2dd5 0x383b 0x3415 0x2f9d 0x2e1a 0x2dd8 0x386b 0x3422 0x2fa5 0x2e1c 0x2dda 0x3891 0x3427 0x2faa 0x2e1f 0x2ddc 0x38b0 0x3429 0x2fad 0x2e21 0x2ddd 0x38b2 0x342d 0x2fb1 0x2e23 0x2dde 0x3888 0x3439 0x2fb9 0x2e25 0x2de0 0x3873 0x3448 0x2fbf 0x2e27 0x2de1 0x386e 0x3457 0x2fc0 0x2e28 0x2de2 0x3861 0x3449 0x2fc4 0x2e29 0x2de2 0x386f 0x3454 0x2fc7 0x2e2b 0x2de2 0x3869 0x3454 0x2fc8 0x2e2b 0x2de1 0x3868 0x345b 0x2fc9 0x2e2b 0x2de2 0x385f 0x3457 0x2fcf 0x2e2c 0x2de3 0x387c 0x3452 0x2fd1 0x2e30 0x2de6 0x3886 0x346f 0x2fdb 0x2e36 0x2deb 0x38aa 0x3476 0x2ff3 0x2e3f 0x2df0 0x3895 0x349e 0x3007 0x2e4a 0x2dfa 0x38d0 0x34c8 0x3032 0x2e5c 0x2e06 0x38d0 0x34c8 0x3032 0x2e5c 0x2e06 0x38d0 0x34c8 0x3032 0x2e5c 0x2e06>;
						qcom,lut-row-legend = <0x2710 0x2648 0x2580 0x24b8 0x23f0 0x2328 0x2260 0x2198 0x20d0 0x2008 0x1f40 0x1e78 0x1db0 0x1ce8 0x1c20 0x1b58 0x1a90 0x19c8 0x1900 0x1838 0x1770 0x16a8 0x15e0 0x1518 0x1450 0x1388 0x12c0 0x11f8 0x1130 0x1068 0xfa0 0xed8 0xe10 0xd48 0xc80 0xbb8 0xaf0 0xa28 0x960 0x898 0x7d0 0x708 0x640 0x578 0x4b0 0x3e8 0x384 0x320 0x2bc 0x258 0x1f4 0x190 0x12c 0xc8 0x64 0x00>;
					};

					qcom,pc-temp-z2-lut {
						qcom,lut-col-legend = <0x00 0x0a 0x19 0x28 0x32>;
						qcom,lut-data = <0x2bb8 0x2632 0x2811 0x296b 0x2a9e 0x280d 0x2a3d 0x2824 0x28fa 0x293e 0x25fe 0x2926 0x282f 0x28bc 0x28c4 0x2606 0x274d 0x282a 0x28ad 0x28ac 0x2620 0x26d2 0x281d 0x2898 0x28a6 0x262f 0x26c3 0x2815 0x288c 0x28a4 0x2631 0x26b5 0x2811 0x2887 0x28a8 0x262c 0x26aa 0x2812 0x2882 0x28ac 0x2625 0x26a2 0x2816 0x2880 0x28ac 0x261b 0x269c 0x2819 0x2884 0x28b5 0x2612 0x2698 0x2813 0x2887 0x28cc 0x2616 0x2696 0x27f3 0x288e 0x28d4 0x2626 0x2699 0x27d7 0x28ae 0x28d3 0x262c 0x26a7 0x27e8 0x28bd 0x28d4 0x2618 0x26b3 0x2814 0x289f 0x28d2 0x25f5 0x26b6 0x282a 0x2883 0x28c7 0x25e5 0x26ba 0x2827 0x288f 0x28d1 0x25e1 0x26c3 0x281d 0x28b2 0x290a 0x25dd 0x26dd 0x2837 0x28e1 0x2937 0x25d6 0x26fd 0x2894 0x2931 0x293f 0x25c9 0x271e 0x28ce 0x296a 0x293f 0x25be 0x2742 0x28b3 0x2939 0x2923 0x25b7 0x2760 0x2883 0x28bd 0x28ee 0x25b1 0x2775 0x2863 0x288b 0x28cc 0x259f 0x2784 0x284c 0x289e 0x28b4 0x2574 0x278c 0x283f 0x28b6 0x28a5 0x2552 0x2793 0x283c 0x28a9 0x28a6 0x2544 0x2797 0x283d 0x2890 0x28af 0x250b 0x2796 0x2845 0x2888 0x28ba 0x24d2 0x2793 0x2859 0x2888 0x28cd 0x24c0 0x2792 0x286f 0x288c 0x28e8 0x24b3 0x2793 0x2885 0x289f 0x290a 0x24aa 0x2795 0x289c 0x28c5 0x2934 0x24a2 0x2799 0x28b4 0x28ea 0x2962 0x249c 0x27a2 0x28ce 0x290a 0x299b 0x2498 0x27aa 0x28df 0x2925 0x29c7 0x249e 0x27b2 0x28e4 0x293c 0x29d8 0x24a4 0x27b7 0x28e7 0x2954 0x29e2 0x24ad 0x27bb 0x28ef 0x2961 0x29ed 0x24b6 0x27c0 0x28fb 0x2964 0x29f9 0x24b5 0x27c2 0x2901 0x2965 0x2a01 0x24a8 0x27b9 0x28fa 0x2971 0x2a03 0x24a4 0x279c 0x28f3 0x2981 0x2a07 0x24aa 0x26ec 0x28f1 0x2987 0x2a1d 0x246c 0x26c6 0x28d6 0x2992 0x2a3b 0x2459 0x26cc 0x28c6 0x29ad 0x2a38 0x2447 0x26dc 0x28df 0x29c9 0x2a6a 0x2449 0x26cd 0x293d 0x29ca 0x2a89 0x243a 0x26ed 0x297e 0x2a06 0x2aa5 0x243e 0x26c3 0x2925 0x29d7 0x2a55 0x2464 0x269c 0x28de 0x298a 0x29c5 0x246e 0x264f 0x28b9 0x2971 0x29af 0x2445 0x25fc 0x289b 0x2927 0x295f 0x241d 0x258f 0x282d 0x28da 0x2904 0x241d 0x258f 0x282d 0x28da 0x2904 0x241d 0x258f 0x282d 0x28da 0x2904>;
						qcom,lut-row-legend = <0x2710 0x2648 0x2580 0x24b8 0x23f0 0x2328 0x2260 0x2198 0x20d0 0x2008 0x1f40 0x1e78 0x1db0 0x1ce8 0x1c20 0x1b58 0x1a90 0x19c8 0x1900 0x1838 0x1770 0x16a8 0x15e0 0x1518 0x1450 0x1388 0x12c0 0x11f8 0x1130 0x1068 0xfa0 0xed8 0xe10 0xd48 0xc80 0xbb8 0xaf0 0xa28 0x960 0x898 0x7d0 0x708 0x640 0x578 0x4b0 0x3e8 0x384 0x320 0x2bc 0x258 0x1f4 0x190 0x12c 0xc8 0x64 0x00>;
					};

					qcom,pc-temp-z3-lut {
						qcom,lut-col-legend = <0x00 0x0a 0x19 0x28 0x32>;
						qcom,lut-data = <0x4c45 0x4be7 0x4bad 0x4bb7 0x4b9b 0x4d48 0x4c26 0x4bd0 0x4baa 0x4b96 0x4dd0 0x4c76 0x4bee 0x4bac 0x4b97 0x4de1 0x4cc3 0x4bfa 0x4bb4 0x4b9c 0x4dce 0x4cd9 0x4bff 0x4bb6 0x4b9f 0x4db7 0x4cdc 0x4c00 0x4bb7 0x4ba2 0x4dac 0x4cdd 0x4bfe 0x4bb5 0x4ba2 0x4da7 0x4cdd 0x4bfb 0x4bb0 0x4b9f 0x4da5 0x4ce0 0x4bf8 0x4bac 0x4b9b 0x4da2 0x4ce2 0x4bf6 0x4bac 0x4b99 0x4da0 0x4cd4 0x4bf0 0x4bac 0x4b98 0x4da5 0x4cac 0x4bdf 0x4ba7 0x4b98 0x4db6 0x4c9a 0x4bc8 0x4b9b 0x4b95 0x4dc5 0x4cb6 0x4bce 0x4b96 0x4b91 0x4db4 0x4cd7 0x4bef 0x4ba3 0x4b93 0x4d83 0x4cd1 0x4c01 0x4bb3 0x4b97 0x4d54 0x4cac 0x4bec 0x4bad 0x4b94 0x4d30 0x4c8a 0x4bd0 0x4b9c 0x4b8a 0x4d0e 0x4c6f 0x4bcf 0x4b98 0x4b87 0x4cf1 0x4c5e 0x4be1 0x4ba6 0x4b8e 0x4cd8 0x4c62 0x4bee 0x4bb3 0x4b97 0x4cc6 0x4c75 0x4bef 0x4bb3 0x4b9d 0x4cbc 0x4c87 0x4bef 0x4bae 0x4ba1 0x4cb4 0x4c93 0x4bed 0x4bad 0x4ba2 0x4cac 0x4c9c 0x4bea 0x4bb4 0x4ba0 0x4ca3 0x4c9d 0x4be9 0x4bba 0x4b9e 0x4c97 0x4c9b 0x4bef 0x4bb7 0x4b9c 0x4c8c 0x4c97 0x4bf5 0x4bb2 0x4b9a 0x4c7f 0x4c91 0x4bf6 0x4bae 0x4b98 0x4c6f 0x4c8a 0x4bf4 0x4ba9 0x4b96 0x4c5d 0x4c84 0x4bf2 0x4ba5 0x4b94 0x4c4a 0x4c7f 0x4bef 0x4ba2 0x4b91 0x4c3a 0x4c7a 0x4bea 0x4ba0 0x4b8e 0x4c2b 0x4c73 0x4be7 0x4b9f 0x4b8a 0x4c1e 0x4c6b 0x4be5 0x4b9e 0x4b86 0x4c17 0x4c65 0x4be2 0x4b9e 0x4b84 0x4c1b 0x4c5f 0x4bde 0x4b9e 0x4b84 0x4c23 0x4c5a 0x4bda 0x4b9d 0x4b86 0x4c39 0x4c56 0x4bd7 0x4b9c 0x4b86 0x4c4f 0x4c53 0x4bd6 0x4b97 0x4b83 0x4c46 0x4c4f 0x4bd4 0x4b93 0x4b81 0x4c28 0x4c4a 0x4bd2 0x4b93 0x4b82 0x4c1b 0x4c3f 0x4bd0 0x4b93 0x4b82 0x4c19 0x4bfb 0x4bcc 0x4b93 0x4b83 0x4bac 0x4bb3 0x4bb6 0x4b90 0x4b7f 0x4b91 0x4b94 0x4ba0 0x4b89 0x4b78 0x4b89 0x4b8c 0x4b9e 0x4b80 0x4b70 0x4b8b 0x4b87 0x4b8e 0x4b7e 0x4b70 0x4b74 0x4b76 0x4b83 0x4b7c 0x4b6d 0x4b78 0x4b75 0x4b98 0x4b87 0x4b7c 0x4bab 0x4b91 0x4b9b 0x4b8b 0x4b83 0x4bda 0x4b96 0x4b9d 0x4b8e 0x4b84 0x4bf2 0x4b94 0x4b99 0x4b92 0x4b87 0x4c08 0x4ba0 0x4b9f 0x4b95 0x4b8c 0x4c08 0x4ba0 0x4b9f 0x4b95 0x4b8c 0x4c08 0x4ba0 0x4b9f 0x4b95 0x4b8c>;
						qcom,lut-row-legend = <0x2710 0x2648 0x2580 0x24b8 0x23f0 0x2328 0x2260 0x2198 0x20d0 0x2008 0x1f40 0x1e78 0x1db0 0x1ce8 0x1c20 0x1b58 0x1a90 0x19c8 0x1900 0x1838 0x1770 0x16a8 0x15e0 0x1518 0x1450 0x1388 0x12c0 0x11f8 0x1130 0x1068 0xfa0 0xed8 0xe10 0xd48 0xc80 0xbb8 0xaf0 0xa28 0x960 0x898 0x7d0 0x708 0x640 0x578 0x4b0 0x3e8 0x384 0x320 0x2bc 0x258 0x1f4 0x190 0x12c 0xc8 0x64 0x00>;
					};

					qcom,pc-temp-z4-lut {
						qcom,lut-col-legend = <0x00 0x0a 0x19 0x28 0x32>;
						qcom,lut-data = <0x4001 0x3c8d 0x3a72 0x3978 0x397b 0x40ed 0x3c83 0x3a6f 0x39c6 0x39b9 0x40da 0x3c60 0x3a4a 0x39d2 0x39c2 0x4086 0x3c0a 0x3a21 0x39c0 0x39b5 0x4000 0x3ba1 0x39fb 0x39a7 0x399e 0x3f71 0x3b4a 0x39dc 0x3990 0x3986 0x3ef7 0x3b02 0x39c2 0x3981 0x3976 0x3e89 0x3acb 0x39ac 0x3976 0x396c 0x3e16 0x3aa0 0x39a0 0x3970 0x3966 0x3d82 0x3a79 0x399a 0x396d 0x3961 0x3cf4 0x3a50 0x3998 0x396a 0x395d 0x3cc5 0x3a2f 0x3998 0x3965 0x3959 0x3cdb 0x3a29 0x3999 0x395f 0x3951 0x3cf0 0x3a35 0x399d 0x3961 0x394e 0x3cc2 0x3a3c 0x39a2 0x3970 0x395b 0x3c4c 0x3a29 0x39a0 0x397b 0x3968 0x3beb 0x39fe 0x398c 0x396b 0x395e 0x3bb2 0x39dd 0x3979 0x394d 0x3947 0x3b8d 0x39c9 0x3978 0x394f 0x3946 0x3b7e 0x39bd 0x3982 0x3988 0x3974 0x3b75 0x39bc 0x3996 0x39ba 0x39a6 0x3b71 0x39bf 0x39ca 0x39be 0x39ab 0x3b75 0x39c9 0x39fe 0x39b9 0x399f 0x3b7b 0x39fa 0x39fe 0x39ae 0x3991 0x3b80 0x3a38 0x39df 0x3993 0x3982 0x3b85 0x3a46 0x39bf 0x397d 0x3975 0x3b8c 0x3a43 0x39a7 0x3973 0x396c 0x3b92 0x3a3e 0x3994 0x396e 0x3965 0x3b9e 0x3a2f 0x3989 0x3969 0x395f 0x3bab 0x3a18 0x3982 0x3965 0x395a 0x3bb3 0x3a05 0x397d 0x3962 0x3955 0x3bba 0x39f5 0x397b 0x395e 0x3951 0x3bbe 0x39e5 0x397a 0x395a 0x394e 0x3bbc 0x39d6 0x3979 0x395a 0x394d 0x3bb5 0x39c8 0x3979 0x395c 0x3950 0x3ba1 0x39ba 0x3978 0x395e 0x3955 0x3b72 0x39ac 0x3976 0x3961 0x395b 0x3b43 0x39a1 0x3973 0x3963 0x3961 0x3afc 0x399e 0x3970 0x3963 0x3963 0x3abc 0x399c 0x396d 0x3963 0x3960 0x3ab4 0x3999 0x396a 0x3962 0x395d 0x3abb 0x3994 0x3967 0x3960 0x395c 0x3ab9 0x3995 0x3962 0x395d 0x395b 0x3aa3 0x39d0 0x395a 0x3959 0x3958 0x3abd 0x39eb 0x3957 0x394b 0x394c 0x3ac6 0x39f6 0x3953 0x3935 0x3934 0x3acb 0x39f8 0x394d 0x3931 0x392d 0x3ac3 0x39fa 0x3959 0x3929 0x3920 0x3ad0 0x3a03 0x3961 0x3925 0x391e 0x3ac0 0x39ff 0x394e 0x392e 0x392c 0x3a9b 0x39f7 0x3956 0x3935 0x3930 0x3a8e 0x39fe 0x3959 0x3936 0x3935 0x3a94 0x3a0e 0x3963 0x3937 0x3936 0x3aa9 0x3a1d 0x3967 0x393a 0x3936 0x3aa9 0x3a1d 0x3967 0x393a 0x3936 0x3aa9 0x3a1d 0x3967 0x393a 0x3936>;
						qcom,lut-row-legend = <0x2710 0x2648 0x2580 0x24b8 0x23f0 0x2328 0x2260 0x2198 0x20d0 0x2008 0x1f40 0x1e78 0x1db0 0x1ce8 0x1c20 0x1b58 0x1a90 0x19c8 0x1900 0x1838 0x1770 0x16a8 0x15e0 0x1518 0x1450 0x1388 0x12c0 0x11f8 0x1130 0x1068 0xfa0 0xed8 0xe10 0xd48 0xc80 0xbb8 0xaf0 0xa28 0x960 0x898 0x7d0 0x708 0x640 0x578 0x4b0 0x3e8 0x384 0x320 0x2bc 0x258 0x1f4 0x190 0x12c 0xc8 0x64 0x00>;
					};

					qcom,pc-temp-z5-lut {
						qcom,lut-col-legend = <0x00 0x0a 0x19 0x28 0x32>;
						qcom,lut-data = <0x2b3c 0x2daa 0x3498 0x4a8d 0x45cc 0x2ef0 0x3052 0x39fb 0x4721 0x484e 0x3117 0x343d 0x3f9f 0x4802 0x4a61 0x31df 0x385f 0x430e 0x4b83 0x4d9f 0x326a 0x3a69 0x44ec 0x4e02 0x5124 0x32f3 0x3bab 0x4673 0x5049 0x55e1 0x33c6 0x3ce5 0x4810 0x514c 0x5936 0x34d0 0x3e95 0x49be 0x511b 0x5a23 0x35db 0x4119 0x4b35 0x5160 0x5a1d 0x36fa 0x4312 0x4c4c 0x5327 0x5b6b 0x3859 0x42b6 0x4bad 0x5424 0x5e2c 0x3a2d 0x3f5c 0x45e6 0x5167 0x6138 0x3c44 0x3ed3 0x3ee4 0x49ed 0x6100 0x3d63 0x47a6 0x4250 0x472f 0x5e7d 0x3d9a 0x506d 0x5049 0x50b3 0x5f98 0x3db5 0x5016 0x57f1 0x5c40 0x639a 0x3dda 0x4c6d 0x532f 0x5d14 0x64bc 0x3dd6 0x4a75 0x4bb9 0x59b9 0x646c 0x3d86 0x49e6 0x55e6 0x5b90 0x6454 0x3cdc 0x49b6 0x76e4 0x6b24 0x646b 0x3bcd 0x5034 0x875d 0x7705 0x6492 0x3ad1 0x649b 0x78a4 0x6a60 0x5e9c 0x3a04 0x7968 0x6282 0x5014 0x511e 0x3939 0x8c1a 0x56c4 0x4873 0x4bc7 0x3846 0x9a39 0x4fd8 0x5026 0x4d8e 0x3716 0x9aa6 0x4dfb 0x5780 0x5074 0x35e9 0x91df 0x53c1 0x5aa0 0x53ba 0x34ed 0x87db 0x5d83 0x5d20 0x57f1 0x33ea 0x7eb5 0x65eb 0x5e8b 0x5cc6 0x32dd 0x764e 0x6eb9 0x601d 0x628a 0x31ca 0x720c 0x75c6 0x61b9 0x67fc 0x30bf 0x6fd5 0x79eb 0x63f1 0x6c9c 0x2ffa 0x6e15 0x7d26 0x6810 0x7085 0x2f5e 0x6c28 0x8068 0x6dc5 0x7165 0x2ed6 0x6a83 0x83d1 0x7653 0x6fdc 0x2e78 0x6a47 0x8529 0x7b5b 0x6e81 0x2ea9 0x6b32 0x8003 0x7adf 0x6f61 0x2f11 0x6ca0 0x7890 0x796f 0x710e 0x303e 0x6e9b 0x7749 0x7672 0x709c 0x317f 0x7119 0x77a9 0x6cad 0x6a94 0x3162 0x71bd 0x77df 0x65cc 0x65f5 0x300b 0x6c45 0x7771 0x66c4 0x66af 0x2fb0 0x60cd 0x7669 0x680b 0x6789 0x3015 0x4018 0x70b0 0x6813 0x6600 0x2ca4 0x3328 0x596b 0x6764 0x62b7 0x2bbe 0x3022 0x477d 0x6688 0x6215 0x2b68 0x2f70 0x4725 0x57da 0x5967 0x2b6c 0x2f09 0x3dd8 0x58e5 0x64be 0x2ab7 0x2db9 0x398d 0x5bd2 0x6460 0x2ae0 0x2ded 0x457f 0x6bcd 0x75c0 0x2cb0 0x2ff3 0x438f 0x6311 0x7110 0x2d80 0x2fa5 0x439f 0x6129 0x668d 0x2d89 0x2ebe 0x3ec3 0x61e3 0x62ca 0x2d50 0x2e6c 0x3eb4 0x5b72 0x6005 0x2d50 0x2e6c 0x3eb4 0x5b72 0x6005 0x2d50 0x2e6c 0x3eb4 0x5b72 0x6005>;
						qcom,lut-row-legend = <0x2710 0x2648 0x2580 0x24b8 0x23f0 0x2328 0x2260 0x2198 0x20d0 0x2008 0x1f40 0x1e78 0x1db0 0x1ce8 0x1c20 0x1b58 0x1a90 0x19c8 0x1900 0x1838 0x1770 0x16a8 0x15e0 0x1518 0x1450 0x1388 0x12c0 0x11f8 0x1130 0x1068 0xfa0 0xed8 0xe10 0xd48 0xc80 0xbb8 0xaf0 0xa28 0x960 0x898 0x7d0 0x708 0x640 0x578 0x4b0 0x3e8 0x384 0x320 0x2bc 0x258 0x1f4 0x190 0x12c 0xc8 0x64 0x00>;
					};

					qcom,pc-temp-z6-lut {
						qcom,lut-col-legend = <0x00 0x0a 0x19 0x28 0x32>;
						qcom,lut-data = <0x409a 0x3c2e 0x39dd 0x392f 0x3913 0x416d 0x3c48 0x39ee 0x394b 0x392d 0x419b 0x3c57 0x39ee 0x3952 0x3933 0x4181 0x3c50 0x39e4 0x394f 0x3931 0x413b 0x3c33 0x39d5 0x3947 0x392a 0x40e4 0x3c0c 0x39c7 0x393d 0x3921 0x409c 0x3be5 0x39bb 0x3935 0x391b 0x4062 0x3bcb 0x39b0 0x392e 0x3915 0x4027 0x3bb9 0x39aa 0x392a 0x3910 0x3fe0 0x3ba7 0x39a7 0x3929 0x390e 0x3f9a 0x3b8a 0x39a3 0x3928 0x390c 0x3f73 0x3b64 0x399a 0x3924 0x390b 0x3f65 0x3b56 0x398e 0x391c 0x3906 0x3f55 0x3b62 0x3992 0x3919 0x3903 0x3f1e 0x3b70 0x39a4 0x3927 0x390a 0x3ec0 0x3b64 0x39ac 0x3933 0x3912 0x3e70 0x3b3f 0x3999 0x392a 0x390c 0x3e3a 0x3b22 0x3982 0x3915 0x38fe 0x3e0f 0x3b10 0x3982 0x3914 0x38fc 0x3df2 0x3b06 0x3991 0x3936 0x3915 0x3ddc 0x3b09 0x39a5 0x3953 0x3930 0x3dd2 0x3b19 0x39c1 0x3956 0x3934 0x3dd2 0x3b2e 0x39d7 0x3953 0x3934 0x3dd7 0x3b4e 0x39d6 0x394f 0x3932 0x3ddc 0x3b6d 0x39c9 0x3948 0x392b 0x3de1 0x3b75 0x39be 0x3942 0x3924 0x3de6 0x3b75 0x39b8 0x393d 0x391f 0x3dea 0x3b74 0x39b4 0x3938 0x391c 0x3dee 0x3b6e 0x39b1 0x3935 0x3919 0x3df0 0x3b64 0x39ae 0x3931 0x3916 0x3df0 0x3b5c 0x39ab 0x392e 0x3913 0x3df0 0x3b54 0x39a9 0x392b 0x3910 0x3def 0x3b4c 0x39a8 0x3928 0x390d 0x3ded 0x3b46 0x39a7 0x3928 0x390c 0x3deb 0x3b40 0x39a7 0x3929 0x390c 0x3deb 0x3b3c 0x39a6 0x392a 0x390c 0x3ded 0x3b38 0x39a4 0x392c 0x390f 0x3def 0x3b35 0x39a2 0x392d 0x3913 0x3def 0x3b35 0x39a0 0x392d 0x3914 0x3dee 0x3b36 0x399f 0x392a 0x3912 0x3deb 0x3b36 0x399e 0x3928 0x3910 0x3de2 0x3b35 0x399d 0x3927 0x3910 0x3dd8 0x3b34 0x399b 0x3927 0x390f 0x3dcd 0x3b2c 0x3997 0x3926 0x390f 0x3da1 0x3b16 0x398b 0x391d 0x3908 0x3d94 0x3b10 0x397f 0x3911 0x38f9 0x3d93 0x3b0a 0x397c 0x390a 0x38f2 0x3d8f 0x3b0c 0x3979 0x3906 0x38ec 0x3d8d 0x3b07 0x3977 0x3903 0x38ea 0x3d95 0x3b0c 0x397c 0x390d 0x38f8 0x3da1 0x3b20 0x3983 0x3914 0x38ff 0x3dbd 0x3b30 0x398c 0x3918 0x3902 0x3de0 0x3b45 0x3993 0x391d 0x3906 0x3e15 0x3b6d 0x39a2 0x3924 0x390d 0x3e15 0x3b6d 0x39a2 0x3924 0x390d 0x3e15 0x3b6d 0x39a2 0x3924 0x390d>;
						qcom,lut-row-legend = <0x2710 0x2648 0x2580 0x24b8 0x23f0 0x2328 0x2260 0x2198 0x20d0 0x2008 0x1f40 0x1e78 0x1db0 0x1ce8 0x1c20 0x1b58 0x1a90 0x19c8 0x1900 0x1838 0x1770 0x16a8 0x15e0 0x1518 0x1450 0x1388 0x12c0 0x11f8 0x1130 0x1068 0xfa0 0xed8 0xe10 0xd48 0xc80 0xbb8 0xaf0 0xa28 0x960 0x898 0x7d0 0x708 0x640 0x578 0x4b0 0x3e8 0x384 0x320 0x2bc 0x258 0x1f4 0x190 0x12c 0xc8 0x64 0x00>;
					};
				};
			};
		};
	};

	fragment@14 {
		target = <0xffffffff>;

		__overlay__ {

			pa_therm1 {
				label = "pa_therm1";
				qcom,hw-settle-time = <0xc8>;
				qcom,pre-scaling = <0x01 0x01>;
				qcom,ratiometric;
				reg = <0x4f>;
			};
		};
	};

	fragment@15 {
		target = <0xffffffff>;

		__overlay__ {
			io-channels = <0xffffffff 0x4d 0xffffffff 0x4e 0xffffffff 0x4f 0xffffffff 0x52>;

			pa_therm1 {
				qcom,hw-settle-time = <0xc8>;
				qcom,ratiometric;
				reg = <0x4f>;
			};
		};
	};

	fragment@16 {
		target = <0xffffffff>;

		__overlay__ {
			extcon = <0xffffffff 0xffffffff 0xffffffff>;
		};
	};

	fragment@17 {
		target = <0xffffffff>;

		__overlay__ {
			extcon = <0xffffffff>;
		};
	};

	fragment@18 {
		target = <0xffffffff>;

		__overlay__ {
			compatible = "qcom,ufs-phy-qmp-v3";
			status = "ok";
			vdda-phy-max-microamp = <0xf5b4>;
			vdda-phy-supply = <0xffffffff>;
			vdda-pll-max-microamp = <0x477c>;
			vdda-pll-supply = <0xffffffff>;
		};
	};

	fragment@19 {
		target = <0xffffffff>;

		__overlay__ {
			qcom,vddp-ref-clk-max-microamp = <0x64>;
			qcom,vddp-ref-clk-supply = <0xffffffff>;
			status = "ok";
			vcc-max-microamp = <0x927c0>;
			vcc-supply = <0xffffffff>;
			vcc-voltage-level = <0x2d2a80 0x2d2a80>;
			vccq2-max-microamp = <0x927c0>;
			vccq2-supply = <0xffffffff>;
			vccq2-voltage-level = <0x1ab3f0 0x1dc130>;
			vdd-hba-fixed-regulator;
			vdd-hba-supply = <0xffffffff>;
		};
	};

	fragment@2 {
		target = <0xffffffff>;

		__overlay__ {

			qcom,mdss_dsi_rm69299_visionox_amoled_video {
				phandle = <0x03>;
				qcom,dsi-dyn-clk-enable;
				qcom,dsi-dyn-clk-list = <0x38ae2bc0 0x37bc55b0 0x37f8cb38 0x383540b8 0x3871b640>;
				qcom,dsi-supported-dfps-list = <0x3c 0x37 0x30>;
				qcom,esd-check-enabled;
				qcom,mdss-dsi-bl-max-level = <0xff>;
				qcom,mdss-dsi-bl-min-level = <0x01>;
				qcom,mdss-dsi-bl-pmic-control-type = "bl_ctrl_dcs";
				qcom,mdss-dsi-bllp-eof-power-mode;
				qcom,mdss-dsi-bllp-power-mode;
				qcom,mdss-dsi-border-color = <0x00>;
				qcom,mdss-dsi-bpp = <0x18>;
				qcom,mdss-dsi-color-order = "rgb_swap_rgb";
				qcom,mdss-dsi-dma-trigger = "trigger_sw";
				qcom,mdss-dsi-h-sync-pulse = <0x00>;
				qcom,mdss-dsi-lane-0-state;
				qcom,mdss-dsi-lane-1-state;
				qcom,mdss-dsi-lane-2-state;
				qcom,mdss-dsi-lane-3-state;
				qcom,mdss-dsi-lane-map = "lane_map_0123";
				qcom,mdss-dsi-lp11-init;
				qcom,mdss-dsi-mdp-trigger = "none";
				qcom,mdss-dsi-pan-enable-dynamic-fps;
				qcom,mdss-dsi-pan-fps-update = "dfps_immediate_porch_mode_vfp";
				qcom,mdss-dsi-panel-name = "rm69299 amoled fhd+ video mode dsi visionox panel";
				qcom,mdss-dsi-panel-on-check-value = <0x9c>;
				qcom,mdss-dsi-panel-status-check-mode = "reg_read";
				qcom,mdss-dsi-panel-status-command = <0x6010001 0x10a>;
				qcom,mdss-dsi-panel-status-command-state = "dsi_hs_mode";
				qcom,mdss-dsi-panel-status-read-length = <0x01>;
				qcom,mdss-dsi-panel-status-value = <0x9c>;
				qcom,mdss-dsi-panel-type = "dsi_video_mode";
				qcom,mdss-dsi-reset-sequence = <0x01 0x0a 0x00 0x0a 0x01 0x0a>;
				qcom,mdss-dsi-stream = <0x00>;
				qcom,mdss-dsi-t-clk-post = <0x0e>;
				qcom,mdss-dsi-t-clk-pre = <0x31>;
				qcom,mdss-dsi-te-check-enable;
				qcom,mdss-dsi-te-dcs-command = <0x01>;
				qcom,mdss-dsi-te-pin-select = <0x01>;
				qcom,mdss-dsi-te-using-te-pin;
				qcom,mdss-dsi-traffic-mode = "non_burst_sync_event";
				qcom,mdss-dsi-tx-eot-append;
				qcom,mdss-dsi-underflow-color = <0xff>;
				qcom,mdss-dsi-virtual-channel-id = <0x00>;
				qcom,mdss-dsi-wr-mem-continue = <0x3c>;
				qcom,mdss-dsi-wr-mem-start = <0x2c>;
				qcom,panel-supply-entries = <0x01>;
				qcom,platform-reset-gpio = <0xffffffff 0x03 0x00>;
				qcom,platform-te-gpio = <0xffffffff 0x0a 0x00>;

				qcom,mdss-dsi-display-timings {

					timing@0 {
						qcom,default-topology-index = <0x00>;
						qcom,display-topology = <0x01 0x00 0x01>;
						qcom,mdss-dsi-h-back-porch = <0x24>;
						qcom,mdss-dsi-h-front-porch = <0x1a>;
						qcom,mdss-dsi-h-pulse-width = <0x02>;
						qcom,mdss-dsi-h-sync-skew = <0x00>;
						qcom,mdss-dsi-off-command = [05 01 00 00 32 00 02 28 00 05 01 00 00 96 00 02 10 00];
						qcom,mdss-dsi-off-command-state = "dsi_hs_mode";
						qcom,mdss-dsi-on-command = [39 01 00 00 00 00 02 fe 00 39 01 00 00 00 00 02 c2 08 39 01 00 00 00 00 02 35 00 39 01 00 00 00 00 02 51 ff 05 01 00 00 96 00 02 11 00 05 01 00 00 32 00 02 29 00];
						qcom,mdss-dsi-on-command-state = "dsi_lp_mode";
						qcom,mdss-dsi-panel-framerate = <0x3c>;
						qcom,mdss-dsi-panel-height = <0x8c8>;
						qcom,mdss-dsi-panel-phy-timings = <0x200808 0x24230808 0x5020400>;
						qcom,mdss-dsi-panel-width = <0x438>;
						qcom,mdss-dsi-v-back-porch = <0x04>;
						qcom,mdss-dsi-v-front-porch = <0x38>;
						qcom,mdss-dsi-v-pulse-width = <0x04>;
					};
				};
			};
		};
	};

	fragment@20 {
		target = <0xffffffff>;

		__overlay__ {
			pinctrl-0 = <0xffffffff 0xffffffff 0xffffffff 0xffffffff>;
			pinctrl-1 = <0xffffffff 0xffffffff 0xffffffff 0xffffffff>;
			pinctrl-names = "active\0sleep";
			qcom,vdd-current-level = <0x00 0x8b290>;
			qcom,vdd-io-always-on;
			qcom,vdd-io-current-level = <0x00 0x4f588>;
			qcom,vdd-io-lpm-sup;
			qcom,vdd-io-voltage-level = <0x1b7740 0x1b7740>;
			qcom,vdd-voltage-level = <0x2d2a80 0x2d2a80>;
			status = "ok";
			vdd-io-supply = <0xffffffff>;
			vdd-supply = <0xffffffff>;
		};
	};

	fragment@21 {
		target = <0xffffffff>;

		__overlay__ {
			cd-gpios = <0xffffffff 0x45 0x01>;
			pinctrl-0 = <0xffffffff 0xffffffff 0xffffffff 0xffffffff>;
			pinctrl-1 = <0xffffffff 0xffffffff 0xffffffff 0xffffffff>;
			pinctrl-names = "active\0sleep";
			qcom,vdd-current-level = <0x00 0xc3500>;
			qcom,vdd-io-current-level = <0x00 0x55f0>;
			qcom,vdd-io-voltage-level = <0x1b7740 0x2d0370>;
			qcom,vdd-voltage-level = <0x2d2a80 0x2d2a80>;
			status = "ok";
			vdd-io-supply = <0xffffffff>;
			vdd-supply = <0xffffffff>;
		};
	};

	fragment@22 {
		target = <0xffffffff>;

		__overlay__ {

			pa-therm1 {
				polling-delay = <0x00>;
				polling-delay-passive = <0x00>;
				thermal-governor = "user_space";
				thermal-sensors = <0xffffffff 0x4f>;
				wake-capable-sensor;

				trips {

					active-config0 {
						hysteresis = <0x3e8>;
						temperature = <0x1e848>;
						type = "passive";
					};
				};
			};
		};
	};

	fragment@23 {
		target = <0xffffffff>;

		__overlay__ {
			status = "ok";
		};
	};

	fragment@24 {
		target = <0xffffffff>;

		__overlay__ {
			qcom,battery-data = <0x10>;
			qcom,cl-feedback-on;
			qcom,hold-soc-while-full;
			qcom,linearize-soc;
			qcom,qg-iterm-ma = <0x64>;
		};
	};

	fragment@25 {
		target = <0xffffffff>;

		__overlay__ {
			dpdm-supply = <0xffffffff>;
			io-channel-names = "usb_in_voltage\0usb_in_current\0chg_temp\0die_temp\0conn_temp\0sbux_res\0vph_voltage";
			io-channels = <0xffffffff 0x08 0xffffffff 0x07 0xffffffff 0x09 0xffffffff 0x06 0xffffffff 0x4f 0xffffffff 0x99 0xffffffff 0x83>;
			qcom,auto-recharge-soc = <0x62>;
			qcom,battery-data = <0x10>;
			qcom,charger-temp-max = <0x320>;
			qcom,disable-fcc-restriction;
			qcom,disable-sw-thermal-regulation;
			qcom,fcc-stepping-enable;
			qcom,sec-charger-config = <0x03>;
			qcom,smb-temp-max = <0x320>;
			qcom,step-charging-enable;
			qcom,suspend-input-on-debug-batt;
			qcom,sw-jeita-enable;
			qcom,thermal-mitigation = <0x401640 0x3567e0 0x2dc6c0 0x2625a0 0x1e8480 0x16e360 0xf4240 0x7a120>;
		};
	};

	fragment@26 {
		target = <0xffffffff>;

		__overlay__ {

			key_vol_up {

				key_vol_up_default {
					bias-pull-up;
					function = "normal";
					input-enable;
					phandle = <0x11>;
					pins = "gpio2";
					power-source = <0x00>;
				};
			};
		};
	};

	fragment@27 {
		target = <0xffffffff>;

		__overlay__ {

			gpio_keys {
				compatible = "gpio-keys";
				label = "gpio-keys";
				pinctrl-0 = <0x11>;
				pinctrl-names = "default";

				vol_up {
					debounce-interval = <0x0f>;
					gpio-key,wakeup;
					gpios = <0xffffffff 0x02 0x01>;
					label = "volume_up";
					linux,can-disable;
					linux,code = <0x73>;
					linux,input-type = <0x01>;
				};
			};
		};
	};

	fragment@28 {
		target = <0xffffffff>;

		__overlay__ {
			#address-cells = <0x01>;
			#size-cells = <0x00>;
			qcom,clk-freq-out = <0xf4240>;
			status = "ok";

			nq@28 {
				compatible = "qcom,nq-nci";
				interrupt-names = "nfc_irq";
				interrupt-parent = <0xffffffff>;
				interrupts = <0x25 0x00>;
				pinctrl-0 = <0xffffffff 0xffffffff 0xffffffff>;
				pinctrl-1 = <0xffffffff 0xffffffff 0xffffffff>;
				pinctrl-names = "nfc_active\0nfc_suspend";
				qcom,nq-clkreq = <0xffffffff 0x1f 0x00>;
				qcom,nq-firm = <0xffffffff 0x24 0x00>;
				qcom,nq-irq = <0xffffffff 0x25 0x00>;
				qcom,nq-ven = <0xffffffff 0x0c 0x00>;
				reg = <0x28>;
			};
		};
	};

	fragment@29 {
		target = <0xffffffff>;

		__overlay__ {
			status = "ok";

			synaptics_tcm@20 {
				avdd-supply = <0xffffffff>;
				compatible = "synaptics,tcm-i2c";
				interrupt-parent = <0xffffffff>;
				interrupts = <0x09 0x2008>;
				pinctrl-0 = <0xffffffff>;
				pinctrl-1 = <0xffffffff 0xffffffff>;
				pinctrl-2 = <0xffffffff>;
				pinctrl-names = "pmx_ts_active\0pmx_ts_suspend\0pmx_ts_release";
				reg = <0x20>;
				synaptics,bus-reg-name = "vdd";
				synaptics,irq-gpio = <0xffffffff 0x09 0x2008>;
				synaptics,irq-on-state = <0x00>;
				synaptics,power-delay-ms = <0xc8>;
				synaptics,pwr-reg-name = "avdd";
				synaptics,reset-active-ms = <0x14>;
				synaptics,reset-delay-ms = <0xc8>;
				synaptics,reset-gpio = <0xffffffff 0x08 0x00>;
				synaptics,reset-on-state = <0x00>;
				synaptics,ubl-i2c-addr = <0x20>;
				vdd-supply = <0xffffffff>;
			};
		};
	};

	fragment@3 {
		target = <0xffffffff>;

		__overlay__ {

			qcom,mdss_dsi_rm69299_visionox_amoled_cmd {
				phandle = <0x04>;
				qcom,dsi-dyn-clk-enable;
				qcom,dsi-dyn-clk-list = <0x3da58d80 0x3c9e86e0 0x3ce04888 0x3d220a30 0x3d63cbd8>;
				qcom,esd-check-enabled;
				qcom,mdss-dsi-bl-max-level = <0xff>;
				qcom,mdss-dsi-bl-min-level = <0x01>;
				qcom,mdss-dsi-bl-pmic-control-type = "bl_ctrl_dcs";
				qcom,mdss-dsi-bllp-eof-power-mode;
				qcom,mdss-dsi-bllp-power-mode;
				qcom,mdss-dsi-border-color = <0x00>;
				qcom,mdss-dsi-bpp = <0x18>;
				qcom,mdss-dsi-color-order = "rgb_swap_rgb";
				qcom,mdss-dsi-dma-trigger = "trigger_sw";
				qcom,mdss-dsi-h-sync-pulse = <0x00>;
				qcom,mdss-dsi-lane-0-state;
				qcom,mdss-dsi-lane-1-state;
				qcom,mdss-dsi-lane-2-state;
				qcom,mdss-dsi-lane-3-state;
				qcom,mdss-dsi-lane-map = "lane_map_0123";
				qcom,mdss-dsi-lp11-init;
				qcom,mdss-dsi-mdp-trigger = "none";
				qcom,mdss-dsi-panel-name = "rm69299 amoled fhd+ cmd mode dsi visionox panel";
				qcom,mdss-dsi-panel-on-check-value = <0x9c>;
				qcom,mdss-dsi-panel-status-check-mode = "reg_read";
				qcom,mdss-dsi-panel-status-command = <0x6010001 0x10a>;
				qcom,mdss-dsi-panel-status-command-state = "dsi_hs_mode";
				qcom,mdss-dsi-panel-status-read-length = <0x01>;
				qcom,mdss-dsi-panel-status-value = <0x9c>;
				qcom,mdss-dsi-panel-type = "dsi_cmd_mode";
				qcom,mdss-dsi-reset-sequence = <0x01 0x0a 0x00 0x0a 0x01 0x0a>;
				qcom,mdss-dsi-stream = <0x00>;
				qcom,mdss-dsi-t-clk-post = <0x0e>;
				qcom,mdss-dsi-t-clk-pre = <0x31>;
				qcom,mdss-dsi-te-check-enable;
				qcom,mdss-dsi-te-dcs-command = <0x01>;
				qcom,mdss-dsi-te-pin-select = <0x01>;
				qcom,mdss-dsi-te-using-te-pin;
				qcom,mdss-dsi-traffic-mode = "non_burst_sync_event";
				qcom,mdss-dsi-tx-eot-append;
				qcom,mdss-dsi-underflow-color = <0xff>;
				qcom,mdss-dsi-virtual-channel-id = <0x00>;
				qcom,mdss-dsi-wr-mem-continue = <0x3c>;
				qcom,mdss-dsi-wr-mem-start = <0x2c>;
				qcom,panel-supply-entries = <0x01>;
				qcom,platform-reset-gpio = <0xffffffff 0x03 0x00>;
				qcom,platform-te-gpio = <0xffffffff 0x0a 0x00>;
				qcom,ulps-enabled;

				qcom,mdss-dsi-display-timings {

					timing@0 {
						qcom,default-topology-index = <0x00>;
						qcom,display-topology = <0x01 0x00 0x01>;
						qcom,mdss-dsi-h-back-porch = <0x24>;
						qcom,mdss-dsi-h-front-porch = <0x1a>;
						qcom,mdss-dsi-h-pulse-width = <0x02>;
						qcom,mdss-dsi-h-sync-skew = <0x00>;
						qcom,mdss-dsi-off-command = [05 01 00 00 32 00 02 28 00 05 01 00 00 96 00 02 10 00];
						qcom,mdss-dsi-off-command-state = "dsi_hs_mode";
						qcom,mdss-dsi-on-command = [39 01 00 00 00 00 02 fe 00 39 01 00 00 00 00 02 c2 08 39 01 00 00 00 00 02 35 00 39 01 00 00 00 00 02 51 ff 05 01 00 00 96 00 02 11 00 05 01 00 00 32 00 02 29 00];
						qcom,mdss-dsi-on-command-state = "dsi_lp_mode";
						qcom,mdss-dsi-panel-framerate = <0x3c>;
						qcom,mdss-dsi-panel-height = <0x8c8>;
						qcom,mdss-dsi-panel-phy-timings = <0x200808 0x24230808 0x5020400>;
						qcom,mdss-dsi-panel-width = <0x438>;
						qcom,mdss-dsi-v-back-porch = <0x04>;
						qcom,mdss-dsi-v-front-porch = <0x38>;
						qcom,mdss-dsi-v-pulse-width = <0x04>;
					};
				};
			};
		};
	};

	fragment@30 {
		target = <0xffffffff>;

		__overlay__ {
			qcom,dp-aux-switch = <0xffffffff>;
		};
	};

	fragment@31 {
		target = <0xffffffff>;

		__overlay__ {

			lpi_pinctrl@627C0000 {
				#gpio-cells = <0x02>;
				clock-names = "lpass_core_hw_vote\0lpass_audio_hw_vote";
				clocks = <0xffffffff 0x00 0xffffffff 0x00>;
				compatible = "qcom,lpi-pinctrl";
				gpio-controller;
				phandle = <0x2d>;
				qcom,lpi-offset-tbl = <0x00 0x1000 0x2000 0x3000 0x4000 0x5000 0x6000 0x7000 0x8000 0x9000 0xa000 0xb000 0xc000 0xd000 0xe000>;
				qcom,lpi-slew-offset-tbl = <0x00 0x02 0x04 0x08 0x0a 0x0c 0x00 0x00 0x00 0x00 0x10 0x12 0x00 0x00 0x00>;
				qcom,num-gpios = <0x0f>;
				qcom,slew-reg = <0x6295a000 0x00>;
				reg = <0x627c0000 0x00>;

				dmic01_clk_active {
					phandle = <0x2f>;

					config {
						drive-strength = <0x08>;
						output-high;
						pins = "gpio6";
					};

					mux {
						function = "func1";
						pins = "gpio6";
					};
				};

				dmic01_clk_sleep {
					phandle = <0x31>;

					config {
						bias-disable;
						drive-strength = <0x02>;
						output-low;
						pins = "gpio6";
					};

					mux {
						function = "func1";
						pins = "gpio6";
					};
				};

				dmic01_data_active {
					phandle = <0x30>;

					config {
						drive-strength = <0x08>;
						input-enable;
						pins = "gpio7";
					};

					mux {
						function = "func1";
						pins = "gpio7";
					};
				};

				dmic01_data_sleep {
					phandle = <0x32>;

					config {
						drive-strength = <0x02>;
						input-enable;
						pins = "gpio7";
						pull-down;
					};

					mux {
						function = "func1";
						pins = "gpio7";
					};
				};

				dmic23_clk_active {
					phandle = <0x33>;

					config {
						drive-strength = <0x08>;
						output-high;
						pins = "gpio8";
					};

					mux {
						function = "func1";
						pins = "gpio8";
					};
				};

				dmic23_clk_sleep {
					phandle = <0x35>;

					config {
						bias-disable;
						drive-strength = <0x02>;
						output-low;
						pins = "gpio8";
					};

					mux {
						function = "func1";
						pins = "gpio8";
					};
				};

				dmic23_data_active {
					phandle = <0x34>;

					config {
						drive-strength = <0x08>;
						input-enable;
						pins = "gpio9";
					};

					mux {
						function = "func1";
						pins = "gpio9";
					};
				};

				dmic23_data_sleep {
					phandle = <0x36>;

					config {
						drive-strength = <0x02>;
						input-enable;
						pins = "gpio9";
						pull-down;
					};

					mux {
						function = "func1";
						pins = "gpio9";
					};
				};

				dmic45_clk_active {
					phandle = <0x37>;

					config {
						drive-strength = <0x08>;
						output-high;
						pins = "gpio12";
					};

					mux {
						function = "func1";
						pins = "gpio12";
					};
				};

				dmic45_clk_sleep {
					phandle = <0x39>;

					config {
						bias-disable;
						drive-strength = <0x02>;
						output-low;
						pins = "gpio12";
					};

					mux {
						function = "func1";
						pins = "gpio12";
					};
				};

				dmic45_data_active {
					phandle = <0x38>;

					config {
						drive-strength = <0x08>;
						input-enable;
						pins = "gpio13";
					};

					mux {
						function = "func1";
						pins = "gpio13";
					};
				};

				dmic45_data_sleep {
					phandle = <0x3a>;

					config {
						drive-strength = <0x02>;
						input-enable;
						pins = "gpio13";
						pull-down;
					};

					mux {
						function = "func1";
						pins = "gpio13";
					};
				};

				quin_mi2s_sck_active {
					phandle = <0x4b>;

					config {
						bias-disable;
						drive-strength = <0x08>;
						output-high;
						pins = "gpio6";
					};

					mux {
						function = "func2";
						pins = "gpio6";
					};
				};

				quin_mi2s_sck_sleep {
					phandle = <0x4f>;

					config {
						bias-pull-down;
						drive-strength = <0x02>;
						input-enable;
						pins = "gpio6";
					};

					mux {
						function = "func2";
						pins = "gpio6";
					};
				};

				quin_mi2s_sd0_active {
					phandle = <0x4d>;

					config {
						bias-disable;
						drive-strength = <0x08>;
						output-high;
						pins = "gpio8";
					};

					mux {
						function = "func2";
						pins = "gpio8";
					};
				};

				quin_mi2s_sd0_sleep {
					phandle = <0x51>;

					config {
						bias-pull-down;
						drive-strength = <0x02>;
						input-enable;
						pins = "gpio8";
					};

					mux {
						function = "func2";
						pins = "gpio8";
					};
				};

				quin_mi2s_sd1_active {
					phandle = <0x4e>;

					config {
						bias-disable;
						drive-strength = <0x08>;
						output-high;
						pins = "gpio9";
					};

					mux {
						function = "func2";
						pins = "gpio9";
					};
				};

				quin_mi2s_sd1_sleep {
					phandle = <0x52>;

					config {
						bias-pull-down;
						drive-strength = <0x02>;
						input-enable;
						pins = "gpio9";
					};

					mux {
						function = "func2";
						pins = "gpio9";
					};
				};

				quin_mi2s_ws_active {
					phandle = <0x4c>;

					config {
						bias-disable;
						drive-strength = <0x08>;
						output-high;
						pins = "gpio7";
					};

					mux {
						function = "func2";
						pins = "gpio7";
					};
				};

				quin_mi2s_ws_sleep {
					phandle = <0x50>;

					config {
						bias-pull-down;
						drive-strength = <0x02>;
						input-enable;
						pins = "gpio7";
					};

					mux {
						function = "func2";
						pins = "gpio7";
					};
				};

				rx_swr_clk_active {
					phandle = <0x3f>;

					config {
						bias-disable;
						drive-strength = <0x0a>;
						pins = "gpio3";
						slew-rate = <0x03>;
					};

					mux {
						function = "func1";
						pins = "gpio3";
					};
				};

				rx_swr_clk_sleep {
					phandle = <0x41>;

					config {
						bias-bus-hold;
						drive-strength = <0x0a>;
						pins = "gpio3";
					};

					mux {
						function = "func1";
						pins = "gpio3";
					};
				};

				rx_swr_data_active {
					phandle = <0x40>;

					config {
						bias-bus-hold;
						drive-strength = <0x0a>;
						pins = "gpio4\0gpio5";
						slew-rate = <0x03>;
					};

					mux {
						function = "func1";
						pins = "gpio4\0gpio5";
					};
				};

				rx_swr_data_sleep {
					phandle = <0x42>;

					config {
						bias-bus-hold;
						drive-strength = <0x0a>;
						pins = "gpio4\0gpio5";
					};

					mux {
						function = "func1";
						pins = "gpio4\0gpio5";
					};
				};

				tx_swr_clk_active {
					phandle = <0x43>;

					config {
						bias-disable;
						drive-strength = <0x0a>;
						pins = "gpio0";
						slew-rate = <0x03>;
					};

					mux {
						function = "func1";
						pins = "gpio0";
					};
				};

				tx_swr_clk_sleep {
					phandle = <0x47>;

					config {
						bias-bus-hold;
						drive-strength = <0x0a>;
						pins = "gpio0";
					};

					mux {
						function = "func1";
						pins = "gpio0";
					};
				};

				tx_swr_data0_active {
					phandle = <0x44>;

					config {
						bias-bus-hold;
						drive-strength = <0x0a>;
						pins = "gpio1";
						slew-rate = <0x03>;
					};

					mux {
						function = "func1";
						pins = "gpio1";
					};
				};

				tx_swr_data0_sleep {
					phandle = <0x48>;

					config {
						bias-bus-hold;
						drive-strength = <0x0a>;
						pins = "gpio1";
					};

					mux {
						function = "func1";
						pins = "gpio1";
					};
				};

				tx_swr_data1_active {
					phandle = <0x45>;

					config {
						bias-bus-hold;
						drive-strength = <0x0a>;
						pins = "gpio2";
						slew-rate = <0x03>;
					};

					mux {
						function = "func1";
						pins = "gpio2";
					};
				};

				tx_swr_data1_sleep {
					phandle = <0x49>;

					config {
						bias-bus-hold;
						drive-strength = <0x0a>;
						pins = "gpio2";
					};

					mux {
						function = "func1";
						pins = "gpio2";
					};
				};

				tx_swr_data2_active {
					phandle = <0x46>;

					config {
						bias-bus-hold;
						drive-strength = <0x0a>;
						pins = "gpio14";
						slew-rate = <0x03>;
					};

					mux {
						function = "func1";
						pins = "gpio14";
					};
				};

				tx_swr_data2_sleep {
					phandle = <0x4a>;

					config {
						bias-bus-hold;
						drive-strength = <0x0a>;
						pins = "gpio14";
					};

					mux {
						function = "func1";
						pins = "gpio14";
					};
				};

				wsa_swr_clk_active {
					phandle = <0x3b>;

					config {
						bias-bus-hold;
						drive-strength = <0x0a>;
						pins = "gpio10";
						slew-rate = <0x03>;
					};

					mux {
						function = "func2";
						pins = "gpio10";
					};
				};

				wsa_swr_clk_sleep {
					phandle = <0x3d>;

					config {
						bias-bus-hold;
						drive-strength = <0x0a>;
						pins = "gpio10";
					};

					mux {
						function = "func2";
						pins = "gpio10";
					};
				};

				wsa_swr_data_active {
					phandle = <0x3c>;

					config {
						bias-bus-hold;
						drive-strength = <0x0a>;
						pins = "gpio11";
						slew-rate = <0x03>;
					};

					mux {
						function = "func2";
						pins = "gpio11";
					};
				};

				wsa_swr_data_sleep {
					phandle = <0x3e>;

					config {
						bias-bus-hold;
						drive-strength = <0x0a>;
						pins = "gpio11";
					};

					mux {
						function = "func2";
						pins = "gpio11";
					};
				};
			};
		};
	};

	fragment@32 {
		target = <0xffffffff>;

		__overlay__ {
			qcom,num-macros = <0x03>;

			bolero-clk-rsc-mngr {
				clock-names = "tx_core_clk\0tx_npl_clk\0rx_core_clk\0rx_npl_clk\0wsa_core_clk\0wsa_npl_clk\0va_core_clk\0va_npl_clk";
				clocks = <0x12 0x00 0x13 0x00 0x14 0x00 0x15 0x00 0x16 0x00 0x17 0x00 0x18 0x00 0x19 0x00>;
				compatible = "qcom,bolero-clk-rsc-mngr";
				qcom,fs-gen-sequence = <0x3000 0x01 0x3004 0x01 0x3080 0x02>;
				qcom,rx_mclk_mode_muxsel = <0x627240d8>;
				qcom,va_mclk_mode_muxsel = "bz\0";
				qcom,wsa_mclk_mode_muxsel = <0x627220d8>;
			};

			rx-macro@62600000 {
				clock-names = "rx_core_clk\0rx_npl_clk";
				clocks = <0x14 0x00 0x15 0x00>;
				compatible = "qcom,rx-macro";
				phandle = <0x5c>;
				qcom,default-clk-id = <0x00>;
				qcom,rx-bcl-pmic-params = [00 00 1e];
				qcom,rx-swr-gpios = <0x1b>;
				qcom,rx_mclk_mode_muxsel = <0x627240d8>;
				reg = <0x62600000 0x00>;

				rx_swr_master {
					#address-cells = <0x02>;
					#size-cells = <0x00>;
					clock-names = "lpass_core_hw_vote\0lpass_audio_hw_vote";
					clocks = <0xffffffff 0x00 0xffffffff 0x00>;
					compatible = "qcom,swr-mstr";
					interrupt-names = "swr_master_irq";
					interrupts = <0x00 0x129 0x00>;
					phandle = <0x5d>;
					qcom,swr-clock-stop-mode0 = <0x01>;
					qcom,swr-num-dev = <0x01>;
					qcom,swr-num-ports = <0x05>;
					qcom,swr-port-mapping = <0x01 0x09 0x01 0x01 0x0a 0x02 0x02 0x0d 0x01 0x03 0x0b 0x01 0x03 0x0c 0x02 0x04 0x0e 0x01 0x05 0x0f 0x01 0x05 0x10 0x02>;
					qcom,swr_master_id = <0x02>;
					swrm-io-base = <0x62610000 0x00>;

					wcd937x-rx-slave {
						compatible = "qcom,wcd937x-slave";
						phandle = <0x22>;
						reg = <0x0a 0x1170224>;
					};

					wcd938x-rx-slave {
						compatible = "qcom,wcd938x-slave";
						phandle = <0x20>;
						reg = <0x0d 0x1170224>;
						status = "disabled";
					};
				};
			};

			tx-macro@62620000 {
				clock-names = "tx_core_clk\0tx_npl_clk";
				clocks = <0x12 0x00 0x13 0x00>;
				compatible = "qcom,tx-macro";
				phandle = <0x5a>;
				qcom,tx-dmic-sample-rate = <0x249f00>;
				qcom,tx-swr-gpios = <0x1a>;
				reg = <0x62620000 0x00>;

				tx_swr_master {
					#address-cells = <0x02>;
					#size-cells = <0x00>;
					clock-names = "lpass_core_hw_vote\0lpass_audio_hw_vote";
					clocks = <0xffffffff 0x00 0xffffffff 0x00>;
					compatible = "qcom,swr-mstr";
					interrupt-names = "swr_master_irq\0swr_wake_irq";
					interrupts = <0x00 0x128 0x00 0x00 0x22b 0x00>;
					phandle = <0x5b>;
					qcom,mipi-sdw-block-packing-mode = <0x01>;
					qcom,swr-clock-stop-mode0 = <0x01>;
					qcom,swr-mstr-irq-wakeup-capable = <0x01>;
					qcom,swr-num-dev = <0x01>;
					qcom,swr-num-ports = <0x05>;
					qcom,swr-port-mapping = <0x01 0x21 0x0f 0x02 0x12 0x01 0x02 0x13 0x02 0x03 0x14 0x01 0x03 0x15 0x02 0x04 0x16 0x01 0x04 0x17 0x02 0x04 0x18 0x04 0x04 0x19 0x08 0x05 0x1a 0x01 0x05 0x1b 0x02 0x05 0x1c 0x04 0x05 0x1d 0x08>;
					qcom,swr-wakeup-required = <0x00>;
					qcom,swr_master_id = <0x03>;
					swrm-io-base = <0x62630000 0x00>;

					wcd937x-tx-slave {
						compatible = "qcom,wcd937x-slave";
						phandle = <0x23>;
						reg = <0x0a 0x1170223>;
					};

					wcd938x-tx-slave {
						compatible = "qcom,wcd938x-slave";
						phandle = <0x21>;
						reg = <0x0d 0x1170223>;
						status = "disabled";
					};
				};
			};

			va-macro@62770000 {
				clock-names = "lpass_audio_hw_vote";
				clocks = <0xffffffff 0x00>;
				compatible = "qcom,va-macro";
				phandle = <0x60>;
				qcom,default-clk-id = <0x00>;
				qcom,va-clk-mux-select = <0x01>;
				qcom,va-dmic-sample-rate = <0x927c0>;
				qcom,va-island-mode-muxsel = "bz\0";
				reg = <0x62770000 0x00>;
			};

			wcd937x-codec {
				cdc-vdd-buck-supply = <0xffffffff>;
				cdc-vdd-ldo-rxtx-supply = <0xffffffff>;
				cdc-vdd-mic-bias-supply = <0xffffffff>;
				cdc-vddpx-1-supply = <0xffffffff>;
				compatible = "qcom,wcd937x-codec";
				phandle = <0x2c>;
				qcom,cdc-micbias1-mv = <0xa8c>;
				qcom,cdc-micbias2-mv = <0xa8c>;
				qcom,cdc-micbias3-mv = <0xa8c>;
				qcom,cdc-on-demand-supplies = "cdc-vdd-buck";
				qcom,cdc-static-supplies = "cdc-vdd-ldo-rxtx\0cdc-vddpx-1\0cdc-vdd-mic-bias";
				qcom,cdc-vdd-buck-current = <0x9eb10>;
				qcom,cdc-vdd-buck-voltage = <0x1b7740 0x1b7740>;
				qcom,cdc-vdd-ldo-rxtx-current = <0x61a8>;
				qcom,cdc-vdd-ldo-rxtx-voltage = <0x1b7740 0x1b7740>;
				qcom,cdc-vdd-mic-bias-current = <0x7530>;
				qcom,cdc-vdd-mic-bias-voltage = <0x325aa0 0x325aa0>;
				qcom,cdc-vddpx-1-current = <0x2710>;
				qcom,cdc-vddpx-1-voltage = <0x1b7740 0x1b7740>;
				qcom,rx-slave = <0x22>;
				qcom,rx_swr_ch_map = <0x00 0x09 0x01 0x00 0x09 0x00 0x0a 0x02 0x00 0x0a 0x01 0x0d 0x01 0x00 0x0d 0x02 0x0b 0x01 0x00 0x0b 0x02 0x0c 0x02 0x00 0x0c 0x03 0x0e 0x01 0x00 0x0e 0x04 0x0f 0x01 0x00 0x0f 0x04 0x10 0x02 0x00 0x10>;
				qcom,split-codec = <0x01>;
				qcom,tx-slave = <0x23>;
				qcom,tx_swr_ch_map = <0x00 0x12 0x01 0x00 0x12 0x01 0x13 0x01 0x00 0x14 0x01 0x14 0x02 0x00 0x15 0x02 0x16 0x01 0x00 0x16 0x02 0x17 0x02 0x00 0x17 0x02 0x11 0x04 0x00 0x18 0x03 0x18 0x01 0x00 0x1a 0x03 0x19 0x02 0x00 0x1b 0x03 0x1a 0x04 0x00 0x1c 0x03 0x1b 0x08 0x00 0x1d>;
				qcom,wcd-rst-gpio-node = <0x1f>;
			};

			wcd938x-codec {
				cdc-vdd-buck-supply = <0xffffffff>;
				cdc-vdd-mic-bias-supply = <0xffffffff>;
				cdc-vdd-rxtx-supply = <0xffffffff>;
				cdc-vddio-supply = <0xffffffff>;
				compatible = "qcom,wcd938x-codec";
				phandle = <0x61>;
				qcom,cdc-micbias1-mv = <0x708>;
				qcom,cdc-micbias2-mv = <0x708>;
				qcom,cdc-micbias3-mv = <0x708>;
				qcom,cdc-micbias4-mv = <0x708>;
				qcom,cdc-on-demand-supplies = "cdc-vdd-buck";
				qcom,cdc-static-supplies = "cdc-vdd-rxtx\0cdc-vddio\0cdc-vdd-mic-bias";
				qcom,cdc-vdd-buck-current = <0x9eb10>;
				qcom,cdc-vdd-buck-voltage = <0x1b7740 0x1b7740>;
				qcom,cdc-vdd-mic-bias-current = <0x7530>;
				qcom,cdc-vdd-mic-bias-voltage = <0x325aa0 0x325aa0>;
				qcom,cdc-vdd-rxtx-current = <0x7530>;
				qcom,cdc-vdd-rxtx-voltage = <0x1b7740 0x1b7740>;
				qcom,cdc-vddio-current = <0x7530>;
				qcom,cdc-vddio-voltage = <0x1b7740 0x1b7740>;
				qcom,rx-slave = <0x20>;
				qcom,rx_swr_ch_map = <0x00 0x09 0x01 0x00 0x09 0x00 0x0a 0x02 0x00 0x0a 0x01 0x0d 0x01 0x00 0x0d 0x02 0x0b 0x01 0x00 0x0b 0x02 0x0c 0x02 0x00 0x0c 0x03 0x0e 0x01 0x00 0x0e 0x04 0x0f 0x01 0x00 0x0f 0x04 0x10 0x02 0x00 0x10>;
				qcom,split-codec = <0x01>;
				qcom,tx-slave = <0x21>;
				qcom,tx_swr_ch_map = <0x00 0x12 0x01 0x00 0x12 0x00 0x13 0x02 0x00 0x13 0x01 0x14 0x01 0x00 0x14 0x01 0x15 0x02 0x00 0x15 0x02 0x16 0x01 0x00 0x16 0x02 0x17 0x02 0x00 0x17 0x02 0x11 0x04 0x00 0x18 0x02 0x18 0x04 0x00 0x18 0x02 0x19 0x08 0x00 0x19 0x03 0x1a 0x01 0x00 0x1a 0x03 0x1b 0x02 0x00 0x1b 0x03 0x1c 0x04 0x00 0x1c 0x03 0x1d 0x08 0x00 0x1d>;
				qcom,wcd-rst-gpio-node = <0x1f>;
				status = "disabled";
			};

			wsa-macro@62640000 {
				clock-names = "wsa_core_clk\0wsa_npl_clk";
				clocks = <0x16 0x00 0x17 0x00>;
				compatible = "qcom,wsa-macro";
				phandle = <0x5e>;
				qcom,default-clk-id = <0x00>;
				qcom,wsa-bcl-pmic-params = [00 00 1e];
				qcom,wsa-swr-gpios = <0x1c>;
				qcom,wsa_mclk_mode_muxsel = <0x627220d8>;
				reg = <0x62640000 0x00>;
				status = "disabled";

				wsa_swr_master {
					#address-cells = <0x02>;
					#size-cells = <0x00>;
					clock-names = "lpass_core_hw_vote\0lpass_audio_hw_vote";
					clocks = <0xffffffff 0x00 0xffffffff 0x00>;
					compatible = "qcom,swr-mstr";
					interrupt-names = "swr_master_irq";
					interrupts = <0x00 0x127 0x00>;
					phandle = <0x5f>;
					qcom,mipi-sdw-block-packing-mode = <0x00>;
					qcom,swr-num-dev = <0x02>;
					qcom,swr-num-ports = <0x08>;
					qcom,swr-port-mapping = <0x01 0x01 0x01 0x02 0x03 0x0f 0x03 0x02 0x03 0x04 0x05 0x01 0x05 0x07 0x0f 0x06 0x06 0x03 0x07 0x04 0x03 0x08 0x08 0x03>;
					qcom,swr_master_id = <0x01>;
					swrm-io-base = <0x62650000 0x00>;

					wsa881x@20170211 {
						compatible = "qcom,wsa881x";
						phandle = <0x28>;
						qcom,bolero-handle = <0xffffffff>;
						qcom,spkr-sd-n-node = <0x1d>;
						reg = <0x10 0x20170211>;
					};

					wsa881x@20170212 {
						compatible = "qcom,wsa881x";
						phandle = <0x29>;
						qcom,bolero-handle = <0xffffffff>;
						qcom,spkr-sd-n-node = <0x1e>;
						reg = <0x10 0x20170212>;
					};

					wsa881x@21170213 {
						compatible = "qcom,wsa881x";
						phandle = <0x2a>;
						qcom,bolero-handle = <0xffffffff>;
						qcom,spkr-sd-n-node = <0x1d>;
						reg = <0x10 0x21170213>;
					};

					wsa881x@21170214 {
						compatible = "qcom,wsa881x";
						phandle = <0x2b>;
						qcom,bolero-handle = <0xffffffff>;
						qcom,spkr-sd-n-node = <0x1e>;
						reg = <0x10 0x21170214>;
					};
				};
			};
		};
	};

	fragment@33 {
		target = <0xffffffff>;

		__overlay__ {
			asoc-codec = <0xffffffff 0xffffffff 0x27>;
			asoc-codec-names = "msm-stub-codec.1\0bolero_codec\0msm-ext-disp-audio-codec-rx";
			qcom,audio-routing = "AMIC1\0MIC BIAS1\0MIC BIAS1\0Analog Mic1\0AMIC2\0MIC BIAS2\0MIC BIAS2\0Analog Mic2\0AMIC3\0MIC BIAS3\0MIC BIAS3\0Analog Mic3\0AMIC4\0MIC BIAS4\0MIC BIAS4\0Analog Mic4\0TX DMIC0\0MIC BIAS1\0MIC BIAS1\0Digital Mic0\0TX DMIC1\0MIC BIAS1\0MIC BIAS1\0Digital Mic1\0TX DMIC2\0MIC BIAS3\0MIC BIAS3\0Digital Mic2\0TX DMIC3\0MIC BIAS3\0MIC BIAS3\0Digital Mic3\0TX DMIC4\0MIC BIAS4\0MIC BIAS4\0Digital Mic4\0IN1_HPHL\0HPHL_OUT\0IN2_HPHR\0HPHR_OUT\0IN3_AUX\0AUX_OUT\0TX SWR_ADC0\0ADC1_OUTPUT\0TX SWR_ADC1\0ADC2_OUTPUT\0TX SWR_ADC2\0ADC3_OUTPUT\0TX SWR_ADC3\0ADC4_OUTPUT\0TX SWR_DMIC0\0DMIC1_OUTPUT\0TX SWR_DMIC1\0DMIC2_OUTPUT\0TX SWR_DMIC2\0DMIC3_OUTPUT\0TX SWR_DMIC3\0DMIC4_OUTPUT\0TX SWR_DMIC4\0DMIC5_OUTPUT\0TX SWR_DMIC5\0DMIC6_OUTPUT\0TX SWR_DMIC6\0DMIC7_OUTPUT\0TX SWR_DMIC7\0DMIC8_OUTPUT\0WSA SRC0_INP\0SRC0\0WSA_TX DEC0_INP\0TX DEC0 MUX\0WSA_TX DEC1_INP\0TX DEC1 MUX\0RX_TX DEC0_INP\0TX DEC0 MUX\0RX_TX DEC1_INP\0TX DEC1 MUX\0RX_TX DEC2_INP\0TX DEC2 MUX\0RX_TX DEC3_INP\0TX DEC3 MUX\0SpkrLeft IN\0WSA_SPK1 OUT\0SpkrRight IN\0WSA_SPK2 OUT\0VA_AIF1 CAP\0VA_SWR_CLK\0VA_AIF2 CAP\0VA_SWR_CLK\0VA_AIF3 CAP\0VA_SWR_CLK\0VA MIC BIAS1\0Digital Mic0\0VA MIC BIAS1\0Digital Mic1\0VA MIC BIAS3\0Digital Mic2\0VA MIC BIAS3\0Digital Mic3\0VA MIC BIAS4\0Digital Mic4\0VA DMIC0\0VA MIC BIAS1\0VA DMIC1\0VA MIC BIAS1\0VA DMIC2\0VA MIC BIAS3\0VA DMIC3\0VA MIC BIAS3\0VA DMIC4\0VA MIC BIAS4\0VA SWR_ADC0\0VA_SWR_CLK\0VA SWR_ADC1\0VA_SWR_CLK\0VA SWR_ADC2\0VA_SWR_CLK\0VA SWR_ADC3\0VA_SWR_CLK\0VA SWR_MIC0\0VA_SWR_CLK\0VA SWR_MIC1\0VA_SWR_CLK\0VA SWR_MIC2\0VA_SWR_CLK\0VA SWR_MIC3\0VA_SWR_CLK\0VA SWR_MIC4\0VA_SWR_CLK\0VA SWR_MIC5\0VA_SWR_CLK\0VA SWR_MIC6\0VA_SWR_CLK\0VA SWR_MIC7\0VA_SWR_CLK\0VA SWR_ADC0\0ADC1_OUTPUT\0VA SWR_ADC1\0ADC2_OUTPUT\0VA SWR_ADC2\0ADC3_OUTPUT\0VA SWR_ADC3\0ADC4_OUTPUT\0VA SWR_MIC0\0DMIC1_OUTPUT\0VA SWR_MIC1\0DMIC2_OUTPUT\0VA SWR_MIC2\0DMIC3_OUTPUT\0VA SWR_MIC3\0DMIC4_OUTPUT\0VA SWR_MIC4\0DMIC5_OUTPUT\0VA SWR_MIC5\0DMIC6_OUTPUT\0VA SWR_MIC6\0DMIC7_OUTPUT\0VA SWR_MIC7\0DMIC8_OUTPUT";
			qcom,cdc-dmic01-gpios = <0x24>;
			qcom,cdc-dmic23-gpios = <0x25>;
			qcom,cdc-dmic45-gpios = <0x26>;
			qcom,codec-aux-devs = <0x2c>;
			qcom,codec-max-aux-devs = <0x01>;
			qcom,model = "atoll-idp-snd-card";
			qcom,msm-mbhc-gnd-swh = <0x01>;
			qcom,msm-mbhc-hphl-swh = <0x01>;
			qcom,msm-mi2s-master = <0x01 0x01 0x01 0x01 0x01 0x01>;
			qcom,msm_audio_ssr_devs = <0xffffffff 0xffffffff 0x2d 0xffffffff>;
			qcom,tert-mi2s-gpios = <0x2e>;
			qcom,wsa-aux-dev-prefix = "SpkrLeft\0SpkrRight\0SpkrLeft\0SpkrRight";
			qcom,wsa-devs = <0x28 0x29 0x2a 0x2b>;
			qcom,wsa-max-devs = <0x00>;
		};
	};

	fragment@34 {
		target = <0xffffffff>;

		__overlay__ {

			cdc_dmic01_pinctrl {
				compatible = "qcom,msm-cdc-pinctrl";
				phandle = <0x24>;
				pinctrl-0 = <0x2f 0x30>;
				pinctrl-1 = <0x31 0x32>;
				pinctrl-names = "aud_active\0aud_sleep";
				qcom,lpi-gpios;
			};

			cdc_dmic23_pinctrl {
				compatible = "qcom,msm-cdc-pinctrl";
				phandle = <0x25>;
				pinctrl-0 = <0x33 0x34>;
				pinctrl-1 = <0x35 0x36>;
				pinctrl-names = "aud_active\0aud_sleep";
				qcom,lpi-gpios;
			};

			cdc_dmic45_pinctrl {
				compatible = "qcom,msm-cdc-pinctrl";
				phandle = <0x26>;
				pinctrl-0 = <0x37 0x38>;
				pinctrl-1 = <0x39 0x3a>;
				pinctrl-names = "aud_active\0aud_sleep";
				qcom,lpi-gpios;
			};

			msm_cdc_pinctrl_quin {
				compatible = "qcom,msm-cdc-pinctrl";
				phandle = <0x62>;
				pinctrl-0 = <0x4b 0x4c 0x4d 0x4e>;
				pinctrl-1 = <0x4f 0x50 0x51 0x52>;
				pinctrl-names = "aud_active\0aud_sleep";
				qcom,lpi-gpios;
			};

			rx_swr_clk_data_pinctrl {
				compatible = "qcom,msm-cdc-pinctrl";
				phandle = <0x1b>;
				pinctrl-0 = <0x3f 0x40>;
				pinctrl-1 = <0x41 0x42>;
				pinctrl-names = "aud_active\0aud_sleep";
				qcom,lpi-gpios;
			};

			tx_swr_clk_data_pinctrl {
				compatible = "qcom,msm-cdc-pinctrl";
				phandle = <0x1a>;
				pinctrl-0 = <0x43 0x44 0x45 0x46>;
				pinctrl-1 = <0x47 0x48 0x49 0x4a>;
				pinctrl-names = "aud_active\0aud_sleep";
				qcom,chip-wakeup-default-val = <0x01>;
				qcom,chip-wakeup-maskbit = <0x00>;
				qcom,chip-wakeup-reg = <0x1ffb000>;
				qcom,lpi-gpios;
			};

			wsa_swr_clk_data_pinctrl {
				compatible = "qcom,msm-cdc-pinctrl";
				phandle = <0x1c>;
				pinctrl-0 = <0x3b 0x3c>;
				pinctrl-1 = <0x3d 0x3e>;
				pinctrl-names = "aud_active\0aud_sleep";
				qcom,lpi-gpios;
				status = "disabled";
			};
		};
	};

	fragment@35 {
		target = <0xffffffff>;

		__overlay__ {

			msm_cdc_pinctrl@58 {
				compatible = "qcom,msm-cdc-pinctrl";
				phandle = <0x1f>;
				pinctrl-0 = <0xffffffff>;
				pinctrl-1 = <0xffffffff>;
				pinctrl-names = "aud_active\0aud_sleep";
			};

			msm_cdc_pinctrl_pri {
				compatible = "qcom,msm-cdc-pinctrl";
				phandle = <0x2e>;
				pinctrl-0 = <0xffffffff 0xffffffff 0xffffffff 0xffffffff>;
				pinctrl-1 = <0xffffffff 0xffffffff 0xffffffff 0xffffffff>;
				pinctrl-names = "aud_active\0aud_sleep";
			};

			rx_core_clk {
				#clock-cells = <0x01>;
				compatible = "qcom,audio-ref-clk";
				phandle = <0x14>;
				qcom,codec-ext-clk-src = <0x05>;
				qcom,codec-lpass-clk-id = <0x30e>;
				qcom,codec-lpass-ext-clk-freq = <0x1588800>;
			};

			rx_npl_clk {
				#clock-cells = <0x01>;
				compatible = "qcom,audio-ref-clk";
				phandle = <0x15>;
				qcom,codec-ext-clk-src = <0x06>;
				qcom,codec-lpass-clk-id = <0x30f>;
				qcom,codec-lpass-ext-clk-freq = <0x1588800>;
			};

			tx_core_clk {
				#clock-cells = <0x01>;
				compatible = "qcom,audio-ref-clk";
				phandle = <0x12>;
				qcom,codec-ext-clk-src = <0x07>;
				qcom,codec-lpass-clk-id = <0x30c>;
				qcom,codec-lpass-ext-clk-freq = <0x124f800>;
			};

			tx_npl_clk {
				#clock-cells = <0x01>;
				compatible = "qcom,audio-ref-clk";
				phandle = <0x13>;
				qcom,codec-ext-clk-src = <0x08>;
				qcom,codec-lpass-clk-id = <0x30d>;
				qcom,codec-lpass-ext-clk-freq = <0x124f800>;
			};

			va_core_clk {
				#clock-cells = <0x01>;
				compatible = "qcom,audio-ref-clk";
				phandle = <0x18>;
				qcom,codec-ext-clk-src = <0x02>;
				qcom,codec-lpass-clk-id = <0x30b>;
				qcom,codec-lpass-ext-clk-freq = <0x124f800>;
			};

			va_npl_clk {
				#clock-cells = <0x01>;
				compatible = "qcom,audio-ref-clk";
				phandle = <0x19>;
				qcom,codec-ext-clk-src = <0x0a>;
				qcom,codec-lpass-clk-id = <0x310>;
				qcom,codec-lpass-ext-clk-freq = <0x124f800>;
			};

			wsa_core_clk {
				#clock-cells = <0x01>;
				compatible = "qcom,audio-ref-clk";
				phandle = <0x16>;
				qcom,codec-ext-clk-src = <0x03>;
				qcom,codec-lpass-clk-id = <0x309>;
				qcom,codec-lpass-ext-clk-freq = <0x124f800>;
			};

			wsa_npl_clk {
				#clock-cells = <0x01>;
				compatible = "qcom,audio-ref-clk";
				phandle = <0x17>;
				qcom,codec-ext-clk-src = <0x04>;
				qcom,codec-lpass-clk-id = <0x30a>;
				qcom,codec-lpass-ext-clk-freq = <0x124f800>;
			};

			wsa_spkr_en1_pinctrl {
				compatible = "qcom,msm-cdc-pinctrl";
				phandle = <0x1d>;
				pinctrl-0 = <0xffffffff>;
				pinctrl-1 = <0xffffffff>;
				pinctrl-names = "aud_active\0aud_sleep";
				status = "disabled";
			};

			wsa_spkr_en2_pinctrl {
				compatible = "qcom,msm-cdc-pinctrl";
				phandle = <0x1e>;
				pinctrl-0 = <0xffffffff>;
				pinctrl-1 = <0xffffffff>;
				pinctrl-names = "aud_active\0aud_sleep";
				status = "disabled";
			};
		};
	};

	fragment@36 {
		target = <0xffffffff>;

		__overlay__ {
			qcom,msm-dai-is-island-supported = <0x01>;
		};
	};

	fragment@4 {
		target = <0xffffffff>;

		__overlay__ {

			qcom,mdss_dsi_sim_video {
				phandle = <0x05>;
				qcom,mdss-dsi-bl-pmic-control-type = "bl_ctrl_dcs";
				qcom,mdss-dsi-bllp-eof-power-mode;
				qcom,mdss-dsi-bllp-power-mode;
				qcom,mdss-dsi-border-color = <0x00>;
				qcom,mdss-dsi-bpp = <0x18>;
				qcom,mdss-dsi-dma-trigger = "trigger_sw";
				qcom,mdss-dsi-lane-0-state;
				qcom,mdss-dsi-lane-1-state;
				qcom,mdss-dsi-lane-2-state;
				qcom,mdss-dsi-lane-3-state;
				qcom,mdss-dsi-mdp-trigger = "none";
				qcom,mdss-dsi-panel-blackness-level = <0xc9e>;
				qcom,mdss-dsi-panel-hdr-color-primaries = <0x38a4 0x3c8c 0x7d00 0x4268 0x3c8c 0x7530 0x1f40 0xbb8>;
				qcom,mdss-dsi-panel-hdr-enabled;
				qcom,mdss-dsi-panel-mode-switch;
				qcom,mdss-dsi-panel-name = "Simulator video mode dsi panel";
				qcom,mdss-dsi-panel-peak-brightness = <0x401640>;
				qcom,mdss-dsi-panel-type = "dsi_video_mode";
				qcom,mdss-dsi-reset-sequence = <0x01 0x00 0x00 0x00 0x01 0x00>;
				qcom,mdss-dsi-stream = <0x00>;
				qcom,mdss-dsi-t-clk-post = <0x0d>;
				qcom,mdss-dsi-t-clk-pre = <0x2d>;
				qcom,mdss-dsi-te-check-enable;
				qcom,mdss-dsi-te-dcs-command = <0x01>;
				qcom,mdss-dsi-te-pin-select = <0x01>;
				qcom,mdss-dsi-te-using-wd;
				qcom,mdss-dsi-traffic-mode = "non_burst_sync_event";
				qcom,mdss-dsi-underflow-color = <0xff>;
				qcom,mdss-dsi-virtual-channel-id = <0x00>;
				qcom,mdss-dsi-wr-mem-continue = <0x3c>;
				qcom,mdss-dsi-wr-mem-start = <0x2c>;
				qcom,panel-ack-disabled;
				qcom,panel-supply-entries = <0x02>;
				qcom,platform-reset-gpio = <0xffffffff 0x03 0x00>;

				qcom,mdss-dsi-display-timings {

					timing@0 {
						qcom,cmd-to-video-mode-post-switch-commands = [32 01 00 00 00 00 02 00 00];
						qcom,cmd-to-video-mode-post-switch-commands-state = "dsi_lp_mode";
						qcom,default-topology-index = <0x00>;
						qcom,display-topology = <0x01 0x00 0x01 0x02 0x00 0x01>;
						qcom,mdss-dsi-h-back-porch = <0x08>;
						qcom,mdss-dsi-h-front-porch = <0x08>;
						qcom,mdss-dsi-h-left-border = <0x00>;
						qcom,mdss-dsi-h-pulse-width = <0x08>;
						qcom,mdss-dsi-h-right-border = <0x00>;
						qcom,mdss-dsi-h-sync-pulse = <0x00>;
						qcom,mdss-dsi-h-sync-skew = <0x00>;
						qcom,mdss-dsi-off-command = [22 01 00 00 00 00 02 00 00];
						qcom,mdss-dsi-off-command-state = "dsi_lp_mode";
						qcom,mdss-dsi-on-command = [32 01 00 00 00 00 02 00 00];
						qcom,mdss-dsi-on-command-state = "dsi_lp_mode";
						qcom,mdss-dsi-panel-framerate = <0x3c>;
						qcom,mdss-dsi-panel-height = <0x1e0>;
						qcom,mdss-dsi-panel-phy-timings = <0x1c0707 0x23210707 0x5020400>;
						qcom,mdss-dsi-panel-timings = <0x00 0x00 0x00>;
						qcom,mdss-dsi-panel-width = <0x280>;
						qcom,mdss-dsi-v-back-porch = <0x06>;
						qcom,mdss-dsi-v-bottom-border = <0x00>;
						qcom,mdss-dsi-v-front-porch = <0x06>;
						qcom,mdss-dsi-v-pulse-width = <0x02>;
						qcom,mdss-dsi-v-top-border = <0x00>;
						qcom,mdss-dsi-video-mode;
					};

					timing@1 {
						qcom,default-topology-index = <0x00>;
						qcom,display-topology = <0x01 0x00 0x01>;
						qcom,mdss-dsi-cmd-mode;
						qcom,mdss-dsi-h-back-porch = <0x08>;
						qcom,mdss-dsi-h-front-porch = <0x08>;
						qcom,mdss-dsi-h-left-border = <0x00>;
						qcom,mdss-dsi-h-pulse-width = <0x08>;
						qcom,mdss-dsi-h-right-border = <0x00>;
						qcom,mdss-dsi-h-sync-pulse = <0x00>;
						qcom,mdss-dsi-h-sync-skew = <0x00>;
						qcom,mdss-dsi-off-command = [22 01 00 00 00 00 02 00 00];
						qcom,mdss-dsi-off-command-state = "dsi_lp_mode";
						qcom,mdss-dsi-on-command = [32 01 00 00 00 00 02 00 00];
						qcom,mdss-dsi-on-command-state = "dsi_lp_mode";
						qcom,mdss-dsi-panel-framerate = <0x3c>;
						qcom,mdss-dsi-panel-height = <0x1e0>;
						qcom,mdss-dsi-panel-phy-timings = <0x1c0707 0x23210707 0x5020400>;
						qcom,mdss-dsi-panel-timings = <0x00 0x00 0x00>;
						qcom,mdss-dsi-panel-width = <0x280>;
						qcom,mdss-dsi-v-back-porch = <0x06>;
						qcom,mdss-dsi-v-bottom-border = <0x00>;
						qcom,mdss-dsi-v-front-porch = <0x06>;
						qcom,mdss-dsi-v-pulse-width = <0x02>;
						qcom,mdss-dsi-v-top-border = <0x00>;
						qcom,video-to-cmd-mode-post-switch-commands = [32 01 00 00 00 00 02 00 00];
						qcom,video-to-cmd-mode-post-switch-commands-state = "dsi_lp_mode";
					};
				};
			};
		};
	};

	fragment@5 {
		target = <0xffffffff>;

		__overlay__ {

			qcom,mdss_dsi_sim_cmd {
				phandle = <0x06>;
				qcom,mdss-dsi-bl-max-level = <0xfff>;
				qcom,mdss-dsi-bl-pmic-control-type = "bl_ctrl_dcs";
				qcom,mdss-dsi-bllp-eof-power-mode;
				qcom,mdss-dsi-bllp-power-mode;
				qcom,mdss-dsi-border-color = <0x00>;
				qcom,mdss-dsi-bpp = <0x18>;
				qcom,mdss-dsi-color-order = "rgb_swap_rgb";
				qcom,mdss-dsi-dma-trigger = "trigger_sw";
				qcom,mdss-dsi-lane-0-state;
				qcom,mdss-dsi-lane-1-state;
				qcom,mdss-dsi-lane-2-state;
				qcom,mdss-dsi-lane-3-state;
				qcom,mdss-dsi-mdp-trigger = "none";
				qcom,mdss-dsi-panel-blackness-level = <0xc9e>;
				qcom,mdss-dsi-panel-hdr-color-primaries = <0x38a4 0x3c8c 0x7d00 0x4268 0x3c8c 0x7530 0x1f40 0xbb8>;
				qcom,mdss-dsi-panel-hdr-enabled;
				qcom,mdss-dsi-panel-name = "Simulator cmd mode dsi panel";
				qcom,mdss-dsi-panel-peak-brightness = <0x401640>;
				qcom,mdss-dsi-panel-type = "dsi_cmd_mode";
				qcom,mdss-dsi-reset-sequence = <0x01 0x0a 0x00 0x0a 0x01 0x0a>;
				qcom,mdss-dsi-stream = <0x00>;
				qcom,mdss-dsi-t-clk-post = <0x0c>;
				qcom,mdss-dsi-t-clk-pre = <0x29>;
				qcom,mdss-dsi-te-check-enable;
				qcom,mdss-dsi-te-dcs-command = <0x01>;
				qcom,mdss-dsi-te-pin-select = <0x01>;
				qcom,mdss-dsi-te-using-te-pin;
				qcom,mdss-dsi-te-using-wd;
				qcom,mdss-dsi-traffic-mode = "non_burst_sync_event";
				qcom,mdss-dsi-underflow-color = <0xff>;
				qcom,mdss-dsi-virtual-channel-id = <0x00>;
				qcom,mdss-dsi-wr-mem-continue = <0x3c>;
				qcom,mdss-dsi-wr-mem-start = <0x2c>;
				qcom,panel-ack-disabled;
				qcom,panel-supply-entries = <0x02>;
				qcom,platform-reset-gpio = <0xffffffff 0x03 0x00>;
				qcom,ulps-enabled;

				qcom,mdss-dsi-display-timings {

					timing@0 {
						qcom,compression-mode = "dsc";
						qcom,default-topology-index = <0x01>;
						qcom,display-topology = <0x01 0x01 0x01 0x02 0x02 0x01>;
						qcom,mdss-dsc-bit-per-component = <0x08>;
						qcom,mdss-dsc-bit-per-pixel = <0x08>;
						qcom,mdss-dsc-block-prediction-enable;
						qcom,mdss-dsc-slice-height = <0x28>;
						qcom,mdss-dsc-slice-per-pkt = <0x01>;
						qcom,mdss-dsc-slice-width = <0x2d0>;
						qcom,mdss-dsi-h-back-porch = <0x64>;
						qcom,mdss-dsi-h-front-porch = <0x78>;
						qcom,mdss-dsi-h-left-border = <0x00>;
						qcom,mdss-dsi-h-pulse-width = <0x28>;
						qcom,mdss-dsi-h-right-border = <0x00>;
						qcom,mdss-dsi-h-sync-skew = <0x00>;
						qcom,mdss-dsi-off-command = [05 01 00 00 32 00 02 28 00 05 01 00 00 78 00 02 10 00];
						qcom,mdss-dsi-off-command-state = "dsi_hs_mode";
						qcom,mdss-dsi-on-command = <0x29010000 0x2b0 0x3050100 0xa0001 0x150100 0xa0002 0x3a773901 0xa00 0x52a0000 0x4ff3901 0xa00 0x52b0000 0x59f1501 0xa00 0x2350039 0x100000a 0x34400 0x150100 0xa0002 0x51ff1501 0xa00 0x2532415 0x100000a 0x25500 0x5010000 0x78000111 0x5010000 0x10000129>;
						qcom,mdss-dsi-on-command-state = "dsi_lp_mode";
						qcom,mdss-dsi-panel-framerate = <0x3c>;
						qcom,mdss-dsi-panel-height = <0xa00>;
						qcom,mdss-dsi-panel-phy-timings = <0x1a0606 0x22200707 0x4020400>;
						qcom,mdss-dsi-panel-timings = <0x210909 0x24230808 0x8030400>;
						qcom,mdss-dsi-panel-width = <0x5a0>;
						qcom,mdss-dsi-v-back-porch = <0x64>;
						qcom,mdss-dsi-v-bottom-border = <0x00>;
						qcom,mdss-dsi-v-front-porch = <0x64>;
						qcom,mdss-dsi-v-pulse-width = <0x28>;
						qcom,mdss-dsi-v-top-border = <0x00>;
						qcom,panel-roi-alignment = <0x2d0 0x28 0x2d0 0x28 0x2d0 0x28>;
						qcom,partial-update-enabled = "single_roi";
					};

					timing@1 {
						qcom,compression-mode = "dsc";
						qcom,default-topology-index = <0x01>;
						qcom,display-topology = <0x01 0x01 0x01 0x02 0x02 0x01>;
						qcom,mdss-dsc-bit-per-component = <0x08>;
						qcom,mdss-dsc-bit-per-pixel = <0x08>;
						qcom,mdss-dsc-block-prediction-enable;
						qcom,mdss-dsc-slice-height = <0x28>;
						qcom,mdss-dsc-slice-per-pkt = <0x01>;
						qcom,mdss-dsc-slice-width = <0x21c>;
						qcom,mdss-dsi-h-back-porch = <0x1cc>;
						qcom,mdss-dsi-h-front-porch = <0x78>;
						qcom,mdss-dsi-h-left-border = <0x00>;
						qcom,mdss-dsi-h-pulse-width = <0x28>;
						qcom,mdss-dsi-h-right-border = <0x00>;
						qcom,mdss-dsi-h-sync-skew = <0x00>;
						qcom,mdss-dsi-off-command = [05 01 00 00 32 00 02 28 00 05 01 00 00 78 00 02 10 00];
						qcom,mdss-dsi-off-command-state = "dsi_hs_mode";
						qcom,mdss-dsi-on-command = <0x29010000 0x2b0 0x3050100 0xa0001 0x150100 0xa0002 0x3a773901 0xa00 0x52a0000 0x4ff3901 0xa00 0x52b0000 0x59f1501 0xa00 0x2350039 0x100000a 0x34400 0x150100 0xa0002 0x51ff1501 0xa00 0x2532415 0x100000a 0x25500 0x5010000 0x78000111 0x5010000 0x10000129>;
						qcom,mdss-dsi-on-command-state = "dsi_lp_mode";
						qcom,mdss-dsi-panel-framerate = <0x3c>;
						qcom,mdss-dsi-panel-height = <0x780>;
						qcom,mdss-dsi-panel-phy-timings = <0x1a0606 0x22200707 0x4020400>;
						qcom,mdss-dsi-panel-timings = <0x210909 0x24230808 0x8030400>;
						qcom,mdss-dsi-panel-width = <0x438>;
						qcom,mdss-dsi-v-back-porch = <0x64>;
						qcom,mdss-dsi-v-bottom-border = <0x00>;
						qcom,mdss-dsi-v-front-porch = <0x2e4>;
						qcom,mdss-dsi-v-pulse-width = <0x28>;
						qcom,mdss-dsi-v-top-border = <0x00>;
						qcom,panel-roi-alignment = <0x21c 0x28 0x21c 0x28 0x21c 0x28>;
						qcom,partial-update-enabled = "single_roi";
					};

					timing@2 {
						qcom,compression-mode = "dsc";
						qcom,default-topology-index = <0x01>;
						qcom,display-topology = <0x01 0x01 0x01 0x02 0x02 0x01>;
						qcom,mdss-dsc-bit-per-component = <0x08>;
						qcom,mdss-dsc-bit-per-pixel = <0x08>;
						qcom,mdss-dsc-block-prediction-enable;
						qcom,mdss-dsc-slice-height = <0x28>;
						qcom,mdss-dsc-slice-per-pkt = <0x01>;
						qcom,mdss-dsc-slice-width = <0x168>;
						qcom,mdss-dsi-h-back-porch = <0x348>;
						qcom,mdss-dsi-h-front-porch = <0x64>;
						qcom,mdss-dsi-h-left-border = <0x00>;
						qcom,mdss-dsi-h-pulse-width = <0x28>;
						qcom,mdss-dsi-h-right-border = <0x00>;
						qcom,mdss-dsi-h-sync-skew = <0x00>;
						qcom,mdss-dsi-off-command = [05 01 00 00 32 00 02 28 00 05 01 00 00 78 00 02 10 00];
						qcom,mdss-dsi-off-command-state = "dsi_hs_mode";
						qcom,mdss-dsi-on-command = <0x29010000 0x2b0 0x3050100 0xa0001 0x150100 0xa0002 0x3a773901 0xa00 0x52a0000 0x4ff3901 0xa00 0x52b0000 0x59f1501 0xa00 0x2350039 0x100000a 0x34400 0x150100 0xa0002 0x51ff1501 0xa00 0x2532415 0x100000a 0x25500 0x5010000 0x78000111 0x5010000 0x10000129>;
						qcom,mdss-dsi-on-command-state = "dsi_lp_mode";
						qcom,mdss-dsi-panel-framerate = <0x3c>;
						qcom,mdss-dsi-panel-height = <0x500>;
						qcom,mdss-dsi-panel-phy-timings = <0x1a0606 0x22200707 0x4020400>;
						qcom,mdss-dsi-panel-timings = <0x210909 0x24230808 0x8030400>;
						qcom,mdss-dsi-panel-width = <0x2d0>;
						qcom,mdss-dsi-v-back-porch = <0x64>;
						qcom,mdss-dsi-v-bottom-border = <0x00>;
						qcom,mdss-dsi-v-front-porch = <0x564>;
						qcom,mdss-dsi-v-pulse-width = <0x28>;
						qcom,mdss-dsi-v-top-border = <0x00>;
						qcom,panel-roi-alignment = <0x168 0x28 0x168 0x28 0x168 0x28>;
						qcom,partial-update-enabled = "single_roi";
					};
				};
			};
		};
	};

	fragment@6 {
		target = <0xffffffff>;

		__overlay__ {

			qcom,mdss_dsi_sim_dsc_375_cmd {
				phandle = <0x07>;
				qcom,adjust-timer-wakeup-ms = <0x01>;
				qcom,mdss-dsi-bl-max-level = <0xfff>;
				qcom,mdss-dsi-bl-pmic-control-type = "bl_ctrl_dcs";
				qcom,mdss-dsi-bllp-eof-power-mode;
				qcom,mdss-dsi-bllp-power-mode;
				qcom,mdss-dsi-border-color = <0x00>;
				qcom,mdss-dsi-bpp = <0x18>;
				qcom,mdss-dsi-color-order = "rgb_swap_rgb";
				qcom,mdss-dsi-dma-trigger = "trigger_sw";
				qcom,mdss-dsi-lane-0-state;
				qcom,mdss-dsi-lane-1-state;
				qcom,mdss-dsi-lane-2-state;
				qcom,mdss-dsi-lane-3-state;
				qcom,mdss-dsi-mdp-trigger = "none";
				qcom,mdss-dsi-panel-name = "Simulator cmd mode DSC 3.75:1 dsi panel";
				qcom,mdss-dsi-panel-type = "dsi_cmd_mode";
				qcom,mdss-dsi-reset-sequence = <0x01 0x0a 0x00 0x0a 0x01 0x0a>;
				qcom,mdss-dsi-stream = <0x00>;
				qcom,mdss-dsi-t-clk-post = <0x0d>;
				qcom,mdss-dsi-t-clk-pre = <0x2d>;
				qcom,mdss-dsi-te-check-enable;
				qcom,mdss-dsi-te-dcs-command = <0x01>;
				qcom,mdss-dsi-te-pin-select = <0x01>;
				qcom,mdss-dsi-te-using-te-pin;
				qcom,mdss-dsi-te-using-wd;
				qcom,mdss-dsi-traffic-mode = "non_burst_sync_event";
				qcom,mdss-dsi-underflow-color = <0xff>;
				qcom,mdss-dsi-virtual-channel-id = <0x00>;
				qcom,mdss-dsi-wr-mem-continue = <0x3c>;
				qcom,mdss-dsi-wr-mem-start = <0x2c>;
				qcom,panel-ack-disabled;
				qcom,panel-supply-entries = <0x02>;
				qcom,platform-reset-gpio = <0xffffffff 0x03 0x00>;
				qcom,ulps-enabled;

				qcom,mdss-dsi-display-timings {

					timing@0 {
						qcom,compression-mode = "dsc";
						qcom,default-topology-index = <0x00>;
						qcom,display-topology = <0x01 0x01 0x01>;
						qcom,mdss-dsc-bit-per-component = <0x0a>;
						qcom,mdss-dsc-bit-per-pixel = <0x08>;
						qcom,mdss-dsc-block-prediction-enable;
						qcom,mdss-dsc-slice-height = <0x10>;
						qcom,mdss-dsc-slice-per-pkt = <0x02>;
						qcom,mdss-dsc-slice-width = <0x2d0>;
						qcom,mdss-dsi-h-back-porch = <0x20>;
						qcom,mdss-dsi-h-front-porch = <0x64>;
						qcom,mdss-dsi-h-left-border = <0x00>;
						qcom,mdss-dsi-h-pulse-width = <0x10>;
						qcom,mdss-dsi-h-right-border = <0x00>;
						qcom,mdss-dsi-h-sync-pulse = <0x00>;
						qcom,mdss-dsi-h-sync-skew = <0x00>;
						qcom,mdss-dsi-off-command = [05 01 00 00 78 00 02 28 00 05 01 00 00 78 00 02 10 00];
						qcom,mdss-dsi-off-command-state = "dsi_hs_mode";
						qcom,mdss-dsi-on-command = <0x15010000 0x2ff 0x20150100 0x02 0xfb011501 0x00 0x2000115 0x1000000 0x20155 0x15010000 0x202 0x45150100 0x02 0x5401501 0x00 0x2061915 0x1000000 0x2071e 0x15010000 0x20b 0x73150100 0x02 0xc731501 0x00 0x20eb015 0x1000000 0x20fae 0x15010000 0x211 0xb8150100 0x02 0x13001501 0x00 0x2588015 0x1000000 0x25901 0x15010000 0x25a 0x150100 0x02 0x5b011501 0x00 0x25c8015 0x1000000 0x25d81 0x15010000 0x25e 0x150100 0x02 0x5f011501 0x00 0x2723115 0x1000000 0x26803 0x15010000 0x2ff 0x24150100 0x02 0xfb011501 0x00 0x2001c15 0x1000000 0x2010b 0x15010000 0x202 0xc150100 0x02 0x3011501 0x00 0x2040f15 0x1000000 0x20510 0x15010000 0x206 0x10150100 0x02 0x7101501 0x00 0x2088915 0x1000000 0x2098a 0x15010000 0x20a 0x13150100 0x02 0xb131501 0x00 0x20c1515 0x1000000 0x20d15 0x15010000 0x20e 0x17150100 0x02 0xf171501 0x00 0x2101c15 0x1000000 0x2110b 0x15010000 0x212 0xc150100 0x02 0x13011501 0x00 0x2140f15 0x1000000 0x21510 0x15010000 0x216 0x10150100 0x02 0x17101501 0x00 0x2188915 0x1000000 0x2198a 0x15010000 0x21a 0x13150100 0x02 0x1b131501 0x00 0x21c1515 0x1000000 0x21d15 0x15010000 0x21e 0x17150100 0x02 0x1f171501 0x00 0x2204015 0x1000000 0x22101 0x15010000 0x222 0x150100 0x02 0x23401501 0x00 0x2244015 0x1000000 0x2256d 0x15010000 0x226 0x40150100 0x02 0x27401501 0x00 0x2e00015 0x1000000 0x2dc21 0x15010000 0x2dd 0x22150100 0x02 0xde071501 0x00 0x2df0715 0x1000000 0x2e36d 0x15010000 0x2e1 0x7150100 0x02 0xe2071501 0x00 0x229d815 0x1000000 0x22a2a 0x15010000 0x24b 0x3150100 0x02 0x4c111501 0x00 0x24d1015 0x1000000 0x24e01 0x15010000 0x24f 0x1150100 0x02 0x50101501 0x00 0x2510015 0x1000000 0x25280 0x15010000 0x253 0x150100 0x02 0x56001501 0x00 0x2540715 0x1000000 0x25807 0x15010000 0x255 0x25150100 0x02 0x5b431501 0x00 0x25c0015 0x1000000 0x25f73 0x15010000 0x260 0x73150100 0x02 0x63221501 0x00 0x2640015 0x1000000 0x26708 0x15010000 0x268 0x4150100 0x02 0x72021501 0x00 0x27a8015 0x1000000 0x27b91 0x15010000 0x27c 0xd8150100 0x02 0x7d601501 0x00 0x27f1515 0x1000000 0x27515 0x15010000 0x2b3 0xc0150100 0x02 0xb4001501 0x00 0x2b50015 0x1000000 0x27800 0x15010000 0x279 0x150100 0x02 0x80001501 0x00 0x2830015 0x1000000 0x2930a 0x15010000 0x294 0xa150100 0x02 0x8a001501 0x00 0x29bff15 0x1000000 0x29db0 0x15010000 0x29f 0x63150100 0x02 0x98101501 0x00 0x2ec0015 0x1000000 0x2ff10 0x39010000 0x11c1 0x9200010 0x2000268 0x1bb000a 0x66704c5 0x39010000 0x3c2 0x10f01501 0x00 0x2c00315 0x1000000 0x43b03 0xa0a1501 0x00 0x2350015 0x1000000 0x2e501 0x15010000 0x2bb 0x10150100 0x02 0xfb010501 0x7800 0x2110005 0x1000078 0x22900>;
						qcom,mdss-dsi-on-command-state = "dsi_hs_mode";
						qcom,mdss-dsi-panel-framerate = <0x3c>;
						qcom,mdss-dsi-panel-height = <0xa00>;
						qcom,mdss-dsi-panel-phy-timings = <0x1a0606 0x22200707 0x4020400>;
						qcom,mdss-dsi-panel-width = <0x5a0>;
						qcom,mdss-dsi-v-back-porch = <0x08>;
						qcom,mdss-dsi-v-bottom-border = <0x00>;
						qcom,mdss-dsi-v-front-porch = <0x0a>;
						qcom,mdss-dsi-v-pulse-width = <0x02>;
						qcom,mdss-dsi-v-top-border = <0x00>;
					};

					timing@1 {
						qcom,compression-mode = "dsc";
						qcom,default-topology-index = <0x00>;
						qcom,display-topology = <0x01 0x01 0x01 0x02 0x02 0x01 0x02 0x01 0x01>;
						qcom,mdss-dsc-bit-per-component = <0x0a>;
						qcom,mdss-dsc-bit-per-pixel = <0x08>;
						qcom,mdss-dsc-block-prediction-enable;
						qcom,mdss-dsc-slice-height = <0x10>;
						qcom,mdss-dsc-slice-per-pkt = <0x02>;
						qcom,mdss-dsc-slice-width = <0x21c>;
						qcom,mdss-dsi-h-back-porch = <0x00>;
						qcom,mdss-dsi-h-front-porch = <0x00>;
						qcom,mdss-dsi-h-left-border = <0x00>;
						qcom,mdss-dsi-h-pulse-width = <0x00>;
						qcom,mdss-dsi-h-right-border = <0x00>;
						qcom,mdss-dsi-h-sync-pulse = <0x00>;
						qcom,mdss-dsi-h-sync-skew = <0x00>;
						qcom,mdss-dsi-off-command = <0x5010000 0x10000128 0x5010000 0x40000110>;
						qcom,mdss-dsi-off-command-state = "dsi_hs_mode";
						qcom,mdss-dsi-on-command = <0x15010000 0x2bb 0x10150100 0x02 0xb0030501 0x7800 0x1111501 0x00 0x251ff15 0x1000000 0x25324 0x15010000 0x2ff 0x23150100 0x02 0x8051501 0x00 0x2469015 0x1000000 0x2ff10 0x15010000 0x2ff 0xf0150100 0x02 0x92011501 0x00 0x2ff1015 0x1000000 0x23500 0x5010000 0x28000129>;
						qcom,mdss-dsi-on-command-state = "dsi_lp_mode";
						qcom,mdss-dsi-panel-framerate = <0x3c>;
						qcom,mdss-dsi-panel-height = <0x780>;
						qcom,mdss-dsi-panel-phy-timings = <0x150505 0x201f0505 0x3020400>;
						qcom,mdss-dsi-panel-width = <0x438>;
						qcom,mdss-dsi-v-back-porch = <0x00>;
						qcom,mdss-dsi-v-bottom-border = <0x00>;
						qcom,mdss-dsi-v-front-porch = <0x00>;
						qcom,mdss-dsi-v-pulse-width = <0x00>;
						qcom,mdss-dsi-v-top-border = <0x00>;
					};
				};
			};
		};
	};

	fragment@7 {
		target = <0xffffffff>;

		__overlay__ {

			qcom,mdss_dsi_nt36672c_video {
				phandle = <0x08>;
				qcom,dsi-dyn-clk-enable;
				qcom,dsi-dyn-clk-list = <0x3eb54a94 0x3e726713 0x3e2f838b 0x3deca00a 0x3da9bc89>;
				qcom,dsi-dyn-clk-skip-timing-update;
				qcom,dsi-dyn-clk-type = "constant-fps-adjust-hfp";
				qcom,dsi-supported-dfps-list = <0x3c 0x5a 0x32>;
				qcom,esd-check-enabled;
				qcom,mdss-dsi-bllp-eof-power-mode;
				qcom,mdss-dsi-bllp-power-mode;
				qcom,mdss-dsi-border-color = <0x00>;
				qcom,mdss-dsi-bpp = <0x18>;
				qcom,mdss-dsi-dma-trigger = "trigger_sw";
				qcom,mdss-dsi-lane-0-state;
				qcom,mdss-dsi-lane-1-state;
				qcom,mdss-dsi-lane-2-state;
				qcom,mdss-dsi-mdp-trigger = "none";
				qcom,mdss-dsi-pan-enable-dynamic-fps;
				qcom,mdss-dsi-pan-fps-update = "dfps_immediate_porch_mode_vfp";
				qcom,mdss-dsi-panel-blackness-level = <0xc9e>;
				qcom,mdss-dsi-panel-name = "nt36672c fhd plus video mode dsi panel";
				qcom,mdss-dsi-panel-on-check-value = <0x9c>;
				qcom,mdss-dsi-panel-peak-brightness = <0x401640>;
				qcom,mdss-dsi-panel-status-check-mode = "reg_read";
				qcom,mdss-dsi-panel-status-command = <0x6010001 0x10a>;
				qcom,mdss-dsi-panel-status-command-state = "dsi_hs_mode";
				qcom,mdss-dsi-panel-status-read-length = <0x01>;
				qcom,mdss-dsi-panel-status-value = <0x9c>;
				qcom,mdss-dsi-panel-type = "dsi_video_mode";
				qcom,mdss-dsi-reset-sequence = <0x01 0x14 0x00 0x14 0x01 0x14>;
				qcom,mdss-dsi-stream = <0x00>;
				qcom,mdss-dsi-t-clk-post = <0x00>;
				qcom,mdss-dsi-t-clk-pre = <0x00>;
				qcom,mdss-dsi-traffic-mode = "non_burst_sync_event";
				qcom,mdss-dsi-underflow-color = <0xff>;
				qcom,mdss-dsi-virtual-channel-id = <0x00>;
				qcom,mdss-pan-physical-height-dimension = <0x83>;
				qcom,mdss-pan-physical-width-dimension = <0x4a>;
				qcom,panel-cphy-mode;

				qcom,mdss-dsi-display-timings {

					timing@0 {
						qcom,default-topology-index = <0x00>;
						qcom,display-topology = <0x01 0x00 0x01>;
						qcom,mdss-dsi-h-back-porch = <0x38>;
						qcom,mdss-dsi-h-front-porch = <0xca>;
						qcom,mdss-dsi-h-pulse-width = <0x0c>;
						qcom,mdss-dsi-h-sync-skew = <0x00>;
						qcom,mdss-dsi-off-command = [05 01 00 00 14 00 02 28 00 05 01 00 00 78 00 02 10 00];
						qcom,mdss-dsi-off-command-state = "dsi_hs_mode";
						qcom,mdss-dsi-on-command = [29 01 00 00 00 00 02 ff 10 29 01 00 00 00 00 02 fb 01 29 01 00 00 00 00 02 b0 00 29 01 00 00 00 00 02 c0 00 29 01 00 00 00 00 03 c2 1b a0 29 01 00 00 00 00 02 ff 25 29 01 00 00 00 00 02 fb 01 29 01 00 00 00 00 02 18 20 15 01 00 00 00 00 02 ff 2a 15 01 00 00 00 00 02 fb 01 15 01 00 00 00 00 02 27 80 15 01 00 00 00 00 02 28 fd 29 01 00 00 00 00 02 ff f0 29 01 00 00 00 00 02 fb 01 29 01 00 00 00 00 02 5a 00 29 01 00 00 00 00 02 a0 08 29 01 00 00 00 00 02 ff d0 29 01 00 00 00 00 02 fb 01 29 01 00 00 00 00 02 09 ad 15 01 00 00 00 00 02 ff 10 15 01 00 00 00 00 02 fb 01 15 01 00 00 00 00 02 51 ff 15 01 00 00 00 00 02 53 2c 15 01 00 00 00 00 02 ff 23 15 01 00 00 00 00 02 fb 01 15 01 00 00 00 00 02 0a 00 15 01 00 00 00 00 02 0b 00 15 01 00 00 00 00 02 0c 00 15 01 00 00 00 00 02 0d 00 15 01 00 00 00 00 02 11 01 15 01 00 00 00 00 02 12 95 15 01 00 00 00 00 02 15 68 15 01 00 00 00 00 02 16 0b 15 01 00 00 00 00 02 6f 00 15 01 00 00 00 00 02 70 00 15 01 00 00 00 00 02 71 00 15 01 00 00 00 00 02 a0 11 15 01 00 00 00 00 02 ff f0 15 01 00 00 00 00 02 fb 01 15 01 00 00 00 00 02 d2 52 29 01 00 00 00 00 02 ff 10 29 01 00 00 00 00 02 35 00 05 01 00 00 78 00 02 11 00 05 01 00 00 14 00 02 29 00];
						qcom,mdss-dsi-on-command-state = "dsi_lp_mode";
						qcom,mdss-dsi-panel-framerate = <0x3c>;
						qcom,mdss-dsi-panel-height = <0x960>;
						qcom,mdss-dsi-panel-phy-timings = <0x230909 0x26240909 0x9060204>;
						qcom,mdss-dsi-panel-width = <0x438>;
						qcom,mdss-dsi-v-back-porch = <0x0a>;
						qcom,mdss-dsi-v-front-porch = <0x50b>;
						qcom,mdss-dsi-v-pulse-width = <0x0a>;
					};
				};
			};
		};
	};

	fragment@8 {
		target = <0xffffffff>;

		__overlay__ {

			qcom,mdss_dsi_ft8756_huaxing_video {
				phandle = <0x09>;
				qcom,dispparam-enabled;
				qcom,esd-err-int-gpio = <0xffffffff 0x04 0x00>;
				qcom,mdss-brightness-max-level = <0xfff>;
				qcom,mdss-dsi-bl-max-level = <0xfff>;
				qcom,mdss-dsi-bl-min-level = <0x01>;
				qcom,mdss-dsi-bl-pmic-control-type = "bl_ctrl_wled";
				qcom,mdss-dsi-bllp-eof-power-mode;
				qcom,mdss-dsi-bllp-power-mode;
				qcom,mdss-dsi-border-color = <0x00>;
				qcom,mdss-dsi-bpp = <0x18>;
				qcom,mdss-dsi-color-order = "rgb_swap_rgb";
				qcom,mdss-dsi-dma-trigger = "trigger_sw";
				qcom,mdss-dsi-force-clock-lane-hs;
				qcom,mdss-dsi-h-left-border = <0x00>;
				qcom,mdss-dsi-h-right-border = <0x00>;
				qcom,mdss-dsi-h-sync-pulse = <0x00>;
				qcom,mdss-dsi-lane-0-state;
				qcom,mdss-dsi-lane-1-state;
				qcom,mdss-dsi-lane-2-state;
				qcom,mdss-dsi-lane-3-state;
				qcom,mdss-dsi-lane-map = "lane_map_0123";
				qcom,mdss-dsi-lp11-init;
				qcom,mdss-dsi-mdp-trigger = "none";
				qcom,mdss-dsi-panel-name = "ft8756 video mode dsi huaxing panel";
				qcom,mdss-dsi-panel-type = "dsi_video_mode";
				qcom,mdss-dsi-reset-sequence = <0x01 0x04 0x00 0x01 0x01 0x0a>;
				qcom,mdss-dsi-stream = <0x00>;
				qcom,mdss-dsi-t-clk-post = <0x02>;
				qcom,mdss-dsi-t-clk-pre = <0x2f>;
				qcom,mdss-dsi-traffic-mode = "non_burst_sync_event";
				qcom,mdss-dsi-tx-eot-append;
				qcom,mdss-dsi-underflow-color = <0xff>;
				qcom,mdss-dsi-v-bottom-border = <0x00>;
				qcom,mdss-dsi-v-top-border = <0x00>;
				qcom,mdss-dsi-virtual-channel-id = <0x00>;
				qcom,mdss-pan-physical-height-dimension = <0x9a>;
				qcom,mdss-pan-physical-width-dimension = <0x45>;

				qcom,mdss-dsi-display-timings {

					timing@0 {
						qcom,default-topology-index = <0x00>;
						qcom,display-topology = <0x01 0x00 0x01>;
						qcom,mdss-dsi-dispparam-cabcmovieon-command = [15 01 00 00 00 00 02 55 03];
						qcom,mdss-dsi-dispparam-cabcmovieon-command-state = "dsi_hs_mode";
						qcom,mdss-dsi-dispparam-cabcoff-command = [15 01 00 00 00 00 02 55 00];
						qcom,mdss-dsi-dispparam-cabcoff-command-state = "dsi_hs_mode";
						qcom,mdss-dsi-dispparam-cabcstillon-command = [15 01 00 00 00 00 02 55 02];
						qcom,mdss-dsi-dispparam-cabcstillon-command-state = "dsi_hs_mode";
						qcom,mdss-dsi-dispparam-cabcuion-command = [15 01 00 00 00 00 02 55 01];
						qcom,mdss-dsi-dispparam-cabcuion-command-state = "dsi_hs_mode";
						qcom,mdss-dsi-dispparam-dimmingoff-command = [39 01 00 00 01 00 02 53 24];
						qcom,mdss-dsi-dispparam-dimmingoff-command-state = "dsi_lp_mode";
						qcom,mdss-dsi-dispparam-dimmingon-command = [39 01 00 00 01 00 02 53 2c];
						qcom,mdss-dsi-dispparam-dimmingon-command-state = "dsi_lp_mode";
						qcom,mdss-dsi-dispparam-hbm-off-command = [15 01 00 00 00 00 02 53 2c 15 01 00 00 00 00 02 51 b8];
						qcom,mdss-dsi-dispparam-hbm-off-command-state = "dsi_lp_mode";
						qcom,mdss-dsi-dispparam-hbm-on-command = [15 01 00 00 00 00 02 53 2c 15 01 00 00 00 00 02 51 e6];
						qcom,mdss-dsi-dispparam-hbm-on-command-state = "dsi_lp_mode";
						qcom,mdss-dsi-dispparam-xy-coordinate-command = [15 01 00 00 00 00 02 00 60 06 01 00 01 05 00 02 f4 00];
						qcom,mdss-dsi-dispparam-xy-coordinate-command-state = "dsi_hs_mode";
						qcom,mdss-dsi-h-back-porch = <0x14>;
						qcom,mdss-dsi-h-front-porch = <0x14>;
						qcom,mdss-dsi-h-pulse-width = <0x04>;
						qcom,mdss-dsi-h-sync-skew = <0x00>;
						qcom,mdss-dsi-hbm1-on-command = [15 01 00 00 00 00 02 53 2c 15 01 00 00 00 00 02 51 e6];
						qcom,mdss-dsi-hbm1-on-command-state = "dsi_lp_mode";
						qcom,mdss-dsi-hbm2-on-command = [15 01 00 00 00 00 02 53 2c 15 01 00 00 00 00 02 51 ff];
						qcom,mdss-dsi-hbm2-on-command-state = "dsi_lp_mode";
						qcom,mdss-dsi-off-command = [05 01 00 00 0a 00 02 28 00 05 01 00 00 96 00 02 10 00 39 01 00 00 00 00 02 00 00 39 01 00 00 00 00 05 f7 5a a5 95 27];
						qcom,mdss-dsi-off-command-state = "dsi_hs_mode";
						qcom,mdss-dsi-on-command = [39 01 00 00 00 00 02 00 00 39 01 00 00 00 00 04 ff 87 56 01 39 01 00 00 00 00 02 00 80 39 01 00 00 00 00 03 ff 87 56 15 01 00 00 00 00 02 00 80 39 01 00 00 00 00 0d ca 80 80 80 80 80 80 80 80 80 80 80 80 15 01 00 00 00 00 02 00 90 39 01 00 00 00 00 0a ca fe ff 66 f6 ff 66 fb ff 32 15 01 00 00 00 00 02 51 b8 15 01 00 00 00 00 02 53 24 15 01 00 00 00 00 02 55 00 39 01 00 00 00 00 02 00 b5 39 01 00 00 00 00 02 ca 04 05 01 00 00 5a 00 02 11 00 05 01 00 00 05 00 02 29 00];
						qcom,mdss-dsi-on-command-state = "dsi_lp_mode";
						qcom,mdss-dsi-panel-framerate = <0x3c>;
						qcom,mdss-dsi-panel-height = <0x960>;
						qcom,mdss-dsi-panel-phy-timings = <0x220808 0x25230908 0x6020400>;
						qcom,mdss-dsi-panel-width = <0x438>;
						qcom,mdss-dsi-v-back-porch = <0x20>;
						qcom,mdss-dsi-v-front-porch = <0x08>;
						qcom,mdss-dsi-v-pulse-width = <0x04>;
					};
				};
			};
		};
	};

	fragment@9 {
		target = <0xffffffff>;

		__overlay__ {

			qcom,mdss_dsi_nt36675_tianma_video {
				phandle = <0x0a>;
				qcom,dispparam-enabled;
				qcom,esd-err-int-gpio = <0xffffffff 0x04 0x00>;
				qcom,mdss-brightness-max-level = <0xfff>;
				qcom,mdss-dsi-bl-max-level = <0xfff>;
				qcom,mdss-dsi-bl-min-level = <0x01>;
				qcom,mdss-dsi-bl-pmic-control-type = "bl_ctrl_wled";
				qcom,mdss-dsi-bllp-eof-power-mode;
				qcom,mdss-dsi-bllp-power-mode;
				qcom,mdss-dsi-border-color = <0x00>;
				qcom,mdss-dsi-bpp = <0x18>;
				qcom,mdss-dsi-color-order = "rgb_swap_rgb";
				qcom,mdss-dsi-dma-trigger = "trigger_sw";
				qcom,mdss-dsi-h-left-border = <0x00>;
				qcom,mdss-dsi-h-right-border = <0x00>;
				qcom,mdss-dsi-h-sync-pulse = <0x00>;
				qcom,mdss-dsi-lane-0-state;
				qcom,mdss-dsi-lane-1-state;
				qcom,mdss-dsi-lane-2-state;
				qcom,mdss-dsi-lane-3-state;
				qcom,mdss-dsi-lane-map = "lane_map_0123";
				qcom,mdss-dsi-lp11-init;
				qcom,mdss-dsi-mdp-trigger = "none";
				qcom,mdss-dsi-panel-name = "nt36675 video mode dsi tianma panel";
				qcom,mdss-dsi-panel-type = "dsi_video_mode";
				qcom,mdss-dsi-reset-sequence = <0x01 0x0a 0x00 0x0a 0x01 0x0a>;
				qcom,mdss-dsi-stream = <0x00>;
				qcom,mdss-dsi-t-clk-post = <0x02>;
				qcom,mdss-dsi-t-clk-pre = <0x2f>;
				qcom,mdss-dsi-traffic-mode = "non_burst_sync_event";
				qcom,mdss-dsi-tx-eot-append;
				qcom,mdss-dsi-underflow-color = <0xff>;
				qcom,mdss-dsi-v-bottom-border = <0x00>;
				qcom,mdss-dsi-v-top-border = <0x00>;
				qcom,mdss-dsi-virtual-channel-id = <0x00>;
				qcom,mdss-pan-physical-height-dimension = <0x9a>;
				qcom,mdss-pan-physical-width-dimension = <0x45>;

				qcom,mdss-dsi-display-timings {

					timing@0 {
						qcom,default-topology-index = <0x00>;
						qcom,display-topology = <0x01 0x00 0x01>;
						qcom,mdss-dsi-dispparam-cabcmovieon-command = <0x15010000 0x2ff 0x23150100 0x02 0xfb011501 0x00 0x20a2015 0x1000000 0x20b20 0x15010000 0x20c 0x20150100 0x02 0xd2a1501 0x00 0x2105015 0x1000000 0x21101 0x15010000 0x212 0x95150100 0x02 0x15681501 0x00 0x2160b15 0x1000000 0x258ff 0x15010000 0x259 0xff150100 0x02 0x5afc1501 0x00 0x25bf515 0x1000000 0x25ced 0x15010000 0x25d 0xe7150100 0x02 0x5ee11501 0x00 0x25fd915 0x1000000 0x260d4 0x15010000 0x261 0xcf150100 0x02 0x62ca1501 0x00 0x263c515 0x1000000 0x264c0 0x15010000 0x265 0xbb150100 0x02 0x66b61501 0x00 0x267b215 0x1000000 0x2a011 0x15010000 0x2ff 0x10150100 0x02 0xfb011501 0x00 0x2532c15 0x1000000 0x25503>;
						qcom,mdss-dsi-dispparam-cabcmovieon-command-state = "dsi_hs_mode";
						qcom,mdss-dsi-dispparam-cabcoff-command = [15 01 00 00 00 00 02 ff 10 15 01 00 00 00 00 02 53 24 15 01 00 00 00 00 02 55 00];
						qcom,mdss-dsi-dispparam-cabcoff-command-state = "dsi_hs_mode";
						qcom,mdss-dsi-dispparam-cabcstillon-command = <0x15010000 0x2ff 0x23150100 0x02 0xfb011501 0x00 0x20a2015 0x1000000 0x20b20 0x15010000 0x20c 0x20150100 0x02 0xd2a1501 0x00 0x2105015 0x1000000 0x21101 0x15010000 0x212 0x95150100 0x02 0x15681501 0x00 0x2160b15 0x1000000 0x245ff 0x15010000 0x246 0xfe150100 0x02 0x47fa1501 0x00 0x248ee15 0x1000000 0x249e1 0x15010000 0x24a 0xcf150100 0x02 0x4bbe1501 0x00 0x24cb215 0x1000000 0x24da8 0x15010000 0x24e 0x9e150100 0x02 0x4f941501 0x00 0x2508a15 0x1000000 0x25180 0x15010000 0x252 0x76150100 0x02 0x536e1501 0x00 0x2546615 0x1000000 0x2a011 0x15010000 0x2ff 0x10150100 0x02 0xfb011501 0x00 0x2532c15 0x1000000 0x25502>;
						qcom,mdss-dsi-dispparam-cabcstillon-command-state = "dsi_hs_mode";
						qcom,mdss-dsi-dispparam-cabcuion-command = <0x15010000 0x2ff 0x10150100 0x02 0xfb011501 0x00 0x2532c15 0x1000000 0x25501>;
						qcom,mdss-dsi-dispparam-cabcuion-command-state = "dsi_hs_mode";
						qcom,mdss-dsi-dispparam-dimmingoff-command = [39 01 00 00 01 00 02 53 24];
						qcom,mdss-dsi-dispparam-dimmingoff-command-state = "dsi_lp_mode";
						qcom,mdss-dsi-dispparam-dimmingon-command = [39 01 00 00 01 00 02 53 2c];
						qcom,mdss-dsi-dispparam-dimmingon-command-state = "dsi_lp_mode";
						qcom,mdss-dsi-dispparam-hbm-off-command = [15 01 00 00 00 00 02 53 2c 15 01 00 00 00 00 02 51 b8];
						qcom,mdss-dsi-dispparam-hbm-off-command-state = "dsi_lp_mode";
						qcom,mdss-dsi-dispparam-hbm-on-command = [15 01 00 00 00 00 02 53 2c 15 01 00 00 00 00 02 51 e6];
						qcom,mdss-dsi-dispparam-hbm-on-command-state = "dsi_lp_mode";
						qcom,mdss-dsi-dispparam-xy-coordinate-command = <0x15010000 0x2ff 0x10060100 0x1050002 0xda000601 0x10500 0x2db0006 0x1000105 0x2dc00>;
						qcom,mdss-dsi-dispparam-xy-coordinate-command-state = "dsi_hs_mode";
						qcom,mdss-dsi-h-back-porch = <0x16>;
						qcom,mdss-dsi-h-front-porch = <0x14>;
						qcom,mdss-dsi-h-pulse-width = <0x04>;
						qcom,mdss-dsi-h-sync-skew = <0x00>;
						qcom,mdss-dsi-hbm1-on-command = [15 01 00 00 00 00 02 53 2c 15 01 00 00 00 00 02 51 e6];
						qcom,mdss-dsi-hbm1-on-command-state = "dsi_lp_mode";
						qcom,mdss-dsi-hbm2-on-command = [15 01 00 00 00 00 02 53 2c 15 01 00 00 00 00 02 51 ff];
						qcom,mdss-dsi-hbm2-on-command-state = "dsi_lp_mode";
						qcom,mdss-dsi-off-command = [15 01 00 00 00 00 02 ff 10 05 01 00 00 0a 00 02 28 00 05 01 00 00 8c 00 02 10 00];
						qcom,mdss-dsi-off-command-state = "dsi_hs_mode";
						qcom,mdss-dsi-on-command = [15 01 00 00 00 00 02 ff 10 15 01 00 00 00 00 02 fb 01 39 01 00 00 00 00 06 3b 03 1e 0a 04 04 15 01 00 00 00 00 02 b0 00 15 01 00 00 00 00 02 35 00 15 01 00 00 00 00 02 51 b8 15 01 00 00 00 00 02 53 24 15 01 00 00 00 00 02 55 00 15 01 00 00 00 00 02 ff 27 15 01 00 00 00 00 02 fb 01 15 01 00 00 00 00 02 07 01 15 01 00 00 00 00 02 40 25 15 01 00 00 00 00 02 ff 23 15 01 00 00 00 00 02 fb 01 15 01 00 00 00 00 02 0a 20 15 01 00 00 00 00 02 0b 20 15 01 00 00 00 00 02 0c 20 15 01 00 00 00 00 02 0d 2a 15 01 00 00 00 00 02 10 50 15 01 00 00 00 00 02 11 01 15 01 00 00 00 00 02 12 95 15 01 00 00 00 00 02 15 68 15 01 00 00 00 00 02 16 0b 15 01 00 00 00 00 02 30 ff 15 01 00 00 00 00 02 31 ff 15 01 00 00 00 00 02 32 ff 15 01 00 00 00 00 02 33 fe 15 01 00 00 00 00 02 34 fd 15 01 00 00 00 00 02 35 fa 15 01 00 00 00 00 02 36 f6 15 01 00 00 00 00 02 37 f2 15 01 00 00 00 00 02 38 f0 15 01 00 00 00 00 02 39 ee 15 01 00 00 00 00 02 3a ec 15 01 00 00 00 00 02 3b ea 15 01 00 00 00 00 02 3d e8 15 01 00 00 00 00 02 3f e7 15 01 00 00 00 00 02 40 e6 15 01 00 00 00 00 02 41 e5 15 01 00 00 00 00 02 a0 11 15 01 00 00 00 00 02 ff 10 15 01 00 00 00 00 02 fb 01 05 01 00 00 50 00 02 11 00 05 01 00 00 05 00 02 29 00 15 01 00 00 00 00 02 ff 27 15 01 00 00 00 00 02 fb 01 15 01 00 00 00 00 02 3f 01 15 01 00 00 00 00 02 43 08 15 01 00 00 00 00 02 ff 10];
						qcom,mdss-dsi-on-command-state = "dsi_lp_mode";
						qcom,mdss-dsi-panel-framerate = <0x3c>;
						qcom,mdss-dsi-panel-height = <0x960>;
						qcom,mdss-dsi-panel-phy-timings = <0x220809 0x25230909 0x6020400>;
						qcom,mdss-dsi-panel-width = <0x438>;
						qcom,mdss-dsi-v-back-porch = <0x1e>;
						qcom,mdss-dsi-v-front-porch = <0x0a>;
						qcom,mdss-dsi-v-pulse-width = <0x02>;
					};
				};
			};
		};
	};
};
